// =============================================================================
// Generated by efx_ipmgr
// Version: 2021.2.323
// IP Version: 2.0
// =============================================================================

////////////////////////////////////////////////////////////////////////////////
// Copyright (C) 2013-2021 Efinix Inc. All rights reserved.              
//
// This   document  contains  proprietary information  which   is        
// protected by  copyright. All rights  are reserved.  This notice       
// refers to original work by Efinix, Inc. which may be derivitive       
// of other work distributed under license of the authors.  In the       
// case of derivative work, nothing in this notice overrides the         
// original author's license agreement.  Where applicable, the           
// original license agreement is included in it's original               
// unmodified form immediately below this header.                        
//                                                                       
// WARRANTY DISCLAIMER.                                                  
//     THE  DESIGN, CODE, OR INFORMATION ARE PROVIDED “AS IS” AND        
//     EFINIX MAKES NO WARRANTIES, EXPRESS OR IMPLIED WITH               
//     RESPECT THERETO, AND EXPRESSLY DISCLAIMS ANY IMPLIED WARRANTIES,  
//     INCLUDING, WITHOUT LIMITATION, THE IMPLIED WARRANTIES OF          
//     MERCHANTABILITY, NON-INFRINGEMENT AND FITNESS FOR A PARTICULAR    
//     PURPOSE.  SOME STATES DO NOT ALLOW EXCLUSIONS OF AN IMPLIED       
//     WARRANTY, SO THIS DISCLAIMER MAY NOT APPLY TO LICENSEE.           
//                                                                       
// LIMITATION OF LIABILITY.                                              
//     NOTWITHSTANDING ANYTHING TO THE CONTRARY, EXCEPT FOR BODILY       
//     INJURY, EFINIX SHALL NOT BE LIABLE WITH RESPECT TO ANY SUBJECT    
//     MATTER OF THIS AGREEMENT UNDER TORT, CONTRACT, STRICT LIABILITY   
//     OR ANY OTHER LEGAL OR EQUITABLE THEORY (I) FOR ANY INDIRECT,      
//     SPECIAL, INCIDENTAL, EXEMPLARY OR CONSEQUENTIAL DAMAGES OF ANY    
//     CHARACTER INCLUDING, WITHOUT LIMITATION, DAMAGES FOR LOSS OF      
//     GOODWILL, DATA OR PROFIT, WORK STOPPAGE, OR COMPUTER FAILURE OR   
//     MALFUNCTION, OR IN ANY EVENT (II) FOR ANY AMOUNT IN EXCESS, IN    
//     THE AGGREGATE, OF THE FEE PAID BY LICENSEE TO EFINIX HEREUNDER    
//     (OR, IF THE FEE HAS BEEN WAIVED, $100), EVEN IF EFINIX SHALL HAVE 
//     BEEN INFORMED OF THE POSSIBILITY OF SUCH DAMAGES.  SOME STATES DO 
//     NOT ALLOW THE EXCLUSION OR LIMITATION OF INCIDENTAL OR            
//     CONSEQUENTIAL DAMAGES, SO THIS LIMITATION AND EXCLUSION MAY NOT   
//     APPLY TO LICENSEE.                                                
//
////////////////////////////////////////////////////////////////////////////////

`define IP_UUID _3304c18ab41b423f9d2fd3d1fa31287d
`define IP_NAME_CONCAT(a,b) a``b
`define IP_MODULE_NAME(name) `IP_NAME_CONCAT(name,`IP_UUID)
module ddr3_calibration (
input rst_n,
input clk,
input ddr_cal_auto_en,
input [3:0] ddr_cal_auto_sel,
input pll_locked,
input pll_ddr_locked,
output pll_rst_n,
output pll_ddr_rst_n,
output [7:0] ddr_cal_auto_status,
output auto_cal_done,
output auto_cal_err,
output ddr_slave_i2c_scl,
output ddr_slave_i2c_sda,
input ddr_slave_i2c_sda_in
);
`IP_MODULE_NAME(ddr_calibration_parser) #(
.ROM_DATA_DEPTH3 (10),
.ROM_DATA_DEPTH2 (2),
.ROM_DATA_DEPTH1 (31),
.ROM_INIT_FILE0 ("rom0_ddr3_x16.hex"),
.ROM_INIT_FILE1 ("rom1_ddr3_x16.hex"),
.ROM_INIT_FILE2 ("rom2_ddr3_x16.hex"),
.ROM_INIT_FILE3 ("rom3_ddr3_x16.hex"),
.DDR_TYPE (1),
.DDR_X16 (1),
.ROM_DATA_DEPTH0 (218)
) u_ddr_calibration_parser(
.rst_n ( rst_n ),
.clk ( clk ),
.ddr_cal_auto_en ( ddr_cal_auto_en ),
.ddr_cal_auto_sel ( ddr_cal_auto_sel ),
.pll_locked ( pll_locked ),
.pll_ddr_locked ( pll_ddr_locked ),
.pll_rst_n ( pll_rst_n ),
.pll_ddr_rst_n ( pll_ddr_rst_n ),
.ddr_cal_auto_status ( ddr_cal_auto_status ),
.auto_cal_done ( auto_cal_done ),
.auto_cal_err ( auto_cal_err ),
.ddr_slave_i2c_scl ( ddr_slave_i2c_scl ),
.ddr_slave_i2c_sda ( ddr_slave_i2c_sda ),
.ddr_slave_i2c_sda_in ( ddr_slave_i2c_sda_in )
);

endmodule

////////////////////////////////////////////////////////////////////////////
//           _____       
//          / _______    Copyright (C) 2013-2020 Efinix Inc. All rights reserved.
//         / /       \   
//        / /  ..    /   ddr_calibration_controller.v
//       / / .'     /    
//    __/ /.'      /     Description:
//   __   \       /      DDR calibration logic main FSM 
//  /_/ /\ \_____/ /     
// ____/  \_______/      
//
// *******************************
// Revisions:
// 1.0 Initial rev
// 2.0 a) added course delay sweeping feature for gate levelling
//     b) fix read levelling final value programming
// *******************************

/////////////////////////////////////////////////////////////////////////////////
`resetall
`timescale 1ns / 1ps

  module `IP_MODULE_NAME(cal_controller) #( 
	parameter [1:0] DDR_TYPE                = 2'b00,
	parameter 	I2C_CMD_BYTE_WIDTH 	= 8,
	parameter [7:0] I2C_TRX_BYTE 		= 8'h5,
	parameter	ROM_DATA_DEPTH0		= 16,
	parameter	ROM_DATA_DEPTH1		= 16,
	parameter	ROM_DATA_DEPTH2		= 16,
	parameter	ROM_DATA_DEPTH3		= 16,
	parameter	ROM_INIT_FILE0		= "rom0.hex",
	parameter	ROM_INIT_FILE1		= "rom1.hex",
	parameter	ROM_INIT_FILE2		= "rom2.hex",
	parameter	ROM_INIT_FILE3		= "rom3.hex"
	
  )(
   	//inputs
   	input 				clk,            //system Clock 
   	input 				rst_n,          //active Low Reset 
   	input 				restart,        //restart the Calibration
   	input 				enable_cal,     //enable the DDR calibration
	input [1:0]			cal_type,	//DDR type[0]
							//1'b0 - LPDDR3 / LPDDR2
							//1'b1 - DDR3
							//DDR type[1]
							//1'b0 - hard_cal
							//1'b1 - soft_cal
   	input [3:0] 			cal_mode,    	//DDR Calibration Mode
   	                         			//bit 0 - Gate Leveling
   	                         			//bit 1 - Write Leveling
   	                         			//bit 2 - Read Leveling
   	                         			//bit 3 - CA Leveling
	input [2:0]			cal_slice,
   	//outputs
   	output reg 			cal_done,       //calibration Done Flag
	output reg [6:0]		cal_status_reg,
	output[7:0]			cal_status_reg2,
   	output reg 			wr_rd_pass_reg, //write and read pass 
   	////////////////////
   	//I2c Interface
   	////////////////////
   	//inputs 
   	input 				i2c_busy,       //i2c Master Controller Busy
   	input [31:0] 			i2c_read_data,  //i2c read data (32 bits) 
   	//outputs
   	output [31:0] 			i2c_write_data, //i2c write datta (32 bits) 
   	output [I2C_CMD_BYTE_WIDTH-1:0] command_byte,
   	output [7:0] 			num_bytes,  	//Number of bytes to be sent. 
   	output reg			i2c_read,       //i2c read ctl 
   	output reg			i2c_write,      //i2c write ctl 
   	output 				i2c_soft_rst    //soft Reset. 
   );

//Parameters

   //ROM Settings 
   localparam ROM_DATA_WIDTH = 108; 	//{CONTROL BIT[11:0], MASK[31:0], DATA[31:0], ADDR[31:0]} 
					//CONTROL BIT
					//[3:0] Number of TRX
					//[4]	special rmw for data
					//[5]	special rmw for addr
					//[6]   Save i2c_read_data to register
					//[7]	cmd # overflow
					//[8]	rmw
					//[9]   read polling
					//[10]  read
					//[11]  write
   localparam ROM_OUTPUT_REG = 0;   
   //Control Bit Location 
   localparam WR_BIT         	= ROM_DATA_WIDTH-1; 
   localparam RD_BIT         	= ROM_DATA_WIDTH-2; 
   localparam RD_POLL_BIT    	= ROM_DATA_WIDTH-3; 
   localparam RMW_BIT        	= ROM_DATA_WIDTH-4; 
   localparam ROM_OVERFLOW     	= ROM_DATA_WIDTH-5;
   localparam SAVE_RD_BIT    	= ROM_DATA_WIDTH-6;
   localparam RMW_ADDR_BIT   	= ROM_DATA_WIDTH-7;
   localparam RMW_DATA_BIT   	= ROM_DATA_WIDTH-8;
   localparam [15:0] I2C_DELAY 	= 16'h01FF;

//Internal Signals 
   //Calibrator fsm
   reg 		sel_reset;
   wire 	rom_fsm_start;
   reg		rom_fsm_next_cmd;
   reg		rom_fsm_done;
   wire		rom_overflow;
   reg [6:0] 	rom_cmd_cnt;
   wire[6:0]	rom_cmd_end;
   wire 	rom_cmd_cnt_load;
   wire 	rom_cmd_cnt_empty;
   wire		rom_cmd_data_ready;
   reg [31:0]	i2c_read_data_register;
   reg [3:0]    cal_next_st,
		cal_current_st;
   reg [7:0]	cal_loop_1_cnt,
		cal_loop_2_cnt;
   wire		cal_loop_1_reset,
		cal_loop_2_reset;
   wire 	cal_loop_1_active,
		cal_check_1_active,
		cal_loop_2_active,
		cal_loop_3_active,
		cal_base_active,
		cal_base_end_active;
  reg        	cal_loop_1_active_reg   = 1'b0,
		cal_loop_2_active_reg   = 1'b0,
		cal_loop_3_active_reg   = 1'b0,
		cal_base_end_active_reg = 1'b0;
   wire		cal_gate_leveling;
   reg [27:0] 	i2c_delay_cnt;
   reg	  	i2c_delay_assert;
   reg [31:0]	target_leveling;
   reg		ca_leveling_track;
   reg 		cal_leveling_latch;    
   //i2c fsm
   reg		rmw_active;
   reg 	  	rd_en;
   wire   	rd_en_t;
   wire	 	rd_en_dummy;
   wire [3:0] 	rom_rd_full;
   reg  [3:0]  	delay_cnt;
   reg 	      	en_delay_cnt;
   reg 	      	wr_rd_pass;
   reg 	      	i2c_wr;
   reg 	      	i2c_rd;
   reg 	      	addr_wr;
   reg 	      	addr_wr_reg;
   wire [31:0] 	masked_rom_data_out;
   wire [31:0] 	masked_i2c_read_data;
   reg  [31:0] 	i2c_write_data_latch;
   reg  [3:0]   rom_sel_reg;
   reg  [3:0]   rom_sel;  
   wire 	cmd_wr;
   wire 	cmd_rd;
   wire		cmd_rmw_addr;
   wire		cmd_rmw_data;
   wire 	cmd_polling_rd;
   wire 	md_wr_rd;
   wire [ROM_DATA_WIDTH-1:0]   
			rom_data_out;
   wire [31:0]  mask_ctl;
   wire [31:0]  data_ctl;
   wire [31:0]  rmw_wdata;
   //soft-cal
   reg  [8:0]	soft_lvl_cnt;
   wire [8:0]   soft_lvl_number;
   wire [8:0]	soft_wr_number;
   wire [8:0]	soft_rd_number;
   reg  [2:0]	soft_slice_cnt;
   reg  [31:0]	soft_slice_addr;
   reg  [31:0]	soft_slice_data;
   wire		main_sel_reset;
   wire [1:0]	rom_sel_reset;
   wire		soft_delay_assert;
   reg  [15:0]	soft_delay;
   reg		cal_gate_leveling_last;
   wire		cal_gate_save;
   wire		cal_gate_AND_zeroes;
   wire		cal_gate_AND_match;
   reg		soft_cal_frst_reg;
   wire		soft_cal_frst;
   reg 		rd_page_sw;
   reg  [8:0] 	rd_first_value;
   wire 	rd_first_delay;
   reg  [1:0] 	rd_first_delay_capture;
   reg  [31:0] 	rd_address_mask;
   reg  [31:0] 	rd_mask;
   wire		rd_page_rst;
   reg		rd_ready;	
   wire		rd_ori_save;
   reg [63:0]	rd_ori_value;

////////////////////////////////////////////////////
//CAL FSM
////////////////////////////////////////////////////
    localparam [3:0] 
		CAL_IDLE		= 4'b0000,
		CAL_START               = 4'b0001,
		CAL_FIRST_READ		= 4'b0010,
		CAL_LOAD_CNT		= 4'b0011,
		CAL_EXE_BASE		= 4'b0100,
		CAL_CHECK_LOOP_1	= 4'b0101,
		CAL_EXE_LOOP_1		= 4'b0110,
		CAL_EXE_LOOP_2		= 4'b0111,
		CAL_PRE_CHECK_LOOP_2	= 4'b1000,
		CAL_CHECK_LOOP_2	= 4'b1001,
		CAL_SOFT_CHECK_LOOP_2	= 4'b1010,
		CAL_EXE_LOOP_3		= 4'b1011,
		CAL_EXE_BASE_END	= 4'b1100,
		CAL_SOFT_SWITCH_PAGE	= 4'b1101,
		CAL_SOFT_SLICE_RESTART	= 4'b1110,
		CAL_DONE		= 4'b1111;


////////////////////////////////////////////////////
//I2C FSM
////////////////////////////////////////////////////
   //== State enumeration
   localparam [4:0] // synopsys enum state_info
		ST_IDLE			= 5'b00000,
		ST_START                = 5'b00001,
		ST_CAL_MODE		= 5'b00010,
		ST_RD0_ROM		= 5'b00011,
		ST_RD1_ROM		= 5'b00100,
		ST_RD2_ROM		= 5'b00101,
		ST_RD3_ROM		= 5'b00110,
		ST_G_WR			= 5'b00111,
		ST_G_WR_CHK_BUSY	= 5'b01000,
		ST_G_WR_CHK_DONE	= 5'b01001,
		ST_G_RD			= 5'b01010,
		ST_G_RD_CHK_BUSY	= 5'b01011,
		ST_G_RD_CHK_DONE	= 5'b01100,
		ST_G_RD_POLL		= 5'b01101,
		ST_G_RD_POLL_CHK_BUSY	= 5'b01110,
		ST_G_RD_POLL_CHK_DONE	= 5'b01111,
		ST_G_RD_POLL_COMPARE    = 5'b10000,
		ST_G_WR1                = 5'b10001,
		ST_G_WR1_CHK_BUSY       = 5'b10010,
		ST_G_WR1_CHK_DONE       = 5'b10011,
		ST_G_RD1                = 5'b10100,
		ST_G_RD1_CHK_BUSY       = 5'b10101,
		ST_G_RD1_CHK_DONE       = 5'b10110,
   		ST_G_RMW                = 5'b10111,
                ST_G_RMW_CHK_BUSY       = 5'b11000,
                ST_G_RMW_CHK_DONE       = 5'b11001,
                ST_G_RMW_W              = 5'b11010,
                ST_G_RMW_W_CHK_BUSY     = 5'b11011,
                ST_G_RMW_W_CHK_DONE     = 5'b11100,
		ST_DONE                 = 5'b11111;
   
   //== State variables
   reg [4:0]  /* synopsys enum state_info */
	      current_st;		/* synopsys state_vector current_st */
   reg [4:0]  /* synopsys enum state_info */
	      next_st;

   assign cmd_wr 	 = rom_data_out[WR_BIT];
   assign cmd_rd 	 = rom_data_out[RD_BIT];
   assign cmd_polling_rd = rom_data_out[RD_POLL_BIT];
   assign cmd_wr_rd 	 = 1'b0;
   assign cmd_save_rd 	 = rom_data_out[SAVE_RD_BIT];
   assign cmd_rmw 	 = rom_data_out[RMW_BIT];
   assign cmd_rmw_addr 	 = rom_data_out[RMW_ADDR_BIT];
   assign cmd_rmw_data 	 = rom_data_out[RMW_DATA_BIT];
   assign rom_overflow 	 = rom_data_out[ROM_OVERFLOW];

   //32-bits data masking bits 
   assign masked_rom_data_out[31:0] = rom_data_out[ (2*32-1) : ((2-1)*32)] 	//Expected Data (2nd) 
					& rom_data_out[(3*32-1): ((3-1)*32)];	//Mask Bit (3rd) 
   
   assign masked_i2c_read_data[31:0] = i2c_read_data[31:0] & mask_ctl;
					//& rom_data_out[ (3*32-1): ((3-1)*32)];

   //assign i2c_write_data = (addr_wr_reg) ? rom_data_out[ (2*32-1) : ((2-1)*32)] : 
   //			rom_data_out[ (1*32-1) : ((1-1)*32)] ;
   assign i2c_write_data = (addr_wr_reg) ? ( (rmw_active) ? rmw_wdata : data_ctl )
                                         : cmd_rmw_addr ? ((rom_data_out[ (1*32-1) : ((1-1)*32)] | soft_slice_addr) & rd_address_mask): rom_data_out[ (1*32-1) : ((1-1)*32)] ;
   assign rmw_wdata = cmd_rmw_data ? masked_i2c_read_data | ((data_ctl | soft_slice_data) & ~mask_ctl) :  masked_i2c_read_data | (data_ctl & ~mask_ctl);
  
   assign mask_ctl = cmd_rmw_data? (rom_data_out[(3*32-1): ((3-1)*32)] ^ rd_mask) : rom_data_out[(3*32-1): ((3-1)*32)];
   assign data_ctl = rom_data_out[(2*32-1): ((2-1)*32)];

   ///////////////////////////////////////////
   //Command Byte Decoding for I2C2APB
   //addr type - 0x01 when addr_wr_reg = 0
   //data type - 0x00 when addr_wr_reg = 1
   ///////////////////////////////////////////
   assign  command_byte = (~addr_wr_reg) ? 8'h01 : 8'h00;

//////////////////
//Calibrator Logic
//////////////////

assign rom_cmd_cnt_load 	= (cal_current_st == CAL_LOAD_CNT);
assign rom_fsm_start		= (cal_current_st == CAL_START); 
assign rom_cmd_end 		= rom_data_out[ROM_DATA_WIDTH-9:ROM_DATA_WIDTH-12];
assign rom_cmd_data_ready 	= delay_cnt[2];
assign cal_gate_AND_zeroes	= ((i2c_read_data_register & target_leveling) == 0);
assign cal_gate_AND_match	= ((i2c_read_data_register & target_leveling) == target_leveling);
assign cal_gate_leveling	= rd_page_sw ? 
				  (cal_type[0] && cal_mode[2]? cal_gate_AND_match  : cal_gate_AND_zeroes) :
				  (cal_type[0] && cal_mode[2]? cal_gate_AND_zeroes : cal_gate_AND_match) ;

assign cal_loop_1_reset		= cal_mode[3]? 1'b0 : (cal_current_st == CAL_EXE_LOOP_1);
assign cal_loop_2_reset		= (cal_current_st == CAL_EXE_LOOP_3);
assign main_sel_reset		= (cal_current_st == CAL_SOFT_SLICE_RESTART) | soft_cal_frst;


assign cal_status_reg2 = i2c_read_data_register[15:8];

always@(posedge clk)
begin
	if(cal_type[1]) begin 	//soft
		case(cal_mode)
		4'b0001: target_leveling <= 32'h0001_0000;
		4'b0010: target_leveling <= 32'h0000_0010;
		4'b0100: target_leveling <= rd_page_sw ? 32'h0000_5500:32'h0000_aa00;
		default: target_leveling <= 32'hFFFF_FFFF;
		endcase
	end
	else begin		//phy
		case(cal_mode)
		4'b0001: target_leveling <= 32'h0000_0004;
		4'b0100: target_leveling <= 32'h0000_0002;
		4'b1000: target_leveling <= 32'h0000_0008;
		default: target_leveling <= 32'hFFFF_FFFF;
		endcase
	end
end


always @(posedge clk)
begin
	if(~rst_n || restart || main_sel_reset)
		rom_cmd_cnt <= 7'h0;
	else begin
		if(rom_cmd_cnt_load)
			rom_cmd_cnt <= {2'h0, rom_overflow, rom_cmd_end[3:0]} - 1'b1;
		else if (rom_fsm_next_cmd && !rom_cmd_cnt_empty)
			rom_cmd_cnt <= rom_cmd_cnt - 1'b1;
		else
			rom_cmd_cnt <= rom_cmd_cnt;
	end
end

assign rom_cmd_cnt_empty = (rom_cmd_cnt == 7'h0);

always @(posedge clk)
begin	
	if(~rst_n || restart || main_sel_reset)
		cal_loop_1_cnt <= 8'h0;
	else begin
		if (cal_loop_1_reset)
			cal_loop_1_cnt <= 8'h0;
		else if(cal_check_1_active)
			cal_loop_1_cnt <= cal_loop_1_cnt + 1'b1;	
		else
			cal_loop_1_cnt <= cal_loop_1_cnt;
	end
end 

assign cal_check_1_active = (cal_current_st == CAL_CHECK_LOOP_1);
assign cal_loop_1_active = (cal_current_st == CAL_EXE_LOOP_1);

always @(posedge clk)
begin
	if(~rst_n)
		cal_loop_1_active_reg <= 1'b0;
	else begin
		if (rom_cmd_cnt_empty && rom_fsm_done)
			cal_loop_1_active_reg <= 1'b0;
		else if(cal_loop_1_active)
			cal_loop_1_active_reg <= 1'b1;
		else
			cal_loop_1_active_reg <= cal_loop_1_active_reg;
	end
end

always @(posedge clk)
begin	
	if(~rst_n || restart || main_sel_reset || rd_page_rst)
		cal_loop_2_cnt <= 8'h0;
	else begin
		if (cal_loop_2_reset)
			cal_loop_2_cnt <= 8'h0;
		else if(cal_loop_2_active && rom_fsm_done)
			cal_loop_2_cnt <= cal_loop_2_cnt + 1'b1;
		else
			cal_loop_2_cnt <= cal_loop_2_cnt;
	end
end 

assign cal_loop_2_active = (cal_current_st == CAL_EXE_LOOP_2);

always @(posedge clk)
begin
	if (~rst_n)
		cal_loop_2_active_reg <= 1'b0;
	else begin
		if (rom_cmd_cnt_empty && rom_fsm_done)
			cal_loop_2_active_reg <= 1'b0;
		else if(cal_loop_2_active)
			cal_loop_2_active_reg <= 1'b1;
		else
			cal_loop_2_active_reg <= cal_loop_2_active_reg;
	end
end

assign cal_loop_3_active = (cal_current_st == CAL_EXE_LOOP_3);

always @(posedge clk)
begin
	if (~rst_n)
		cal_loop_3_active_reg <= 1'b0;
	else begin
		if (rom_cmd_cnt_empty && rom_fsm_done)
	  		cal_loop_3_active_reg <= 1'b0;
		else if(cal_loop_3_active)
			cal_loop_3_active_reg <= 1'b1;
		else
			cal_loop_3_active_reg <= cal_loop_3_active_reg;
	end
end

assign cal_base_active	   = (cal_current_st == CAL_EXE_BASE);
assign cal_base_end_active = (cal_current_st == CAL_EXE_BASE_END);

always @(posedge clk)
begin
	if (~rst_n)
		cal_base_end_active_reg <= 1'b0;
	else begin
		if (rom_cmd_cnt_empty && rom_fsm_done)
			cal_base_end_active_reg <= 1'b0;
		else if(cal_base_end_active)
			cal_base_end_active_reg <= 1'b1;
		else
			cal_base_end_active_reg <= cal_base_end_active_reg;
	end
end

always @(posedge clk)
begin
	if(~rst_n || rd_page_rst || main_sel_reset || restart)
		i2c_read_data_register <= 32'h0;
	else
	begin
		if(cmd_save_rd && rom_fsm_done)
			i2c_read_data_register <= i2c_read_data;
		else
			i2c_read_data_register <= i2c_read_data_register;
	end
end

always @(posedge clk)
begin
	if (cal_mode[2] && cal_base_active && cmd_save_rd)
		rd_ready <= i2c_busy;
	else
		rd_ready <= 1'b0;
end

assign rd_ori_save = ~i2c_busy & rd_ready;


always @(posedge clk)
begin
	if(rd_ori_save)
		rd_ori_value <= {rd_ori_value[31:0], (i2c_read_data & ~mask_ctl)};
	else
		rd_ori_value <= rd_ori_value;
end


always @(posedge clk)
begin
	if(~rst_n)
		cal_status_reg <= 'h0;
	else begin
	cal_status_reg <= {cal_gate_leveling_last, cal_leveling_latch, cal_base_end_active_reg, cal_loop_3_active_reg, cal_loop_2_active_reg, cal_loop_1_active_reg, cal_base_active };
	end
end

always @(posedge clk)
begin
	if(~rst_n)
		cal_leveling_latch <= 'h0;
	else begin
		if (cal_gate_leveling)
			cal_leveling_latch <= 1'b1;
		else if (!cal_gate_leveling)
			cal_leveling_latch <= 1'b0;
		else
			cal_leveling_latch <= cal_leveling_latch;
	end
end

assign cal_base_active = (cal_current_st == CAL_EXE_BASE);

always @(posedge clk)
begin
	if(~rst_n)
		ca_leveling_track <= 1'b0;
	else
	begin
		if(cal_done)
			ca_leveling_track <= 1'b0;
		else if(rom_fsm_done && cal_loop_1_active)
			ca_leveling_track <= 1'b1;
		else
			ca_leveling_track <= ca_leveling_track;
	end
end

//////////////////
//Soft Leveling
//////////////////
wire delay_fine_max;
wire delay_course_reg;
wire delay_course_max;
reg  [3:0] delay_course_value;
wire [3:0] soft_course_number;
wire	   soft_lvl_max;

assign delay_fine_max   = cal_mode[0]? soft_lvl_cnt[7] : 'b0;
assign delay_course_reg = cal_mode[0]? (rom_data_out[31:0] == 'h02) : 'b0;
assign soft_lvl_max = (soft_lvl_cnt == 'hF8);

always @(posedge clk)
begin
	if(~rst_n || restart || main_sel_reset || rd_page_rst || delay_fine_max)
		soft_lvl_cnt <= 'h0;
	else 
	begin
		if(cal_type[1]) begin
			if(cal_gate_save )
				soft_lvl_cnt <= soft_lvl_cnt + 'h8;
			else
				soft_lvl_cnt <= soft_lvl_cnt;
		end
		else 
			soft_lvl_cnt <= 'h0;
	end
end

assign delay_course_max = (delay_course_value == 'h06);

always @(posedge clk)
begin
	if(~rst_n || restart || main_sel_reset || rd_page_rst || delay_course_max)
		//course delay start value
		delay_course_value <= 'h1;
	else begin
		if(delay_fine_max)
			delay_course_value <= delay_course_value + 1'b1;
		else
			delay_course_value <= delay_course_value;
	end
end

always @(posedge clk)
begin
	if(~rst_n || restart)
		soft_slice_cnt <= 'h0;
	else
	begin
		if(cal_type[1]) begin
			case(cal_mode)
			4'b0100:
			begin
			if(cal_done)
				soft_slice_cnt <= 'h0;
			else if(cal_base_end_active && rom_fsm_done && rd_page_sw)
				soft_slice_cnt <= soft_slice_cnt + 1'b1;
			else
				soft_slice_cnt <= soft_slice_cnt;
			end
			default:
			begin
			if(cal_done)
				soft_slice_cnt <= 'h0;
			else if(cal_base_end_active && rom_fsm_done)
				soft_slice_cnt <= soft_slice_cnt + 1'b1;
			else
				soft_slice_cnt <= soft_slice_cnt;
			end
			endcase
		end
		else
			soft_slice_cnt <= 'h0;
	end
end


always @(posedge clk)
begin
	if(cal_type[1]) begin
		soft_slice_addr <= {26'h0,soft_slice_cnt,4'h0};
	end
	else begin
		soft_slice_addr <= 'h0;
	end
end

assign soft_lvl_number    = (soft_lvl_cnt > 64)? soft_lvl_cnt - 64 : 'h0;
assign soft_course_number = (soft_lvl_cnt < 64)? (delay_course_value == 'h0)? 'h0 : delay_course_value - 1 : delay_course_value;
assign soft_wr_number = soft_lvl_cnt + 'h40;
assign soft_rd_number = soft_lvl_cnt + rd_first_value;

always @(posedge clk)
begin
	case(cal_mode)
	4'b0001:
	begin
		if(cal_type[1]) begin
			if(cal_base_end_active)
				soft_slice_data <= delay_course_reg ? {2'h0, soft_course_number[0], 26'h0, soft_course_number[3:1]} : {soft_lvl_number[7:0], 24'h0};
			else
				soft_slice_data <= delay_course_reg ? {2'h0, delay_course_value[0], 26'h0, delay_course_value[3:1]} : {soft_lvl_cnt, 24'h0};
		end
		else begin
			soft_slice_data <= 'h0;
		end
	end
	4'b0010:
	begin
		soft_slice_data <= {8'h0, soft_lvl_cnt[7:0], soft_wr_number[7:0] , 8'h0};   
	end
	4'b0100:
	begin
		if(cal_loop_2_active && !rd_page_sw)
			soft_slice_data <= {24'h0, soft_lvl_cnt[7:0]};
		else if (cal_base_end_active && !rd_page_sw)
			soft_slice_data <= soft_lvl_max? {24'h0, rd_ori_value[39:32]}        : {24'h0, soft_rd_number[8:1]};
		else if (cal_base_end_active && rd_page_sw)
			soft_slice_data <= soft_lvl_max? { 8'h0, rd_ori_value[23:16], 16'h0} : {8'h0, soft_rd_number[8:1], 16'h0};
		else
			soft_slice_data <= {8'h0, soft_lvl_cnt[7:0], 16'h0};
	end	

	default:
		soft_slice_data <= 'h0;
	endcase
end
assign soft_delay_assert = (cal_current_st == CAL_SOFT_SLICE_RESTART);

always @(posedge clk)
begin
	if(~rst_n)
		soft_delay <= 'h0;
	else begin
		if(soft_delay_assert)
			soft_delay <= soft_delay + 1'b1;
		else
			soft_delay <= 'h0;
	end
end

assign cal_gate_save = (cal_current_st == CAL_SOFT_CHECK_LOOP_2);

always @(posedge clk)
begin
	if(~rst_n)
		cal_gate_leveling_last <= 1'b1;
	else begin
		case(cal_mode)
		4'b0100:
		begin
			if (restart || main_sel_reset || rd_page_rst)
				cal_gate_leveling_last <= 1'b0;
			else if (cal_gate_save)
				cal_gate_leveling_last <= cal_gate_leveling;
			else
				cal_gate_leveling_last <= cal_gate_leveling_last;
		end
		default:
		begin		
			if (main_sel_reset)
				cal_gate_leveling_last <= 1'b1;

			else if(cal_gate_save)
				cal_gate_leveling_last <= cal_gate_leveling;
			else
				cal_gate_leveling_last <= cal_gate_leveling_last;
		end
		endcase
	end
end

always @(posedge clk)
begin
	soft_cal_frst_reg <= enable_cal;
end

assign soft_cal_frst = ~soft_cal_frst_reg & enable_cal;

//////////////////
//Soft Read Leveling
//////////////////

assign rd_page_rst = (cal_current_st == CAL_SOFT_SWITCH_PAGE);

always@(posedge clk)
begin
	if(!rst_n || restart || main_sel_reset)
		rd_page_sw <= 1'b0;
	else begin
		if(cal_base_end_active && rom_fsm_done)
			rd_page_sw <= ~rd_page_sw;
		else
			rd_page_sw <= rd_page_sw;
	end
end

always@ (posedge clk)
begin
	if(!rst_n || restart || main_sel_reset || rd_page_rst)
	begin
		rd_first_delay_capture[1] <= 1'b0;
		rd_first_delay_capture[0] <= 1'b0;
	end
	else begin
		if(cal_gate_save && cal_gate_leveling) begin
			rd_first_delay_capture[1] <= 1'b1;
			rd_first_delay_capture[0] <= rd_first_delay_capture[1];
		end
		else begin
			rd_first_delay_capture[1] <= rd_first_delay_capture[1];
			rd_first_delay_capture[0] <= rd_first_delay_capture[1];
		end
	end
end

assign rd_first_delay = rd_first_delay_capture[1] & ~rd_first_delay_capture[0];

always@ (posedge clk)
begin
	if(rd_first_delay)
		rd_first_value <= soft_lvl_cnt;
	else
		rd_first_value <= rd_first_value;
end	

always@(posedge clk)
begin
	case(cal_mode)
	4'b0100:
	begin
		if (rd_page_sw && cmd_rmw_addr && !rom_data_out[3] && cal_loop_2_active)
			rd_address_mask <= 32'hFFFF_FFF0;
		else
			rd_address_mask <= 32'hFFFF_FFFF;
	end
	default:
	begin
		rd_address_mask <= 32'hFFFF_FFFF;
	end
	endcase
end

always@(posedge clk)
begin
	case(cal_mode)
	4'b0100:
	begin
		if (rd_page_sw && cmd_rmw_addr && !rom_data_out[3] && cal_loop_2_active)
			rd_mask <= 32'h00FF_00FF;
		else
			rd_mask <= 32'h0000_0000;
	end
	default:
	begin
		rd_mask <= 32'h0000_0000;
	end
	endcase
end


//////////////////
//Calibrator FSM
//////////////////

always @(posedge clk)
begin 
	if (~rst_n)
		cal_current_st <= CAL_IDLE;
	else
		cal_current_st <= cal_next_st;
end

always @(*)
begin
	cal_next_st = cal_current_st;
	
	case(cal_current_st)
	CAL_IDLE://0
	begin
		if(enable_cal)
			cal_next_st = CAL_START;
		else
			cal_next_st = CAL_IDLE;
	end
	CAL_START://1
			cal_next_st = CAL_FIRST_READ;
	CAL_FIRST_READ://2
	begin
		if(rom_cmd_data_ready)
			cal_next_st = CAL_LOAD_CNT;
		else
			cal_next_st = CAL_FIRST_READ;
	end
 	CAL_LOAD_CNT://3
	begin
		if(cal_loop_1_active_reg)
			cal_next_st = CAL_EXE_LOOP_1;
		else if(cal_loop_2_active_reg)
			cal_next_st = CAL_EXE_LOOP_2;
		else if(cal_loop_3_active_reg)
			cal_next_st = CAL_EXE_LOOP_3;
		else if(cal_base_end_active_reg)
			cal_next_st = CAL_EXE_BASE_END;
		else
			cal_next_st = CAL_EXE_BASE;
	end
	CAL_EXE_BASE://4
	begin	
	//force to enter CAL_EXE_LOOP_2 for DDR3 GL test
	//unless it is soft-cal
		case(cal_type[1])
		1'b0:
		begin
			if(rom_fsm_done && cal_mode[1])
				cal_next_st = CAL_DONE;
			else if(rom_fsm_done && !cal_mode[1]) 
				cal_next_st = CAL_EXE_LOOP_2;
			else
				cal_next_st = CAL_EXE_BASE;
		end
		1'b1:
		begin
			if(rom_fsm_done && cal_mode[0])
				cal_next_st = CAL_EXE_LOOP_1;
			else if(rom_fsm_done && (cal_mode[1] || cal_mode[2]))
				cal_next_st = CAL_EXE_LOOP_2;
			else
				cal_next_st = CAL_EXE_BASE;
		end
		default:
		begin
			if(rom_fsm_done && cal_mode[1])
				cal_next_st = CAL_DONE;
			else if(rom_fsm_done && !cal_mode[1]) 
				cal_next_st = CAL_EXE_LOOP_2;
			else
				cal_next_st = CAL_EXE_BASE;
		end
		endcase
	end
	CAL_CHECK_LOOP_1://5
	begin
		if (!cal_gate_leveling)
			cal_next_st = CAL_EXE_BASE_END;
		//enter this loop when j = 4 (cnt -1 = 3)
		else if (cal_gate_leveling && cal_loop_1_cnt == 3) 
			cal_next_st = CAL_EXE_LOOP_1;
		else
			cal_next_st = CAL_EXE_LOOP_2;
	end
	CAL_EXE_LOOP_1://6
	begin
		if (rom_cmd_cnt_empty && !cal_loop_1_active_reg)
			cal_next_st = CAL_START;
		else if(rom_fsm_done)
			cal_next_st = CAL_EXE_LOOP_2;
		else
			cal_next_st = CAL_EXE_LOOP_1;
	end	
	CAL_EXE_LOOP_2://7
	begin
		if (rom_cmd_cnt_empty && !cal_loop_2_active_reg)
			cal_next_st = CAL_START;
		else if(rom_fsm_done)
			cal_next_st = CAL_PRE_CHECK_LOOP_2;
		else
			cal_next_st = CAL_EXE_LOOP_2;
	end
	CAL_PRE_CHECK_LOOP_2:
		cal_next_st = CAL_CHECK_LOOP_2;
	CAL_CHECK_LOOP_2://8
	begin
		case(cal_type)
		2'b00:
		begin
			case(cal_mode)
			4'b1000:
			begin
				if(!cal_gate_leveling && ca_leveling_track)
					cal_next_st = CAL_EXE_BASE_END;
				else if(!cal_gate_leveling && !ca_leveling_track)
					cal_next_st = CAL_EXE_LOOP_1;
				else 
					cal_next_st = CAL_EXE_LOOP_2;
			end
			default:
			begin		
				if(!cal_gate_leveling)
					cal_next_st = CAL_EXE_BASE_END;
				else if(cal_loop_2_cnt == 8) 
					cal_next_st = CAL_EXE_LOOP_3;
				else
					cal_next_st =  CAL_EXE_LOOP_2;
			end
			endcase
		end
		default:
		begin
			case(cal_mode)
			4'b0100:
			begin
			if((!cal_gate_leveling && cal_gate_leveling_last) || soft_lvl_max)
				cal_next_st = CAL_EXE_BASE_END;
			else
				cal_next_st = CAL_SOFT_CHECK_LOOP_2;
			end
			default:
			begin
			if(cal_gate_leveling && !cal_gate_leveling_last)
				cal_next_st = CAL_EXE_BASE_END;
			else
				cal_next_st = CAL_SOFT_CHECK_LOOP_2;
			end
			endcase
		end 
		endcase	
	end
	CAL_SOFT_CHECK_LOOP_2:
	begin
		case(cal_mode)
		4'b0010:
		begin
			cal_next_st = CAL_EXE_LOOP_2;
		end
		default:
		begin
			if(cal_loop_2_cnt == 'd4)
				cal_next_st = CAL_EXE_LOOP_3;
			else
				cal_next_st = CAL_EXE_LOOP_2;
		end
		endcase
	end
	CAL_EXE_LOOP_3://9
	begin
		if (rom_cmd_cnt_empty && !cal_loop_3_active_reg)
			cal_next_st = CAL_START;
		else if(rom_fsm_done && !cal_type[1])
			cal_next_st = CAL_PRE_CHECK_LOOP_2;
		else if(rom_fsm_done && cal_type[1])
			cal_next_st = CAL_EXE_LOOP_2;
		else
			cal_next_st = CAL_EXE_LOOP_3;
	end
	CAL_EXE_BASE_END://10
	begin
		if (rom_cmd_cnt_empty && !cal_base_end_active_reg)
			cal_next_st = CAL_START;
		else if(rom_fsm_done && !cal_type[1])
			cal_next_st = CAL_DONE;
		else if(rom_fsm_done && cal_type[1])
			case(cal_mode[2])
			1'b1:
				cal_next_st = CAL_SOFT_SWITCH_PAGE;
			default:
				cal_next_st = CAL_SOFT_SLICE_RESTART;
			endcase
		else
			cal_next_st = CAL_EXE_BASE_END;
	end
	CAL_SOFT_SWITCH_PAGE:
	begin
		if(rd_page_sw)
			cal_next_st = CAL_EXE_LOOP_2;
		else
			cal_next_st = CAL_SOFT_SLICE_RESTART;
	end
	CAL_SOFT_SLICE_RESTART://11- only applicable for soft reset
	begin
		if(soft_delay == 'h1FF) begin
			if(soft_slice_cnt < cal_slice && cal_mode[0])
				cal_next_st = CAL_EXE_LOOP_1;
			else if(soft_slice_cnt < cal_slice && (cal_mode[1] || cal_mode[2]))
				cal_next_st = CAL_EXE_LOOP_2;
			else
				cal_next_st = CAL_DONE;
		end 
		else begin
			cal_next_st = CAL_SOFT_SLICE_RESTART;
		end
		
	end
	CAL_DONE://15
	begin
		if(restart)
			cal_next_st = CAL_IDLE;
		else
			cal_next_st = CAL_DONE;
	end
	default:
			cal_next_st = CAL_IDLE;
	endcase
end	
		
   

//////////////////
//i2c FSM
//////////////////

   always @(posedge clk)
     if (~rst_n)
       current_st <= ST_IDLE;
     else
       current_st <= next_st;

   always @(*)
     begin
	//defaults 
	next_st 	 = current_st;
	rd_en 		 = 1'b0;
	en_delay_cnt 	 = 1'b0;
	i2c_wr 		 = 1'b0;
	i2c_rd 		 = 1'b0;
	rom_sel 	 = 4'b0000;
	wr_rd_pass 	 = 1'b0;
	addr_wr 	 = 1'b0;
	rom_fsm_next_cmd = 1'b0;
 	rom_fsm_done 	 = 1'b0;	
	sel_reset	 = 1'b0;
	i2c_delay_assert = 1'b0;
	rmw_active 	 = 1'b0;
	
	case (current_st)
	  ST_IDLE :
	    begin
	       if (rom_fsm_start)
		 next_st = ST_START;
	    end

	  ST_START :
	    begin
		sel_reset = 1'b1;
		if(cal_loop_2_active_reg)
		begin
			next_st = ST_RD2_ROM;
			rom_sel = 4'b0010;
		end
		else if(cal_loop_1_active_reg)
		begin
			next_st = ST_RD2_ROM;
			rom_sel = 4'b0100;
		end
		else if(cal_loop_3_active_reg)
		begin
			next_st = ST_RD2_ROM;
			rom_sel = 4'b1000;
		end else
		begin
			next_st = ST_RD2_ROM;
			rom_sel = 4'b0001;
		end
	    end
	  
	  ST_CAL_MODE :
	    begin
		rom_fsm_next_cmd = 1'b1;
		if(!rom_cmd_cnt_empty && !cal_loop_1_active_reg 
				&& cal_loop_2_active_reg && !cal_loop_3_active_reg)
		begin
			next_st  = ST_RD0_ROM;
			rom_sel  = 4'b0010;
		end	 
		else if(!rom_cmd_cnt_empty && cal_loop_1_active_reg 
				&& !cal_loop_2_active_reg && !cal_loop_3_active_reg) 
		begin
			next_st  = ST_RD0_ROM;
			rom_sel  = 4'b0100;
		end	 
		else if(!rom_cmd_cnt_empty && !cal_loop_1_active_reg
				&& !cal_loop_2_active_reg && cal_loop_3_active_reg) 
		begin
			next_st  = ST_RD0_ROM;
			rom_sel  = 4'b1000;
		end	 
		else if(!rom_cmd_cnt_empty && !cal_loop_1_active_reg
				&& !cal_loop_2_active_reg && !cal_loop_3_active_reg) 
		begin
			next_st  = ST_RD0_ROM;
			rom_sel  = 4'b0001;
		end	 
		else
		begin
			next_st = ST_DONE;
			rom_sel = 4'b0000;
		end 
	    end // case: ST_CAL_MODE
		
	  ST_RD0_ROM:
	    begin
	       next_st = ST_RD1_ROM;
	    end

	  ST_RD1_ROM : //Read Data
	    begin
	       rd_en = 1'b1;
	       next_st = ST_RD2_ROM;	       
	    end
	  
	  ST_RD2_ROM : //Wait Data Ready
	    begin
	       en_delay_cnt = 1'b1;
	       if (delay_cnt == 4'h3) 
		 begin
		    next_st = ST_RD3_ROM;
		 end
	    end
	  
	  ST_RD3_ROM : //Check the bit for read/write condition to executive the commands. 
	    begin

	       if (cmd_wr)   			//WRITE DATA
		 next_st = ST_G_WR;
	       else if (cmd_rd)   		//READ DATA
		 next_st = ST_G_RD;
	       else if (cmd_polling_rd) 	//POLLILNG READ
		 next_st = ST_G_RD_POLL;
	       else if (cmd_wr_rd)   		//WRITE AND READ DATA. 
		 next_st = ST_G_WR1;
 	       else if (cmd_rmw)           	//RMW
                 next_st = ST_G_RMW;
	       else
		 next_st = ST_CAL_MODE;
	       
	    end // case: ST_RD3_ROM
	  

	  ////////////////////////////////////
	  // Generic - Write Command
	  ////////////////////////////////////
	  ST_G_WR :
	    begin
	       i2c_wr = 1'b1;
	       next_st = ST_G_WR_CHK_BUSY;
	    end

	  ST_G_WR_CHK_BUSY:
	    begin
	       if (i2c_busy)
		 next_st = ST_G_WR_CHK_DONE;
	    end

	  ST_G_WR_CHK_DONE:
	    begin
	       if (~i2c_busy & addr_wr_reg)       //Transtion to ST_RD3_ROM after complete write write. 
		 begin 
	    	 	if (i2c_delay_cnt == I2C_DELAY)
		 	begin
		    		next_st = ST_CAL_MODE;
		    		addr_wr = 1'b1;
			end
			else begin
				next_st = ST_G_WR_CHK_DONE; 
				i2c_delay_assert = 1'b1;
			end
		 end
	       
	       else if (~i2c_busy & ~addr_wr_reg) //Move to ST_G_WR to write data after complete write address. 
		 begin 
	    	 	//if (i2c_delay_cnt == I2C_DELAY)
		 	//begin
		    		next_st = ST_G_WR;
		    		addr_wr = 1'b1;
			//end
			//else begin
			//	next_st = ST_G_WR_CHK_DONE; 
			//	i2c_delay_assert = 1'b1;
			//end
		 end

	    end

	  //////////////////////////////////////
	  //Generic : Read Command
	  //////////////////////////////////////
	  ST_G_RD :
	    begin
	       i2c_rd = 1'b1;
	       next_st = ST_G_RD_CHK_BUSY;
	    end

	  ST_G_RD_CHK_BUSY:
	    begin
	       if (i2c_busy)
		 next_st = ST_G_RD_CHK_DONE;
	    end

	  ST_G_RD_CHK_DONE:
	    begin
	       if (~i2c_busy)
	    	 	if (i2c_delay_cnt == I2C_DELAY)
		 	begin
		    		next_st = ST_CAL_MODE;
			end
			else begin
				next_st = ST_G_RD_CHK_DONE; 
				i2c_delay_assert = 1'b1;
			end
	    end
	  
	  //////////////////////////////////////
	  //Generic : Read Polling
	  //////////////////////////////////////
	  ST_G_RD_POLL :
	    begin
	       i2c_rd = 1'b1;
	       next_st = ST_G_RD_POLL_CHK_BUSY;
	    end

	  ST_G_RD_POLL_CHK_BUSY:
	    begin
	       if (i2c_busy)
		 next_st = ST_G_RD_POLL_CHK_DONE;
	    end

	  ST_G_RD_POLL_CHK_DONE:
	    begin
	       if (~i2c_busy)
		 next_st = ST_G_RD_POLL_COMPARE;
	    end

	  ST_G_RD_POLL_COMPARE:
	    begin
	       if (masked_i2c_read_data == masked_rom_data_out) //Fix-ME
	    	 	if (i2c_delay_cnt == I2C_DELAY)
		 	begin
		    		next_st = ST_CAL_MODE;
			end
			else begin
				next_st = ST_G_RD_POLL_COMPARE; 
				i2c_delay_assert = 1'b1;
			end
	       else
	    	 	if (i2c_delay_cnt == I2C_DELAY)
		 	begin
		 	      next_st = ST_G_RD_POLL; //Continue Polling Read. 	       
			end
			else begin
				next_st = ST_G_RD_POLL_COMPARE; 
				i2c_delay_assert = 1'b1;
			end

	    end
	  

	  //////////////////////////////////////
	  //Write Leveling : Write & Read. 
	  //////////////////////////////////////
	  ST_G_WR1 :
	    begin
	       i2c_wr = 1'b1;
	       next_st = ST_G_WR1_CHK_BUSY;
	    end

	  ST_G_WR1_CHK_BUSY:
	    begin
	       if (i2c_busy)
		 next_st = ST_G_WR1_CHK_DONE;
	    end

	  ST_G_WR1_CHK_DONE:
	    begin
	       if (~i2c_busy)
		 next_st = ST_G_RD1;
	    end


	  ST_G_RD1 :
	    begin
	       i2c_rd = 1'b1;
	       next_st = ST_G_RD1_CHK_BUSY;
	    end

	  ST_G_RD1_CHK_BUSY:
	    begin
	       if (i2c_busy)
		 next_st = ST_G_RD1_CHK_DONE;
	    end

	  ST_G_RD1_CHK_DONE:
	    begin
	       if (~i2c_busy)
		 begin 
	    	 	if (i2c_delay_cnt == I2C_DELAY)
		 	begin
		    		next_st = ST_CAL_MODE;
		    		wr_rd_pass = (masked_i2c_read_data == masked_rom_data_out); //FIX ME
			end
			else begin
				next_st = ST_G_RD1_CHK_DONE; 
				i2c_delay_assert = 1'b1;
			end
		 end
	       
	    end
 	//////////////////////////////////////
 	//Generic : Read and Write Command 
 	/////////////////////////////////////
  	  ST_G_RMW :
            begin
               i2c_rd = 1'b1;
               next_st = ST_G_RMW_CHK_BUSY;
            end

          ST_G_RMW_CHK_BUSY:
            begin
               if (i2c_busy)
                 next_st = ST_G_RMW_CHK_DONE;
            end

          ST_G_RMW_CHK_DONE:
            begin
               if (~i2c_busy) begin
                  next_st = ST_G_RMW_W;
                  rmw_active = 1'b1;
               end

            end

          ST_G_RMW_W :
            begin
               i2c_wr = 1'b1;
               next_st = ST_G_RMW_W_CHK_BUSY;
               rmw_active = 1'b1;
            end

          ST_G_RMW_W_CHK_BUSY:
            begin
               rmw_active = 1'b1;

               if (i2c_busy)
                 next_st = ST_G_RMW_W_CHK_DONE;
            end
	  
	  ST_G_RMW_W_CHK_DONE:
            begin
               rmw_active = 1'b1;
               if (~i2c_busy & addr_wr_reg)       //Transtion to ST_RD3_ROM after complete write write. 
                 begin
		 	if (i2c_delay_cnt == I2C_DELAY)
                        begin
                    		addr_wr = 1'b1;
                    		next_st = ST_CAL_MODE;
			end else
			begin
				i2c_delay_assert = 1'b1;
				next_st = ST_G_RMW_W_CHK_DONE;
			end
	
                 end
               else if (~i2c_busy & ~addr_wr_reg) //Move to ST_G_WR to write data after complete write address. 
                 begin
                    next_st = ST_G_RMW_W;
                    addr_wr = 1'b1;
                 end

            end

	  ST_DONE :
	    begin 
	    	 if (i2c_delay_cnt == I2C_DELAY)
		 begin
			next_st = ST_IDLE;
		 	rom_fsm_done = 1'b1;
		end
		else begin
			next_st = ST_DONE;
			i2c_delay_assert = 1'b1;
		end
	    end

	  default : ;
	 
	endcase // case (current_st)
	
     end // always @ (*)


 always@(posedge clk)
 begin
	 if(~rst_n)
		 i2c_delay_cnt <= 'h0;
	 else
	 begin
		 if(i2c_delay_assert)
			 i2c_delay_cnt <= i2c_delay_cnt + 1;
		 else
			 i2c_delay_cnt <= 'h0;
	end
end

always @(posedge clk)
  if (~rst_n)
    addr_wr_reg <= 1'b0;
  else if (addr_wr)
    addr_wr_reg <= ~addr_wr_reg;
   
   
//Count the wait delay. 
always @(posedge clk)
  if (~rst_n)
    delay_cnt <= 4'h0;
  else if (en_delay_cnt)
    delay_cnt <= delay_cnt + 1'b1;
  else
    delay_cnt <= 4'h0;
   
always @(posedge clk)
  if (~rst_n)
    rom_sel_reg <= 4'h0;
  else if (current_st == ST_CAL_MODE | current_st == ST_START)
    rom_sel_reg <= rom_sel;

always @(posedge clk)
  if (~rst_n | restart)
    cal_done <= 1'b0;
  else if (cal_current_st == CAL_DONE)
    cal_done <= 1'b1;

always @(posedge clk)
  if (~rst_n)
    i2c_write_data_latch <= 32'h0;
  else if (i2c_wr)
    i2c_write_data_latch <= i2c_write_data;

   
always @(posedge clk)
begin

   i2c_write <= i2c_wr;
   i2c_read <= i2c_rd;
end

   assign i2c_soft_rst = 1'b0;
   assign num_bytes = I2C_TRX_BYTE;
   

 always @(posedge clk)
   if (~rst_n)
     wr_rd_pass_reg <= 1'b0;
   else if (wr_rd_pass)
     wr_rd_pass_reg <= 1'b1;
   

   `IP_MODULE_NAME(rom_parser) #(
       .DDR_TYPE(DDR_TYPE),
       .ROM_DATA_WIDTH(ROM_DATA_WIDTH),
       .ROM_OUTPUT_REG(ROM_OUTPUT_REG),
       .ROM_DATA_DEPTH0(ROM_DATA_DEPTH0),
       .ROM_DATA_DEPTH1(ROM_DATA_DEPTH1),
       .ROM_DATA_DEPTH2(ROM_DATA_DEPTH2),
       .ROM_DATA_DEPTH3(ROM_DATA_DEPTH3),
       .ROM_INIT_FILE0(ROM_INIT_FILE0),
       .ROM_INIT_FILE1(ROM_INIT_FILE1),
       .ROM_INIT_FILE2(ROM_INIT_FILE2),
       .ROM_INIT_FILE3(ROM_INIT_FILE3)
       )
     u_rom_parser
     (
      // Outputs
      .rom_rd_full                      (rom_rd_full), 
      .ram_data_out			(rom_data_out[ROM_DATA_WIDTH-1:0]),
      // Inputs
      .clk				(clk),
      .rst_n				(rst_n),
      .cal_type				(cal_type),
      .cal_mode				(cal_mode),
      .restart				(restart),
      .sel_reset			(rom_sel_reset),
      .sel				(rom_sel_reg),
      .rd_en				(rd_en_t));


  assign rd_en_dummy = (cal_base_active | cal_base_end_active) & rom_cmd_cnt_empty & rom_fsm_next_cmd;
  assign rd_en_t = rd_en | rd_en_dummy;
  assign rom_sel_reset = {1'b0, sel_reset};

   //== ASCII state decoding
   /*AUTOASCIIENUM("current_st", "current_ascii_st", "ST_")*/
   // Beginning of automatic ASCII enum decoding
`ifdef EFX_SIM
   reg [143:0]		current_ascii_st;	// Decode of current_st
   always @(current_st) begin
      case ({current_st})
	ST_IDLE:               current_ascii_st = "idle              ";
	ST_CAL_MODE:           current_ascii_st = "cal_mode          ";
	ST_RD0_ROM:            current_ascii_st = "rd0_rom           ";
	ST_RD1_ROM:            current_ascii_st = "rd1_rom           ";
	ST_RD2_ROM:            current_ascii_st = "rd2_rom           ";
	ST_RD3_ROM:            current_ascii_st = "rd3_rom           ";
	ST_G_WR:               current_ascii_st = "g_wr              ";
	ST_G_WR_CHK_BUSY:      current_ascii_st = "g_wr_chk_busy     ";
	ST_G_WR_CHK_DONE:      current_ascii_st = "g_wr_chk_done     ";
	ST_G_RD:               current_ascii_st = "g_rd              ";
	ST_G_RD_CHK_BUSY:      current_ascii_st = "g_rd_chk_busy     ";
	ST_G_RD_CHK_DONE:      current_ascii_st = "g_rd_chk_done     ";
	ST_G_RD_POLL:          current_ascii_st = "g_rd_poll         ";
	ST_G_RD_POLL_CHK_BUSY: current_ascii_st = "g_rd_poll_chk_busy";
	ST_G_RD_POLL_CHK_DONE: current_ascii_st = "g_rd_poll_chk_done";
	ST_G_RD_POLL_COMPARE:  current_ascii_st = "g_rd_poll_compare ";
	ST_G_WR1:              current_ascii_st = "g_wr1             ";
	ST_G_WR1_CHK_BUSY:     current_ascii_st = "g_wr1_chk_busy    ";
	ST_G_WR1_CHK_DONE:     current_ascii_st = "g_wr1_chk_done    ";
	ST_G_RD1:              current_ascii_st = "g_rd1             ";
	ST_G_RD1_CHK_BUSY:     current_ascii_st = "g_rd1_chk_busy    ";
	ST_G_RD1_CHK_DONE:     current_ascii_st = "g_rd1_chk_done    ";
	ST_DONE:               current_ascii_st = "done              ";
	default:               current_ascii_st = "%Error            ";
      endcase
   end
   // End of automatics
`endif
   
endmodule 

////////////////////////////////////////////////////////////////////////////////
// Copyright (C) 2013-2020 Efinix Inc. All rights reserved.
//
// This   document  contains  proprietary information  which   is
// protected by  copyright. All rights  are reserved.  This notice
// refers to original work by Efinix, Inc. which may be derivitive
// of other work distributed under license of the authors.  In the
// case of derivative work, nothing in this notice overrides the
// original author's license agreement.  Where applicable, the
// original license agreement is included in it's original
// unmodified form immediately below this header.
//
// WARRANTY DISCLAIMER.
//     THE  DESIGN, CODE, OR INFORMATION ARE PROVIDED “AS IS” AND
//     EFINIX MAKES NO WARRANTIES, EXPRESS OR IMPLIED WITH
//     RESPECT THERETO, AND EXPRESSLY DISCLAIMS ANY IMPLIED WARRANTIES,
//     INCLUDING, WITHOUT LIMITATION, THE IMPLIED WARRANTIES OF
//     MERCHANTABILITY, NON-INFRINGEMENT AND FITNESS FOR A PARTICULAR
//     PURPOSE.  SOME STATES DO NOT ALLOW EXCLUSIONS OF AN IMPLIED
//     WARRANTY, SO THIS DISCLAIMER MAY NOT APPLY TO LICENSEE.
//
// LIMITATION OF LIABILITY.
//     NOTWITHSTANDING ANYTHING TO THE CONTRARY, EXCEPT FOR BODILY
//     INJURY, EFINIX SHALL NOT BE LIABLE WITH RESPECT TO ANY SUBJECT
//     MATTER OF THIS AGREEMENT UNDER TORT, CONTRACT, STRICT LIABILITY
//     OR ANY OTHER LEGAL OR EQUITABLE THEORY (I) FOR ANY INDIRECT,
//     SPECIAL, INCIDENTAL, EXEMPLARY OR CONSEQUENTIAL DAMAGES OF ANY
//     CHARACTER INCLUDING, WITHOUT LIMITATION, DAMAGES FOR LOSS OF
//     GOODWILL, DATA OR PROFIT, WORK STOPPAGE, OR COMPUTER FAILURE OR
//     MALFUNCTION, OR IN ANY EVENT (II) FOR ANY AMOUNT IN EXCESS, IN
//     THE AGGREGATE, OF THE FEE PAID BY LICENSEE TO EFINIX HEREUNDER
//     (OR, IF THE FEE HAS BEEN WAIVED, $100), EVEN IF EFINIX SHALL HAVE
//     BEEN INFORMED OF THE POSSIBILITY OF SUCH DAMAGES.  SOME STATES DO
//     NOT ALLOW THE EXCLUSION OR LIMITATION OF INCIDENTAL OR
//     CONSEQUENTIAL DAMAGES, SO THIS LIMITATION AND EXCLUSION MAY NOT
//     APPLY TO LICENSEE.
//
////////////////////////////////////////////////////////////////////////////////


//////////////////////////////////////////////////////////////////////////////
//           _____
//          / _______    Copyright (C) 2013-2020 Efinix Inc. All rights reserved.
//         / /       \
//        / /  ..    /   `IP_MODULE_NAME(ddr_calibration_parser).v
//       / / .'     /
//    __/ /.'      /     Description:
//   __   \       /      Parse configurations to DDR calibration contoller.
//  /_/ /\ \_____/ /
// ____/  \_______/
//
// *******************************
// Revisions:
// 1.0 Initial rev
//
// *******************************
//////////////////////////////////////////////////////////////////////////////
`resetall
`timescale 1ns / 1ps

module `IP_MODULE_NAME(ddr_calibration_parser) (
	input		clk,
	input		rst_n,
	output      ddr_slave_i2c_scl,      // DDR control I2C clock
    output      ddr_slave_i2c_sda,      // DDR control I2C data out
    input       ddr_slave_i2c_sda_in,   // DDR control I2C data in
	input		ddr_cal_auto_en,	// Enable auto-run for calibration
	input  [3:0]ddr_cal_auto_sel,	// Select leveling that require to run
	output [7:0]ddr_cal_auto_status,	// Indicate which leveling currently running
	input       pll_locked,             // PLL locked
    input       pll_ddr_locked,         // DDR PLL locked
    output      pll_rst_n,              // PLL active low reset
    output      pll_ddr_rst_n,          // DDR PLL active low reset
	output reg	auto_cal_done,		// Indicate status calibration done
	output reg	auto_cal_err		// Indicate status calibration error
);

	parameter [1:0]	DDR_TYPE		= 2'b00;		
	parameter 	    DDR_X16			= 1;
    parameter       ROM_DATA_DEPTH0 = 41;
    parameter       ROM_DATA_DEPTH1 = 29;
    parameter       ROM_DATA_DEPTH2 = 2;
    parameter       ROM_DATA_DEPTH3 = 2;
    parameter       ROM_INIT_FILE0  = "rom0_lpddr3_x16.hex";
    parameter       ROM_INIT_FILE1  = "rom1_lpddr3_x16.hex";
    parameter       ROM_INIT_FILE2  = "rom2_lpddr3_x16.hex";
    parameter       ROM_INIT_FILE3  = "rom3_lpddr3_x16.hex";

////////////////////////////////////////////////////
////AUTO CAL FSM
//////////////////////////////////////////////////////
localparam [3:0]	AUTO_IDLE	= 4'h0,
			AUTO_CHECK_MODE	= 4'h1,
			AUTO_CA_START	= 4'h2,
			AUTO_CA		= 4'h3,
			AUTO_CA_DONE	= 4'h4,
			AUTO_WR_START	= 4'h5,
			AUTO_WR		= 4'h6,
			AUTO_WR_DONE	= 4'h7,
			AUTO_GL_START	= 4'h8,
			AUTO_GL		= 4'h9,
			AUTO_GL_DONE	= 4'hA,
			AUTO_RD_START	= 4'hB,
			AUTO_RD		= 4'hC,
			AUTO_RD_DONE	= 4'hD,
			AUTO_CAL_ERROR	= 4'hE,
			AUTO_CAL_DONE	= 4'hF;

wire		g_rst_n;
reg	[3:0]	auto_st;
reg     [3:0]   auto_st_status;
reg	[3:0]	auto_next;
wire 	[7:0] 	cal_config;
wire 	[7:0] 	cal_status;
wire 		cal_done;
reg		enable_cal,
		restart;
reg 	[3:0]	cal_mode;
wire		delay_en;
reg	[2:0]	delay_cnt;
wire		delay_done;
wire		sda_out_w, 
		sda_in_w;
wire		cal_sel_err;
//Assignment
assign g_rst_n	  = rst_n & pll_locked & pll_ddr_locked;
assign cal_config = {cal_mode ,2'b00, enable_cal, restart};
assign cal_done	  = cal_status[0];
assign delay_done = (delay_cnt == 'h7);
assign delay_en   = restart;
assign ddr_cal_auto_status = {cal_status[3:0] , auto_st_status};
assign cal_sel_err = (DDR_TYPE == 2'b11) || (ddr_cal_auto_sel[2] && DDR_TYPE == 2'b10);

//FIXME
assign pll_rst_n     = 1'b1;
assign pll_ddr_rst_n = 1'b1;

//delay counter to hold reset for calibrator
always @(posedge clk)
begin
	if(!g_rst_n)
		delay_cnt <='h0;
	else
	begin
		if(delay_en)
			delay_cnt <= delay_cnt + 1'b1;
		else
			delay_cnt <= 'h0;
	end
end

//Moore SM state registers
always @(posedge clk)
begin	
	if(!g_rst_n)
		auto_st <= AUTO_IDLE;
	else
		auto_st <= auto_next;
end

//Next-state assignment
always @(*)
begin
	auto_next = auto_st;

	case(auto_st)
	AUTO_IDLE:
	begin
		if(ddr_cal_auto_en)
			auto_next = AUTO_CHECK_MODE;
		else
			auto_next = AUTO_IDLE;
	end
	AUTO_CHECK_MODE:
	begin
		if	((ddr_cal_auto_sel[3]) || cal_sel_err)
			//FIXME: temporarily remove CA leveling
			auto_next = AUTO_CAL_ERROR;
		else if (ddr_cal_auto_sel[2])
			auto_next = AUTO_WR_START;
		else if (ddr_cal_auto_sel[1])
			auto_next = AUTO_GL_START;
		else if (ddr_cal_auto_sel[0])
			auto_next = AUTO_RD_START;
		else
			auto_next = AUTO_CAL_ERROR;
	end
	AUTO_CA_START:
	begin
		if(delay_done)
			auto_next = AUTO_CA;
		else
			auto_next = AUTO_CA_START;
	end
	AUTO_CA:
	begin
		if(cal_done)
			auto_next = AUTO_CA_DONE;
		else
			auto_next = AUTO_CA;
	end
	AUTO_CA_DONE:
	begin
		if 	(ddr_cal_auto_sel[2])
			auto_next = AUTO_WR_START;
		else if (ddr_cal_auto_sel[1])
			auto_next = AUTO_GL_START;
		else if (ddr_cal_auto_sel[0])
			auto_next = AUTO_RD_START;
		else
			auto_next = AUTO_CAL_DONE;
	end
	AUTO_WR_START:
	begin
		if(delay_done)
			auto_next = AUTO_WR;
		else
			auto_next = AUTO_WR_START;
	end
	AUTO_WR:
	begin
		if(cal_done)
			auto_next = AUTO_WR_DONE;
		else
			auto_next = AUTO_WR;
	end
	AUTO_WR_DONE:
	begin
		if 	(ddr_cal_auto_sel[1])
			auto_next = AUTO_GL_START;
		else if (ddr_cal_auto_sel[0])
			auto_next = AUTO_RD_START;
		else
			auto_next = AUTO_CAL_DONE;
	end
	AUTO_GL_START:
	begin
		if(delay_done)
			auto_next = AUTO_GL;
		else
			auto_next = AUTO_GL_START;
	end
	AUTO_GL:
	begin
		if(cal_done)
			auto_next = AUTO_GL_DONE;
		else	
			auto_next = AUTO_GL;
	end
	AUTO_GL_DONE:
	begin
		if 	(ddr_cal_auto_sel[0])
			auto_next = AUTO_RD_START;
		else
			auto_next = AUTO_CAL_DONE;
	end
	AUTO_RD_START:
	begin
		if(delay_done)
			auto_next = AUTO_RD;
		else
			auto_next = AUTO_RD_START;
	end
	AUTO_RD:
	begin
		if(cal_done)
			auto_next = AUTO_RD_DONE;
		else
			auto_next = AUTO_RD;
	end
	AUTO_RD_DONE:
	begin
		auto_next = AUTO_CAL_DONE;
	end
	AUTO_CAL_ERROR:
	begin
		if(!ddr_cal_auto_en)
			auto_next = AUTO_IDLE;
		else
			auto_next = AUTO_CAL_ERROR;
	end
	AUTO_CAL_DONE:
	begin
	 	if(!ddr_cal_auto_en)
                        auto_next = AUTO_IDLE;
                else
			auto_next = AUTO_CAL_DONE;
	end
	default:
	begin
		auto_next = AUTO_IDLE;
	end
	endcase
end

//Output assignment
always@ (auto_st)
begin
	case(auto_st)
        AUTO_IDLE:
        begin
		enable_cal 	= 1'b0;
		restart		= 1'b0;
		cal_mode	= 4'b0000;
		auto_st_status  = 4'b0000;
		auto_cal_done	= 1'b0;
		auto_cal_err	= 1'b0;
	end
	AUTO_CHECK_MODE:
	begin
		enable_cal 	= 1'b0;
		restart		= 1'b0;
		cal_mode	= 4'b0000;
		auto_st_status  = 4'b0000;
		auto_cal_done	= 1'b0;
		auto_cal_err	= 1'b0;
	end
	AUTO_CA_START:
	begin
		enable_cal 	= 1'b0;
		restart		= 1'b1;
		cal_mode	= 4'b1000;
		auto_st_status  = 4'b0000;
		auto_cal_done	= 1'b0;
		auto_cal_err	= 1'b0;
	end
	AUTO_CA:
	begin
		enable_cal 	= 1'b1;
		restart		= 1'b0;
		cal_mode	= 4'b1000;
		auto_st_status  = 4'b0000;
		auto_cal_done	= 1'b0;
		auto_cal_err	= 1'b0;
	end
	AUTO_CA_DONE:
	begin
		enable_cal 	= 1'b0;
		restart		= 1'b1;
		cal_mode	= 4'b0000;
		auto_st_status  = 4'b0000;
		auto_cal_done	= 1'b0;
		auto_cal_err	= 1'b0;
	end
	AUTO_WR_START:
	begin
		enable_cal 	= 1'b0;
		restart		= 1'b1;
		cal_mode	= 4'b0010;
		auto_st_status  = 4'b0000;
		auto_cal_done	= 1'b0;
		auto_cal_err	= 1'b0;
	end
	AUTO_WR:
	begin
		enable_cal 	= 1'b1;
		restart		= 1'b0;
		cal_mode	= 4'b0010;
		auto_st_status  = 4'b0100;
		auto_cal_done	= 1'b0;
		auto_cal_err	= 1'b0;
	end
	AUTO_WR_DONE:
	begin
		enable_cal 	= 1'b0;
		restart		= 1'b1;
		cal_mode	= 4'b0000;
		auto_st_status  = 4'b0000;
		auto_cal_done	= 1'b0;
		auto_cal_err	= 1'b0;
	end
	AUTO_GL_START:
	begin
		enable_cal 	= 1'b0;
		restart		= 1'b1;
		cal_mode	= 4'b0001;
		auto_st_status  = 4'b0000;
		auto_cal_done	= 1'b0;
		auto_cal_err	= 1'b0;
	end
	AUTO_GL:
	begin
		enable_cal 	= 1'b1;
		restart		= 1'b0;
		cal_mode	= 4'b0001;
		auto_st_status  = 4'b0010;
		auto_cal_done	= 1'b0;
		auto_cal_err	= 1'b0;
	end
	AUTO_GL_DONE:
	begin
		enable_cal 	= 1'b1;
		restart		= 1'b1;
		cal_mode	= 4'b0000;
		auto_st_status  = 4'b0000;
		auto_cal_done	= 1'b0;
		auto_cal_err	= 1'b0;
	end
	AUTO_RD_START:
	begin
		enable_cal 	= 1'b0;
		restart		= 1'b1;
		cal_mode	= 4'b0100;
		auto_st_status  = 4'b0000;
		auto_cal_done	= 1'b0;
		auto_cal_err	= 1'b0;
	end
	AUTO_RD:
	begin
		enable_cal 	= 1'b1;
		restart		= 1'b0;
		cal_mode	= 4'b0100;
		auto_st_status  = 4'b0001;
		auto_cal_done	= 1'b0;
		auto_cal_err	= 1'b0;
	end
	AUTO_RD_DONE:
	begin
		enable_cal 	= 1'b1;
		restart		= 1'b1;
		cal_mode	= 4'b0000;
		auto_st_status  = 4'b0000;
		auto_cal_done	= 1'b0;
		auto_cal_err	= 1'b0;
	end
	AUTO_CAL_ERROR:
	begin
		enable_cal 	= 1'b0;
		restart		= 1'b0;
		cal_mode	= 4'b0000;
		auto_st_status  = 4'b0000;
		auto_cal_done	= 1'b0;
		auto_cal_err	= 1'b1;
	end
	AUTO_CAL_DONE:
	begin
		enable_cal 	= 1'b0;
		restart		= 1'b0;
		cal_mode	= 4'b0000;
		auto_st_status  = 4'b0000;
		auto_cal_done	= 1'b1;
		auto_cal_err	= 1'b0;
	end
	default:
	begin
		enable_cal 	= 1'b0;
		restart		= 1'b0;
		cal_mode	= 4'b0000;
		auto_st_status  = 4'b0000;
		auto_cal_done	= 1'b0;
		auto_cal_err	= 1'b0;
	end
	endcase
end


//*******************************************************
// This workaround only apply for engineering stepping 	* 
// for T120's I2C control lines to DDR controller.	*
// This workaround will be removed in future stepping.	*
//*******************************************************
`ifndef SIM
	wire   sda_wire;
	assign sda_wire   	 = ddr_slave_i2c_sda_in & sda_out_w;
	assign ddr_slave_i2c_sda = sda_wire;
	assign sda_in_w  	 = sda_wire;
`else
	assign sda_in_w = ddr_slave_i2c_sda_in;
	assign ddr_slave_i2c_sda = sda_out_w;
`endif

`IP_MODULE_NAME(top_ddr_calibration_wrapper) #(
	.DDR_TYPE		(DDR_TYPE),
	.DDR_X16		(DDR_X16),
        .I2C_CMD_BYTE_WIDTH	(8),
        .I2C_TRX_BYTE		(8'h5),
        .ROM_DATA_DEPTH0	(ROM_DATA_DEPTH0),
        .ROM_DATA_DEPTH1	(ROM_DATA_DEPTH1),
        .ROM_DATA_DEPTH2	(ROM_DATA_DEPTH2),
        .ROM_DATA_DEPTH3	(ROM_DATA_DEPTH3),
        .ROM_INIT_FILE0		(ROM_INIT_FILE0),
        .ROM_INIT_FILE1		(ROM_INIT_FILE1),
        .ROM_INIT_FILE2		(ROM_INIT_FILE2),
        .ROM_INIT_FILE3		(ROM_INIT_FILE3)
) u_top_ddr_calibration_wrapper (
		.sda_out	(sda_out_w),
                .scl_out      	(ddr_slave_i2c_scl),
		.sda_in		(sda_in_w),
                .scl_in       	(ddr_slave_i2c_scl),
		.clk            (clk),
                .i2c_clk        (clk),
                .rst_n          (g_rst_n),
                .config_reg0    (cal_config),
                .status_reg0    (cal_status),
		.status_reg1	(),
                .control_led    () 			//optional for debug
);

endmodule
////////////////////////////////////////////////////////////////////////////////
// Copyright (C) 2013-2020 Efinix Inc. All rights reserved.              
//
// This   document  contains  proprietary information  which   is        
// protected by  copyright. All rights  are reserved.  This notice       
// refers to original work by Efinix, Inc. which may be derivitive       
// of other work distributed under license of the authors.  In the       
// case of derivative work, nothing in this notice overrides the         
// original author's license agreement.  Where applicable, the           
// original license agreement is included in it's original               
// unmodified form immediately below this header.                        
//
// WARRANTY DISCLAIMER.                                                  
//     THE  DESIGN, CODE, OR INFORMATION ARE PROVIDED “AS IS” AND        
//     EFINIX MAKES NO WARRANTIES, EXPRESS OR IMPLIED WITH               
//     RESPECT THERETO, AND EXPRESSLY DISCLAIMS ANY IMPLIED WARRANTIES,  
//     INCLUDING, WITHOUT LIMITATION, THE IMPLIED WARRANTIES OF          
//     MERCHANTABILITY, NON-INFRINGEMENT AND FITNESS FOR A PARTICULAR    
//     PURPOSE.  SOME STATES DO NOT ALLOW EXCLUSIONS OF AN IMPLIED       
//     WARRANTY, SO THIS DISCLAIMER MAY NOT APPLY TO LICENSEE.           
//
// LIMITATION OF LIABILITY.                                              
//     NOTWITHSTANDING ANYTHING TO THE CONTRARY, EXCEPT FOR BODILY       
//     INJURY, EFINIX SHALL NOT BE LIABLE WITH RESPECT TO ANY SUBJECT    
//     MATTER OF THIS AGREEMENT UNDER TORT, CONTRACT, STRICT LIABILITY   
//     OR ANY OTHER LEGAL OR EQUITABLE THEORY (I) FOR ANY INDIRECT,      
//     SPECIAL, INCIDENTAL, EXEMPLARY OR CONSEQUENTIAL DAMAGES OF ANY    
//     CHARACTER INCLUDING, WITHOUT LIMITATION, DAMAGES FOR LOSS OF      
//     GOODWILL, DATA OR PROFIT, WORK STOPPAGE, OR COMPUTER FAILURE OR   
//     MALFUNCTION, OR IN ANY EVENT (II) FOR ANY AMOUNT IN EXCESS, IN    
//     THE AGGREGATE, OF THE FEE PAID BY LICENSEE TO EFINIX HEREUNDER    
//     (OR, IF THE FEE HAS BEEN WAIVED, $100), EVEN IF EFINIX SHALL HAVE 
//     BEEN INFORMED OF THE POSSIBILITY OF SUCH DAMAGES.  SOME STATES DO 
//     NOT ALLOW THE EXCLUSION OR LIMITATION OF INCIDENTAL OR            
//     CONSEQUENTIAL DAMAGES, SO THIS LIMITATION AND EXCLUSION MAY NOT   
//     APPLY TO LICENSEE.
//
////////////////////////////////////////////////////////////////////////////////

		





		


 



////////////////////////////////////////////////////////////////////////////
//           _____       
//          / _______    Copyright (C) 2013-2020 Efinix Inc. All rights reserved.
//         / /       \   
//        / /  ..    /   ddr_calibration_wrapper.v
//       / / .'     /    
//    __/ /.'      /     Description:
//   __   \       /      DDR calibration wrapper file to wrapper controller
//  /_/ /\ \_____/ /     and i2c master
// ____/  \_______/      
//
// *******************************
// Revisions:
// 1.0 Initial rev
//
// *******************************
//////////////////////////////////////////////////////////////////////////////
`resetall
`timescale 1ns / 1ps

module `IP_MODULE_NAME(top_ddr_calibration_wrapper) 
#(
	parameter [1:0] DDR_TYPE		= 2'b00,
	parameter	DDR_X16			= 0,
	parameter       I2C_CMD_BYTE_WIDTH      = 8,
        parameter [7:0] I2C_TRX_BYTE            = 8'h5,
        parameter       ROM_DATA_DEPTH0         = 38,
        parameter       ROM_DATA_DEPTH1         = 16,
        parameter       ROM_DATA_DEPTH2         = 13,
        parameter       ROM_DATA_DEPTH3         = 4,
        parameter       ROM_INIT_FILE0          = "rom0.hex",
        parameter       ROM_INIT_FILE1          = "rom1.hex",
        parameter       ROM_INIT_FILE2          = "rom2.hex",
        parameter       ROM_INIT_FILE3          = "rom3.hex"

) (
   output control_led,
   //////////////////////////////
   //I2c Interface (DDR IP Core) 
   //Outputs
   output sda_out,
   output scl_out,
   //Inputs 
   input sda_in,
   input scl_in,


   //////////////////////////////
   //System Clock & Reset
   input clk,     // 8Mhz clock from pll
   input i2c_clk, // 8Mhz clock from pll
   input rst_n,	  // external resetn that AND wih pll_locked	
  
   //////////////////////////////


   //////////////////////////////
   //Configuration Register
   input [7:0] config_reg0,
   //////////////////////////////
   //Status Register
   output [7:0] status_reg1,
   output [7:0] status_reg0
   //TEMPFIX
   );

/////////////////////////////////
//Internal Signals 
   wire 	restart;
   wire 	enable_cal;
   wire [3:0] 	cal_mode;
   wire [1:0]	cal_type;
   wire 	i2c_busy;
   wire [31:0] 	i2c_read_data;
   wire 	i2c_read;
   wire 	i2c_write;
   wire 	i2c_soft_rst;
   wire [31:0] 	i2c_write_data;
   wire [7:0] 	command_byte;
   wire [7:0] 	num_bytes;
   wire 	i2c_rxak;
   wire 	cal_done;
   wire [7:0] 	i2c_slave_addr;
   wire 	wr_rd_pass;
   wire	[6:0]	cal_status_reg;
   wire [7:0]	cal_status_reg2;
   wire [1:0]	cal_type_1;
   wire [2:0]   cal_slice;

/////////////////////////////////
//RTL

   //Control registers
   assign restart 	= config_reg0[0];
   assign enable_cal 	= config_reg0[1];
   assign control_led 	= config_reg0[2];
   //assign cal_type 	= {cal_type_1, config_reg0[3]};
   assign cal_type	= cal_type_1;
   assign cal_mode 	= config_reg0[7:4];
   
   //Status registers. 
   
   assign status_reg0[0] = cal_done;
   assign status_reg0[7:1] = cal_status_reg[6:0];
   assign status_reg1 = cal_status_reg2;
   
   //DDR Calibration Core I2C2APB Core. 
   assign i2c_slave_addr = 8'h82;
   
////////////////////////////////
//Calibration Controller.
////////////////////////////////
  `IP_MODULE_NAME(cal_controller) #(
	.DDR_TYPE(DDR_TYPE),
	.I2C_CMD_BYTE_WIDTH(I2C_CMD_BYTE_WIDTH),
	.I2C_TRX_BYTE(I2C_TRX_BYTE),
	.ROM_DATA_DEPTH0(ROM_DATA_DEPTH0),
	.ROM_DATA_DEPTH1(ROM_DATA_DEPTH1),
	.ROM_DATA_DEPTH2(ROM_DATA_DEPTH2),
	.ROM_DATA_DEPTH3(ROM_DATA_DEPTH3),
	.ROM_INIT_FILE0(ROM_INIT_FILE0),
	.ROM_INIT_FILE1(ROM_INIT_FILE1),
	.ROM_INIT_FILE2(ROM_INIT_FILE2),
	.ROM_INIT_FILE3(ROM_INIT_FILE3)
  ) u_cal_controller (
     // Outputs
     .cal_done				(cal_done),
     .cal_status_reg			(cal_status_reg),
     .cal_status_reg2			(cal_status_reg2),
     .wr_rd_pass_reg                    (wr_rd_pass), 
     .i2c_write_data			(i2c_write_data[31:0]),
     .command_byte			(command_byte[7:0]),
     .num_bytes				(num_bytes[7:0]),
     .i2c_read				(i2c_read),
     .i2c_write				(i2c_write),
     .i2c_soft_rst			(i2c_soft_rst),
     // Inputs
     .clk				(clk),
     .rst_n				(rst_n),
     .restart				(restart),
     .enable_cal			(enable_cal),
     .cal_type				(cal_type),
     .cal_mode				(cal_mode[3:0]),
     .cal_slice				(cal_slice),
     .i2c_busy				(i2c_busy),
     .i2c_read_data			(i2c_read_data));
   
      

/////////////////////////////////
//I2C Master Controller
/////////////////////////////////

   `IP_MODULE_NAME(i2c_master_ctl) u_i2c_master_ctl
     (
      // Outputs
      .scl_out				(scl_out),
      .sda_out				(sda_out),
      .data_out				(i2c_read_data),
      .busy				(i2c_busy),
      .i2c_rxak				(i2c_rxak),
      // Inputs
      .sda_in				(sda_in),
      .scl_in				(scl_in),
      .i2c_slave_addr			(i2c_slave_addr[7:0]),
      .din				(i2c_write_data),
      .i2c_clk				(i2c_clk),
      .rst				(~rst_n),
      .command_byte			(command_byte),
      .num_bytes			(num_bytes[7:0]),
      .read				(i2c_read),
      .write				(i2c_write),
      .i2c_soft_rst			(i2c_soft_rst));
   

	generate
	begin
	//LPDDR3_X32
	if(DDR_TYPE == 2'b00 && DDR_X16 == 0) begin
		assign cal_type_1 = 2'b10;
		assign cal_slice  = 3'h4; 
	end	
	//LPDDR3_X16
	else if(DDR_TYPE == 2'b00 && DDR_X16 == 1) begin 
		assign cal_type_1 = 2'b10;
		assign cal_slice  = 3'h2; 
	end	

	//DDR3_X32
	else if(DDR_TYPE == 2'b01 && DDR_X16 == 0) begin
		assign cal_type_1 = 2'b11;
		assign cal_slice  = 3'h4; 
	end	

	//DDR3_x16
	else if(DDR_TYPE == 2'b01 && DDR_X16 == 1) begin
		assign cal_type_1 = 2'b11;
		assign cal_slice  = 3'h2; 
	end	

	//LPDDR2_X32
	else if(DDR_TYPE == 2'b10 && DDR_X16 == 0) begin
		assign cal_type_1 = 2'b10;
		assign cal_slice  = 3'h4; 
	end	
	
	//LPDDR2_X16
	else if(DDR_TYPE == 2'b10 && DDR_X16 == 1) begin
		assign cal_type_1 = 2'b10;
		assign cal_slice  = 3'h2; 
	end	

	//RESERVED
	else begin
		assign cal_type_1 = 2'b00;
		assign cal_slice = 3'h0;
	end
	end
	endgenerate
   
endmodule 
// Local Variables:
// verilog-library-directories:("." "library" "i2c_master")
// End:


////////////////////////////////////////////////////////////////////////////
//           _____       
//          / _______    Copyright (C) 2013-2020 Efinix Inc. All rights reserved.
//         / /       \   
//        / /  ..    /   functions.vh
//       / / .'     /    
//    __/ /.'      /     Description:
//   __   \       /      Include file with DDR calibration IP Core functions.  
//  /_/ /\ \_____/ /     They are used to reformat input parameters and also perform various
// ____/  \_______/      standard computations
//
// *******************************
// Revisions:
// 1.0 Initial rev
//
// *******************************
/////////////////////////////////////////////////////////////////////////////////

function integer depth2width;
input [31:0] depth;
// Description:
//   Converts a depth value into a Width.  For instance a depth of
//        a=depth2width(64);
//   sets "a" to 6. 
//  
//   One way to use this is to convert a depth to a width value on a
//   register.  For instance:
//  
//        reg [depth2width(MEM_WIDTH)-1:0] a;
//  
//   
begin : fnDepth2Width
  if (depth > 1) begin
     depth = depth - 1;
     for (depth2width=0; depth>0; depth2width = depth2width + 1)
       depth = depth>>1;
  end
  else
    depth2width = 0;
end
endfunction 

////////////////////////////////////////////////////////////////////////////////
// Copyright (C) 2013-2020 Efinix Inc. All rights reserved.
//
// This   document  contains  proprietary information  which   is
// protected by  copyright. All rights  are reserved.  This notice
// refers to original work by Efinix, Inc. which may be derivitive
// of other work distributed under license of the authors.  In the
// case of derivative work, nothing in this notice overrides the
// original author's license agreement.  Where applicable, the
// original license agreement is included in it's original
// unmodified form immediately below this header.
//
// WARRANTY DISCLAIMER.
//     THE  DESIGN, CODE, OR INFORMATION ARE PROVIDED “AS IS” AND
//     EFINIX MAKES NO WARRANTIES, EXPRESS OR IMPLIED WITH
//     RESPECT THERETO, AND EXPRESSLY DISCLAIMS ANY IMPLIED WARRANTIES,
//     INCLUDING, WITHOUT LIMITATION, THE IMPLIED WARRANTIES OF
//     MERCHANTABILITY, NON-INFRINGEMENT AND FITNESS FOR A PARTICULAR
//     PURPOSE.  SOME STATES DO NOT ALLOW EXCLUSIONS OF AN IMPLIED
//     WARRANTY, SO THIS DISCLAIMER MAY NOT APPLY TO LICENSEE.
//
// LIMITATION OF LIABILITY.
//     NOTWITHSTANDING ANYTHING TO THE CONTRARY, EXCEPT FOR BODILY
//     INJURY, EFINIX SHALL NOT BE LIABLE WITH RESPECT TO ANY SUBJECT
//     MATTER OF THIS AGREEMENT UNDER TORT, CONTRACT, STRICT LIABILITY
//     OR ANY OTHER LEGAL OR EQUITABLE THEORY (I) FOR ANY INDIRECT,
//     SPECIAL, INCIDENTAL, EXEMPLARY OR CONSEQUENTIAL DAMAGES OF ANY
//     CHARACTER INCLUDING, WITHOUT LIMITATION, DAMAGES FOR LOSS OF
//     GOODWILL, DATA OR PROFIT, WORK STOPPAGE, OR COMPUTER FAILURE OR
//     MALFUNCTION, OR IN ANY EVENT (II) FOR ANY AMOUNT IN EXCESS, IN
//     THE AGGREGATE, OF THE FEE PAID BY LICENSEE TO EFINIX HEREUNDER
//     (OR, IF THE FEE HAS BEEN WAIVED, $100), EVEN IF EFINIX SHALL HAVE
//     BEEN INFORMED OF THE POSSIBILITY OF SUCH DAMAGES.  SOME STATES DO
//     NOT ALLOW THE EXCLUSION OR LIMITATION OF INCIDENTAL OR
//     CONSEQUENTIAL DAMAGES, SO THIS LIMITATION AND EXCLUSION MAY NOT
//     APPLY TO LICENSEE.
//
////////////////////////////////////////////////////////////////////////////////



////////////////////////////////////////////////////////////////////////////
//           _____       
//          / _______    Copyright (C) 2013-2020 Efinix Inc. All rights reserved.
//         / /       \   
//        / /  ..    /   `IP_MODULE_NAME(i2c_master_ctl).v
//       / / .'     /    
//    __/ /.'      /     Description:
//   __   \       /      i2c master 
//  /_/ /\ \_____/ /     
// ____/  \_______/      
//
// *******************************
// Revisions:
// 1.0 Initial rev
//
// *******************************

/////////////////////////////////////////////////////////////////////////////////
`resetall
`timescale 1ns / 1ps
//`include "i2c_master_defines.h"
  

  module `IP_MODULE_NAME(i2c_master_ctl) #(
			   parameter CMD_BYTE_WIDTH = 8,
			   parameter DATA_BYTE_WIDTH = 32
			   )
   (
    //I2c Interfacing. 
    output 			      scl_out, 
    output 			      sda_out,
    input 			      sda_in,
    input 			      scl_in,
    
    
    //outputs
    output wire [DATA_BYTE_WIDTH-1:0] data_out,	//32-bits data to Microcontroller/User Logic. 
    output wire 		      busy,	//i2c busy.
    output wire 		      i2c_rxak, //i2c acknowledge.
    
							
    //inputs
    input [7:0] 		      i2c_slave_addr,	//i2c slave address register.
    input [DATA_BYTE_WIDTH-1:0]       din,		//32-bits from Microcontroller / User Logic FSM. 
    input 			      i2c_clk,		//2MHz for 100kHz I2c.
							//8MHz for 400kHz I2c. 
    input 			      rst,		//Sync Reset.
   
    //Register Interface
    input [CMD_BYTE_WIDTH-1:0] 	      command_byte,	//Command Bytes 
    input [7:0] 		      num_bytes,	//Number of Read/Write Bytes. 
    input 			      read,		//Read Strobe. 
    input 			      write,		//Write Strobe. 
    input 			      i2c_soft_rst	//I2c Soft Reset. 
   );

  
 

// Local Parameter (FSM)
   //== State enumeration
   parameter [3:0] // synopsys enum state_info
     IDLE_ST          = 4'h0,
     START_GEN0_ST    = 4'h1,
     WRITE_DAT0_ST    = 4'h2,
     START_GEN1_ST    = 4'h3,
     WRITE_DAT1_ST    = 4'h4, // Command Byte Sequence (READ)
     RESTART_ST       = 4'h5, // Generate a restart sequence
     WRITE_DAT2_ST    = 4'h6, // READ THE DATA
     STOP_GEN_ST      = 4'h7,
     DONE_ST          = 4'h8;
   
	      
   
	      
//internal signals
   //== State variables
   reg [3:0] /* synopsys enum state_info */ 
	     current_st; /* synopsys state_vector current_st */ 
   reg [3:0] /* synopsys enum state_info */			      
	     next_st;
   
   reg [7:0] byte_cnt;  //Byte Counter.    
  
   reg [7:0]  MIDR; //I2d Data Register Inbound
   reg [7:0]  MBCR; //Control Register
   wire [7:0] MBSR; //Status Register. 
   wire [7:0] MODR; //I2c Data Register Outbound
   wire       uc_wr_data;
   wire       uc_rd_data;
   reg [1:0]  mbcr_write0;
   reg 	      mbcr_write;
   wire       wuc0;
   reg 	      wuc1;
   wire       xfer_complete0;
   reg 	      xfer_complete1;
   
   reg 	      restart;
   reg 	      mbcr_write_a;
   reg [1:0]  uc_wr_data0;
   reg [1:0]  uc_rd_data0;
   reg [7:0]  i2c_slave_addr0;
   wire       read_p,write_p;   
   reg [3:0]  soft_rst_reg;
   wire       soft_rst;
   reg [31:0] data_out0;
   
   
   //////////////////////////////////////////////////////////////////////////////////////
   //Sensor Status update.
   //This state machine is actually used to solve performance issues caused by firmware.
   ///////////////////////////////////////////////////////////////////////////////////////

   //I2C Receive Acknowledge Bit
   assign i2c_rxak = MBSR[0];
      
   // I2c Busy status
   assign    busy = MBSR[5];
   
   /////////////////////////////////////
   //Sychronizer
   //Fast2Slow Domain
   /////////////////////////////////////
   `IP_MODULE_NAME(pulse_gen) u_pgfts_wrflag
     (
      // Outputs
      .data_out				(write_p),
      // Inputs
      .clk				(i2c_clk),
      .rst                              (rst),
      .data_in				(write));
   
   `IP_MODULE_NAME(pulse_gen) u_pgfts_rdflag
     (
      // Outputs
      .data_out				(read_p),
      // Inputs
      .clk				(i2c_clk),
      .rst                              (rst),
      .data_in				(read));
   
   /////////////////////////////
   //I2c Controller
   /////////////////////////////
   
   `IP_MODULE_NAME(i2c_mstrslv_ctl) u_i2c_mstrslv_ctl
     (
      // Outputs
      .MBSR				(MBSR[7:0]),		//I2c Status Register.
      .MODR				(MODR[7:0]),		//I2c Data Register
      .sda_out				(sda_out),		//SDA output drive control.
      .scl_out				(scl_out),		//SCL output drive control.
      // Inputs
      .MBCR				(MBCR[7:0]),		//i2c control register.
      .MADR				(i2c_slave_addr0),	//I2c Slave Address Register
      .MIDR				(MIDR[7:0]),		//I2c Data Register Inbound.
      .sda_in				(sda_in),		//SDA Input.
      .scl_in				(scl_in),		//SCL input.
      .mbcr_wr	         		(mbcr_write0[1]),	//MBCR is being written
      .uc_rd_data			(uc_rd_data),		//Status uC read data register.
      .uc_wr_data			(uc_wr_data),		//Status uC wrote data register.
      .mif_clr				(1'b0),			//Clear Interrupt Bit
      .mal_clr				(1'b0),			//Clear Arbitration Lost Bit.
      .clk				(i2c_clk));		//2MHz clock.
   

   ///////////////////////////////
   //I2c Slave Address.
   ///////////////////////////////
   always @(posedge i2c_clk)
     if (rst)
       i2c_slave_addr0 <= 8'h00;
     else /*if (read_p || write_p)*/ //Fix-Me !!!
       i2c_slave_addr0 <= i2c_slave_addr;
   


   ///////////////////////////////
   //I2c Master Controller States
   ///////////////////////////////
   always @(posedge i2c_clk)
     begin
	if (rst )
	  current_st <= IDLE_ST;
	else
	  current_st <= next_st;
     end
   
   
   
   always @(*)
     begin
	next_st = IDLE_ST;
	case(current_st)
	  
	  IDLE_ST: begin
	     if (write_p) 
	       next_st = START_GEN0_ST;  //I2c Master XMIT 
	     else if (read_p)
	       next_st = START_GEN1_ST;  //I2c Master Receive
	     else
	       next_st = IDLE_ST;
	  end
	  
	  START_GEN0_ST: begin //Generate Start Condition (XMIT)
	     if (write_p || read_p)
	       begin 
      		  next_st = STOP_GEN_ST;   
	       end
	     else if (MBCR[7] == 1'b1) // Wait for transfer complete - MCF==1. 
	       next_st = WRITE_DAT0_ST;
	     else
	       next_st = START_GEN0_ST;
	  end
	  
	  START_GEN1_ST: begin //Generate Start Condition (RECEIVER)
	     if (write_p || read_p)
	       begin 
      		  next_st = STOP_GEN_ST;   
	       end
	     
	     else if (MBCR[7] == 1'b1) // Wait for xfer complete bit true
	       next_st = WRITE_DAT1_ST;
	     else
	       next_st = START_GEN1_ST;
	  end
	  
	  WRITE_DAT0_ST: begin
	     
	     if (write_p || read_p)
	       begin 
      		  next_st = STOP_GEN_ST;  
	       end
	     else if (byte_cnt == num_bytes && MBSR[7] == 1'b1) //Wait for (data) xfer bit true
	       begin
		  next_st = STOP_GEN_ST;
	       end
	     
	     
	     else
	       begin
		  next_st = WRITE_DAT0_ST;
	       end // else: !if(byte_cnt == num_bytes && MBSR[7] == 1'b1)
	     
	     
	     
	  end
	  
	  WRITE_DAT1_ST: begin
	     if (write_p || read_p)
	       begin 
      		  next_st = STOP_GEN_ST;   
	       end
	     
	     else if ( /*i2c_slave_addr0 == `SLAVE_ADDR  &*/ byte_cnt == num_bytes && MBSR[7] == 1'b1) //Wait for (data) xfer bit true (command register)
	       begin
		  next_st = RESTART_ST;
	       end
	     
	  
	     
	     else
	       begin
		  next_st = WRITE_DAT1_ST;
	       end // else: !if(...
	     
	     
	  end // case: WRITE_DAT1_ST
	  
	  RESTART_ST : begin //Generate a restart sequence for read.
	     if (MBCR[7] == 1'b1)
	       next_st = WRITE_DAT2_ST;
	     else
	       next_st = RESTART_ST;
	  end
	  
	  WRITE_DAT2_ST: begin
	     if (read_p || write_p)
	       begin
		  next_st = STOP_GEN_ST;
	 
	       end
	     else if ( (byte_cnt == num_bytes /*-(CMD_BYTE_WIDTH/8)*/) && MBSR[7] == 1'b1) //Wait for (data) xfer bit true
	       begin
		  next_st = STOP_GEN_ST;
		 
	       end
	     
             
	     else
	       begin
		  next_st = WRITE_DAT2_ST;
		 
	       end // else: !if(byte_cnt == (num_bytes -1) && MBSR[7] == 1'b1)
	     
	  end // case: WRITE_DAT2_ST
	  
	  
	  STOP_GEN_ST: begin 
	     if (MBSR[7] == 1'b0) //Wait for master to exit wait state
	       next_st = DONE_ST;
	     else
	       next_st = STOP_GEN_ST;
	  end
	  
	  DONE_ST: begin          //Check for MBB status flag.
	     if (MBSR[5] == 1'b0) //Wait for bus not busy
	       next_st = IDLE_ST;
	     else
	       next_st = DONE_ST;
	  end
  
	  default : next_st = IDLE_ST;
	endcase // case (current_st)	
     end // always @ (*)
   

     
//I2c Master Controller (WRITE-RESTART-READ)...   
//Note : Master Restart Read - This routine writes out the header and one data byte then generates a
// restart with another header and reads the data (based on the num_bytes setting)....
   
   //Send data out!
   always @(posedge i2c_clk)
     if (rst)
       MIDR <= 8'h00;
     else if (write_p || read_p)
       MIDR <= {i2c_slave_addr0[7:1],1'b0}; //Header + Write
     else if (current_st == RESTART_ST) //READ_P SEQ.
       MIDR <= {i2c_slave_addr0[7:1],1'b1}; //Header + Read_p
     else if (MBSR[3] == 1'b1) //Wait Microcontroller to read/write to data register MBDR.
       //if (i2c_slave_addr0 == `SLAVE_ADDR )
       begin
	  if (byte_cnt == 0)
	    MIDR <= command_byte[7:0];
	  else if (byte_cnt == 1)
	    MIDR <= din[7:0];
	  else if (byte_cnt == 2)
	    MIDR <= din[15:8];
	  else if (byte_cnt == 3)
	    MIDR <= din[23:16];
	  else if (byte_cnt == 4)
	    MIDR <= din[31:24];
       end // if (MBSR[3] == 1'b1)
   
   
	    
   	   
   
   //I2c Master Control Register
   always @(posedge i2c_clk)
     if (rst | soft_rst)
       MBCR <= 8'h00;
     else if ( (current_st == WRITE_DAT0_ST || current_st == WRITE_DAT1_ST || current_st == WRITE_DAT2_ST ) && (read_p || write_p) ) 
       MBCR <= 8'hc0; //Generate a stop conditon...
     else if (write_p)
       MBCR <= 8'hf0; // Generate Start Conditon (write cycle)
     else if (read_p)
       MBCR <= 8'hf0; // Generate Start Condition
     else if ( current_st == RESTART_ST)
       MBCR <= 8'hE4; //Generate a restart read with ack
     else if (current_st == WRITE_DAT2_ST && byte_cnt == (num_bytes -1) && MBCR !== 8'hc0 && MBSR[7] == 1'b1) //4
       MBCR <= 8'he8; // Generate(end multibyte read cycle noack!)
     else if ( (current_st == WRITE_DAT2_ST) && byte_cnt == (num_bytes ) && MBSR[7] == 1'b1 ) //5
       MBCR <= 8'hc0; // Generate a STOP Condition
     else if ( (current_st == WRITE_DAT0_ST) && byte_cnt == (num_bytes) && MBSR[7] == 1'b1 )
       MBCR <= 8'hc0; // Generate a STOP Condition
   
   
   
   always @(posedge i2c_clk)
     begin
	if (rst)
	  restart <= 1'b0;
	else
          restart <= (current_st == RESTART_ST);
     end
   
   //MBCR is being written?
   always @(posedge i2c_clk)
     if (rst)
       mbcr_write0 <= 2'b00;
     else if (write_p || read_p  ||  ( byte_cnt == (num_bytes) && MBSR[7] == 1'b1 ) || ( current_st == RESTART_ST && ~restart ))
       mbcr_write0 <= 2'b11;
     else if ( (current_st == WRITE_DAT2_ST) && byte_cnt == (num_bytes ) && MBSR[7] == 1'b1 ) //5
       mbcr_write0 <= 2'b11;
     else if  (current_st == WRITE_DAT2_ST && byte_cnt == (num_bytes -1)  && MBCR !== 8'hc0 && MBSR[7] == 1'b1 ) //4
       mbcr_write0 <= 2'b11;     
     else
       mbcr_write0 <= {mbcr_write0[0],1'b0};

   
   always @(posedge i2c_clk)
     if (rst)
       begin
	  mbcr_write_a <= 1'b0;
	  mbcr_write   <= 1'b0;
       end
     else    
       begin 
	  mbcr_write_a <= mbcr_write0[1];
	  mbcr_write <= mbcr_write_a;
       end
   
   
   assign wuc0 = MBSR[3];
   assign xfer_complete0 = MBSR[7];
   
   always @(posedge i2c_clk)
     if (rst)
       begin
	  wuc1 <= 1'b0;
	  xfer_complete1 <= 1'b0;
       end
     else
       begin
	  wuc1 <= wuc0;
	  xfer_complete1 <= xfer_complete0;
      end
   
   
   //I2c Write Strobe
   always @(posedge i2c_clk)
     if (rst)
       uc_wr_data0 <= 2'b0;
     else if (current_st == WRITE_DAT0_ST && (wuc0 && ~wuc1) && byte_cnt <= (num_bytes )) //wuc =1, Master in wait_uC state
       uc_wr_data0 <= 2'b11;
     else if ( /*i2c_slave_addr0 == `SLAVE_ADDR    &*/ current_st == WRITE_DAT1_ST && (wuc0 && ~wuc1) && byte_cnt < (num_bytes /*-(CMD_BYTE_WIDTH/8)*/ ) ) //wuc =1, Master in wait_uC state
       uc_wr_data0 <= 2'b11; //A write strobe during read sequence...
   
     else if ( read_p || current_st == RESTART_ST) //Strobe Write data Flags...
       uc_wr_data0 <=  2'b11;
     else
       uc_wr_data0 <= {uc_wr_data0[0],1'b0};
   
   assign uc_wr_data = uc_wr_data0[1];
   
   //I2c Read Strobe
   always @(posedge i2c_clk)
     if (rst)
       uc_rd_data0 <= 2'b00;
     else if (current_st == WRITE_DAT2_ST && (xfer_complete0 && ~xfer_complete1)  && byte_cnt < (num_bytes-(CMD_BYTE_WIDTH/8) +2) )
       uc_rd_data0 <= 2'b11;
     else
       uc_rd_data0 <= {uc_rd_data0[0],1'b0};

   assign uc_rd_data = uc_rd_data0[1];
   
   
   always @(posedge i2c_clk)
     if (rst)
       byte_cnt <= 8'h0;
     else if (current_st == WRITE_DAT0_ST)
       if (xfer_complete0 && ~xfer_complete1)
	 byte_cnt <= byte_cnt + 1;
       else
	 byte_cnt <= byte_cnt;
     else if (current_st == WRITE_DAT1_ST)
       if (xfer_complete0 && ~xfer_complete1)
	 byte_cnt <= byte_cnt + 1;
       else
	 byte_cnt <= byte_cnt;
     else if (current_st == WRITE_DAT2_ST)
       if (~xfer_complete0 && xfer_complete1)
	 byte_cnt <= byte_cnt + 1;
       else
	 byte_cnt <= byte_cnt;
     else 
       byte_cnt <= 8'h0;
   

   
   always @(posedge i2c_clk)
     if (rst)
       data_out0 <= 32'h0000_0000;
     else if (current_st == WRITE_DAT2_ST && (xfer_complete0 && ~xfer_complete1))
       data_out0 <= {MODR, data_out0[31:8]};

   

   assign     data_out = data_out0;
   
////////////////////
// Soft Reset.
////////////////////

   always @(posedge i2c_clk or posedge i2c_soft_rst)
     if (rst | i2c_soft_rst)
       soft_rst_reg <= 4'hf;
     else
       soft_rst_reg <= {soft_rst_reg[2:0], 1'b0};

   assign soft_rst = soft_rst_reg[3];


   /*AUTOASCIIENUM("current_st", "current_st_ascii", "_ST")*/
   // Beginning of automatic ASCII enum decoding
   reg [79:0]		current_st_ascii;	// Decode of current_st
   always @(current_st) begin
      case ({current_st})
	IDLE_ST:       current_st_ascii = "idle      ";
	START_GEN0_ST: current_st_ascii = "start_gen0";
	WRITE_DAT0_ST: current_st_ascii = "write_dat0";
	START_GEN1_ST: current_st_ascii = "start_gen1";
	WRITE_DAT1_ST: current_st_ascii = "write_dat1";
	RESTART_ST:    current_st_ascii = "restart   ";
	WRITE_DAT2_ST: current_st_ascii = "write_dat2";
	STOP_GEN_ST:   current_st_ascii = "stop_gen  ";
	DONE_ST:       current_st_ascii = "done      ";
	default:       current_st_ascii = "%Error    ";
      endcase
   end
   // End of automatics

endmodule // i2c_master_ctrl
////////////////////////////////////////////////////////////////////////////////
// Copyright (C) 2013-2020 Efinix Inc. All rights reserved.
//
// This   document  contains  proprietary information  which   is
// protected by  copyright. All rights  are reserved.  This notice
// refers to original work by Efinix, Inc. which may be derivitive
// of other work distributed under license of the authors.  In the
// case of derivative work, nothing in this notice overrides the
// original author's license agreement.  Where applicable, the
// original license agreement is included in it's original
// unmodified form immediately below this header.
//
// WARRANTY DISCLAIMER.
//     THE  DESIGN, CODE, OR INFORMATION ARE PROVIDED “AS IS” AND
//     EFINIX MAKES NO WARRANTIES, EXPRESS OR IMPLIED WITH
//     RESPECT THERETO, AND EXPRESSLY DISCLAIMS ANY IMPLIED WARRANTIES,
//     INCLUDING, WITHOUT LIMITATION, THE IMPLIED WARRANTIES OF
//     MERCHANTABILITY, NON-INFRINGEMENT AND FITNESS FOR A PARTICULAR
//     PURPOSE.  SOME STATES DO NOT ALLOW EXCLUSIONS OF AN IMPLIED
//     WARRANTY, SO THIS DISCLAIMER MAY NOT APPLY TO LICENSEE.
//
// LIMITATION OF LIABILITY.
//     NOTWITHSTANDING ANYTHING TO THE CONTRARY, EXCEPT FOR BODILY
//     INJURY, EFINIX SHALL NOT BE LIABLE WITH RESPECT TO ANY SUBJECT
//     MATTER OF THIS AGREEMENT UNDER TORT, CONTRACT, STRICT LIABILITY
//     OR ANY OTHER LEGAL OR EQUITABLE THEORY (I) FOR ANY INDIRECT,
//     SPECIAL, INCIDENTAL, EXEMPLARY OR CONSEQUENTIAL DAMAGES OF ANY
//     CHARACTER INCLUDING, WITHOUT LIMITATION, DAMAGES FOR LOSS OF
//     GOODWILL, DATA OR PROFIT, WORK STOPPAGE, OR COMPUTER FAILURE OR
//     MALFUNCTION, OR IN ANY EVENT (II) FOR ANY AMOUNT IN EXCESS, IN
//     THE AGGREGATE, OF THE FEE PAID BY LICENSEE TO EFINIX HEREUNDER
//     (OR, IF THE FEE HAS BEEN WAIVED, $100), EVEN IF EFINIX SHALL HAVE
//     BEEN INFORMED OF THE POSSIBILITY OF SUCH DAMAGES.  SOME STATES DO
//     NOT ALLOW THE EXCLUSION OR LIMITATION OF INCIDENTAL OR
//     CONSEQUENTIAL DAMAGES, SO THIS LIMITATION AND EXCLUSION MAY NOT
//     APPLY TO LICENSEE.
//
////////////////////////////////////////////////////////////////////////////////


////////////////////////////////////////////////////////////////////////////
//           _____       
//          / _______    Copyright (C) 2013-2020 Efinix Inc. All rights reserved.
//         / /       \   
//        / /  ..    /   `IP_MODULE_NAME(i2c_mstrslv_ctl).v
//       / / .'     /    
//    __/ /.'      /     Description:
//   __   \       /      i2c slave  
//  /_/ /\ \_____/ /     
// ____/  \_______/      
//
// *******************************
// Revisions:
// 1.0 Initial rev
//
// *******************************

/////////////////////////////////////////////////////////////////////////////////
`resetall
`timescale 1ns / 1ps

  
module `IP_MODULE_NAME(i2c_mstrslv_ctl)
  (
   //outputs 
   output [7:0] MBSR,             // I2C Status Register
   output reg [7:0] MODR,         // I2C Data Register outbound
   output reg sda_out,            // SDA output drive control
   output reg scl_out,             // SCL output drive control
   //inputs
   input [7:0] MBCR,              // I2C Control Register
   input [7:0] MADR,              // I2C Slave Address Register
   input [7:0] MIDR,              // I2C Data Register inbound
   input sda_in,                  // SDA input
   input scl_in,                  // SCL input
   input mbcr_wr,                 // MBCR is being written
   input uc_rd_data,              // Status uC read data register
   input uc_wr_data,              // Status uC wrote data register
   input mif_clr,                 // clear interrupt bit (mif)
   input mal_clr,                 // clear arbitration lost bit (mal)
   input clk                      // I2C state machine clock 2MHz/8MHz
  );
   

  //////////////////////////////////////
  // Internal parameters
  //////////////////////////////////////

   /////////////////////////////////////////////////////////////////////////////////////////
   // Timing:   Normal   Fast    (I2C Specification v2.1)
   // Fscl      100kHz   400kHz  SCL frequency
   // Th_scl    4.0us    0.6us   Min High period of SCL
   // Tl_scl    4.7us    1.3us   Min Low period of SCL
   // Thd:sta   4.0us    0.6us   Min hold time for a start condition
   // Tsu:sta   4.7us    0.6us   Min setup time for a repeated start condition
   // Tsu:dat   300ns    300ns   Min hold time for data
   // Tsu:sto   4.0us    0.6us   Min setup time for a stop conditon
   // Tbuf      4.7us    1.3us   Min Bus free time between a stop/start condition
   //////////////////////////////////////////////////////////////////////////////////////////
   
   // These are in units of 2MHz/8MHz clocks for 100kHz/400kHz operation
   parameter T_HIGH = 4'd5;      // high period of SCL (Th_scl)
                                 // (2 in HiE, *6 in Hi, 1 in LoE) = 9
   parameter T_LOW = 4'd9;       // low period of SCL (Tl_scl)
                                 // (*10 in Lo, 1 in HiE) = 11
   parameter T_HD_START = 4'd8;  // required start hold time (Thd:sta)
                                 // (*9 in Start) = 9
   parameter T_SU_START = 4'd10; // repeated start setup time (Tsu:sta)
                                 // (*11 in Hi) = 11
   parameter T_HD_DATA = 4'd3;   // required data hold time (Thd:dat)
                                 // (*4 in Lo) = 4
   parameter T_SU_STOP = 4'd6;   // required stop setup time (Tsu:sto)
                                 // (2 in HiE, *7 in Hi) = 9
   parameter T_BUF = 4'd8;       // bus free time between a STOP/START condition
                                 // (*9 in Stop wait, 1 in Idle, 1 in Start) = 11

 // SCL State machine defines, onehot bit positions
  parameter ST_SCL_IDLE       = 3'd0,
            ST_SCL_START      = 3'd1,
            ST_SCL_LOW_EDGE   = 3'd2,
            ST_SCL_WAIT_uC    = 3'd3,
            ST_SCL_LOW        = 3'd4,
            ST_SCL_HIGH_EDGE  = 3'd5,
            ST_SCL_HIGH       = 3'd6,
            ST_SCL_STOP_WAIT  = 3'd7;
    
  // I2C State machine defines, onehot bit positions
  parameter ST_I2C_IDLE       = 3'd0,
            ST_I2C_HEADER     = 3'd1,
            ST_I2C_ACK_HEADER = 3'd2,
            ST_I2C_RCV_DATA   = 3'd3,
            ST_I2C_ACK_DATA   = 3'd4,
            ST_I2C_XMIT_DATA  = 3'd5,
            ST_I2C_WAIT_ACK   = 3'd6,
            ST_I2C_STOP       = 3'd7;

  // Bit counter conditions
  parameter BYTE_CNT = 4'd7;
  parameter XFER_DONE = 4'd8;

  //////////////////////////////////////
  // Internal nodes
  //////////////////////////////////////
  
  // active high sync reset
  wire rst;

  // MBCR control register inputs
  wire men;
  wire mien;
  reg  mstaS1;
  reg  mstaS0;
  reg  msta;
  wire mtx;
  wire txak;
  wire rsta;
  wire rsv1;
  wire rsv0;

  // MBSR status register outputs
  reg  mcf;
  reg  maas;
  reg  mbbS0;
  reg  mbb;
  reg  mal;
  reg  wucS0;
  wire wuc;
  wire wuc_negedge;
  reg  srw;
  reg  mif;
  reg  rxak;
  
  reg  master;

  // edge detector signals
  wire sclPosedge;
  wire sclNegedge;
  wire mstaPosedge;
  wire mstaNegedge;
  
  reg  genStart;
  reg  detectStart;
  reg  detectStartS0;
  wire detectStartClr;
  
  reg  genStop;
  reg  detectStop;
  reg  detectStopS0;
  reg  detectStopS1;
  wire detect_stop_clr;
  
  reg  rep_start;
  reg  mbcr_wr1;         //   Latched version of mbcr_wr
  reg  mbcr_wr2;         //   synced version of mbcr_wr1
  reg  arb_lost;

  reg  [3:0] bitCount;
  reg  bitCountClr;
  
  reg  [3:0] mclkCount;
  reg  mclkCountClr;
  
  reg  [3:0] sclkCount;
  reg  sclkCountClr;

  reg  [7:0] mscl_state;
  reg  [7:0] mscl_next_state;
  reg  [7:0] sscl_state;
  reg  [7:0] sscl_next_state;

  reg  [7:0] i2c_state;
  reg  [7:0] i2c_next_state ;

  wire i2cHeaderEn;
  reg  [7:0] i2cHeader;
  wire addrMatch;
  
  reg  sdaInData;
  reg  sdaInS0;
  reg  sdaOutS0;
  reg  sdaOutNext;
  reg  sdaOutMaster;
  reg  sdaOutSlave;

  reg  sclInS0;
  reg  sclInS1;
  reg  sclOutNext;
  reg  sclOutSlave;

  wire shiftOut;
  wire shiftRegEn;
  wire shiftRegLd;
  reg  [7:0] shiftReg;

  wire forceUpdate;
  //DEBUG//
   reg 	 sdaIn_0,sdaIn_1;
   reg 	 sclIn_0;
   
  //////////////////////////////////////////////////////////////////////////////
  // Module definition
  // MBCR Control Register. 
  // Update I2C control signals from control register
  // NOTE: The MBCR register should be synchronized into this clk domain.
  ///////////////////////////////////////////////////////////////////////////////
  assign men  = MBCR[7]; // I2C controller enable
  assign mien = MBCR[6]; // Interrupt enable 
  
  // Create a version of msta that gets reset if we loose arbitration
  always @ (posedge clk)
    if (rst | arb_lost)
      msta <= 1'b0;      // Master=1, Slave=0
    else if (mbcr_wr1)
      msta <= MBCR[5];   // Master/Slave mode Select
    
  assign mtx  = MBCR[4]; // Transmit/Receive mode: 0=rx, 1=tx
  assign txak = MBCR[3]; // Transmit Acknowledge: 0=ack, 1=noack
  assign rsta = MBCR[2]; // Repeated Start
  assign rsv1 = MBCR[1]; // Reserved
  assign rsv0 = MBCR[0]; // Reserved

  // Create sync active high reset when the I2C controller is disabled
  assign rst = ~men;

  //////////////////////////////////////////////////////////////////////////////
  // SCL posedge/negedge detection & synchronization mechanism. 
  //////////////////////////////////////////////////////////////////////////////
  always @ (posedge clk)
    if (rst)
      sclInS0 <= 1'b1;
    else
      sclInS0 <= scl_in;

  always @ (posedge clk)
    if (rst)
      sclInS1 <= 1'b1;
    else
      sclInS1 <= sclInS0;

  assign sclPosedge = (~sclInS1 & sclInS0);
  assign sclNegedge = (sclInS1 & ~sclInS0);

  //////////////////////////////////////////////////////////////////////////////
  // Master/Slave Mode selection latch.
  // msta posedge/negedge detection & synchronization
  /////////////////////////////////////////////////////////////////////////////
  always @ (posedge clk)
    if (rst)
      mstaS0 <= 1'b0;
    else
      mstaS0 <= msta;

  always @ (posedge clk)
    if (rst)
      mstaS1 <= 1'b0;
    else
      mstaS1 <= mstaS0;

  assign mstaPosedge = (~mstaS1 & mstaS0);
  assign mstaNegedge = (mstaS1 & ~mstaS0);
  
  //////////////////////////////////////////////////////////////////////////////
  // Generate start condition based on rising edge of msta. 
  //////////////////////////////////////////////////////////////////////////////
  always @ (posedge clk)
    if (rst)
      genStart <= 1'b0;
    else if (mstaPosedge)
      genStart <= 1'b1;
    else if (detectStartS0)
      genStart <= 1'b0;

  ////////////////////////////////////////////////
  // I2c Start condition. 
  // Start condition detection & synchronization
  /////////////////////////////////////////////////
  assign detectStartClr = (rst | i2c_state[ST_I2C_HEADER]);

  always @ (negedge sdaIn_1 or posedge detectStartClr)
    if (detectStartClr)
      detectStart <= 1'b0;
    else
      detectStart <= sclIn_0;

  always @ (posedge clk)
    if (rst)
      detectStartS0 <= 1'b0;
    else
      detectStartS0 <= detectStart;
    
  //////////////////////////////////////////////////////////////////////////////
  // Generate stop condition - falling edge of MSTA or i2c state machine
  // requested stop and arbitration was not lost 
  //////////////////////////////////////////////////////////////////////////////
  always @ (posedge clk)
    if (rst)
      genStop <= 1'b0;
    else if ((mstaNegedge || i2c_state[ST_I2C_STOP]) && ~arb_lost)
      genStop <= 1'b1;
    else if (detectStopS0)
      genStop <= 1'b0;
    
  // Stop condition detect & synchronization
  assign detect_stop_clr = (rst | detectStartS0);



   always @(posedge clk)
     begin
	sdaIn_0 <= sda_in; 
     end

   always @(posedge clk)
     if (rst)
       sdaIn_1 <= 1'b1;
     else if (sdaIn_0 & sda_in)
       sdaIn_1 <= 1'b1;
     else if (~sdaIn_0 & ~sda_in)
       sdaIn_1 <= 1'b0;  

   
   
   always @(posedge clk)
     begin
	sclIn_0 <= scl_in;
     end

   ///////////////////////////////
   //Detect Stop Condition.
   ///////////////////////////////
   always @ (posedge sdaIn_1 or posedge detect_stop_clr)
     if (detect_stop_clr)
       detectStop <= 1'b0;
     else
       detectStop <= sclIn_0;
   
   always @ (posedge clk)
     if (rst)
       detectStopS0 <= 1'b0;
     else
       detectStopS0 <= detectStop;
   
   always @ (posedge clk)
     if (rst)
       detectStopS1 <= 1'b0;
     else
       detectStopS1 <= detectStopS0;
   
  //////////////////////////////////////////////////////////////////////////////
  // Master/Slave mode detection
  //////////////////////////////////////////////////////////////////////////////
  always @ (posedge clk)
    if (rst)
      master <= 1'b0;
    else if (~mbb) // bus not busy
      master <= msta;

  //////////////////////////////////////////////////////////////////////////////
  // SCL/SDA Generation state machine (Master Mode)                           //
  //////////////////////////////////////////////////////////////////////////////
  always @ (posedge clk)
    if (rst)
      mscl_state <= 8'h01;
    else
      mscl_state <= mscl_next_state;

   //////////////////////////////
   // Create SDA Master data
   // Shift Serial Data Out.
   //////////////////////////////

  always @ (posedge clk)
    if (rst)
      sdaOutMaster <= 1'b1;
    else if (i2c_state[ST_I2C_HEADER] || i2c_state[ST_I2C_XMIT_DATA])
      sdaOutMaster <= shiftOut;
    else if (i2c_state[ST_I2C_ACK_DATA])
      sdaOutMaster <= txak;
    else
      sdaOutMaster <= 1'b1;

 
  always @ (posedge clk)
    if (rst)
      mclkCount <= 4'd0;
    else if (mclkCountClr)
      mclkCount <= 4'd0;
    else
      mclkCount <= mclkCount + 1;

  always @ (posedge clk)
    if (rst)
      sda_out <= 1'b1;
    else
      sda_out <= (master) ? sdaOutNext : sdaOutSlave;

  always @ (posedge clk)
    if (rst)
      scl_out <= 1'b1;
    else
      scl_out <= (master) ? sclOutNext : sclOutSlave;

   ///////////////////////////////////
   //MASTER I2c
   //SCL, and SDA transitions
   ///////////////////////////////////
   always @(*)
     begin
	//defaults 
	mscl_next_state = 8'h00;
	mclkCountClr = 1'b1; // clear or disable clock counter
	sclOutNext = 1'b1;
	sdaOutNext = sda_out;
	
	case (1'b1)
	  mscl_state[ST_SCL_IDLE] :
            begin
               sdaOutNext = 1'b1;
               // leave idle when master mode and bus not busy
               if (master & ~mbb & genStart)
		 mscl_next_state[ST_SCL_START] = 1'b1;
               else
		 mscl_next_state[ST_SCL_IDLE] = 1'b1;
            end
	  
	  mscl_state[ST_SCL_START] :
            begin
               mclkCountClr = 1'b0; // enable clock count
               sdaOutNext = 1'b0;
               if (mclkCount == T_HD_START)
		 mscl_next_state[ST_SCL_LOW_EDGE] = 1'b1;
               else
		 mscl_next_state[ST_SCL_START] = 1'b1;
            end
	  
	  mscl_state[ST_SCL_LOW_EDGE] :
            begin
               sclOutNext = 1'b0;
               if (i2c_state[ST_I2C_ACK_DATA] ||
		   i2c_state[ST_I2C_ACK_HEADER] ||
		   i2c_state[ST_I2C_WAIT_ACK])
		 mscl_next_state[ST_SCL_WAIT_uC] = 1'b1;
               else
		 mscl_next_state[ST_SCL_LOW] = 1'b1;
            end
	  
	  mscl_state[ST_SCL_WAIT_uC] :
            begin
               sclOutNext = 1'b0;
               if (genStop | uc_rd_data | uc_wr_data)
		 mscl_next_state[ST_SCL_LOW] = 1'b1;
               else
		 mscl_next_state[ST_SCL_WAIT_uC] = 1'b1;
            end
	  
	  mscl_state[ST_SCL_LOW] :
            begin
               mclkCountClr = 1'b0; // enable clk count
               sclOutNext = 1'b0;
               // Wait the required SDA hold time
               if (mclkCount >= T_HD_DATA)
		 begin
		    if (genStop)
                      sdaOutNext = 1'b0;
		    else if (rep_start | arb_lost)
                      sdaOutNext = 1'b1;
		    else
                      sdaOutNext = sdaOutMaster;
		 end
               // Wait the required SCL low time
               if (mclkCount == T_LOW)
		 begin
		    if ((bitCount == BYTE_CNT) && arb_lost)
                      mscl_next_state[ST_SCL_IDLE] = 1'b1;
		    else
                      mscl_next_state[ST_SCL_HIGH_EDGE] = 1'b1;
		 end
               else
		 mscl_next_state[ST_SCL_LOW] = 1'b1;
            end
	  
	  mscl_state[ST_SCL_HIGH_EDGE] :
            begin
               // Check for clock stretching
               if (sclInS0)
		 mscl_next_state[ST_SCL_HIGH] = 1'b1;
               else
		 mscl_next_state[ST_SCL_HIGH_EDGE] = 1'b1;
            end
	  
	  mscl_state[ST_SCL_HIGH] :
            begin
               mclkCountClr = 1'b0; // enable clk count
               // Check for generate stop condition
               if (genStop)
		 begin
		    if (mclkCount == T_SU_STOP)
                      begin
			 mclkCountClr = 1'b1; // clear/disable clk count
			 sdaOutNext = 1'b1;
			 mscl_next_state[ST_SCL_STOP_WAIT] = 1'b1;
                      end
		    else
                mscl_next_state[ST_SCL_HIGH] = 1'b1;
		 end
               // Check for repeated start
               else if (rep_start)
		 begin
		    if (mclkCount == T_SU_START)
                      begin
			 mclkCountClr = 1'b1; // clear/disable clk count
			 mscl_next_state[ST_SCL_START] = 1'b1;
                      end
		    else
                      mscl_next_state[ST_SCL_HIGH] = 1'b1;
		 end
               // Wait the required SCL high time
               else if (mclkCount == T_HIGH)
		 mscl_next_state[ST_SCL_LOW_EDGE] = 1'b1;
               else
		 mscl_next_state[ST_SCL_HIGH] = 1'b1;
            end
	  
	  mscl_state[ST_SCL_STOP_WAIT] :
            begin
               mclkCountClr = 1'b0; // enable clk count
               // Wait the required bus free time
               if (mclkCount == T_BUF) 
		 mscl_next_state[ST_SCL_IDLE] = 1'b1;
               else
		 mscl_next_state[ST_SCL_STOP_WAIT] = 1'b1;
            end
	endcase
     end // always @ (*)
   
  
  //////////////////////////////////////////////////////////////////////////////
  // I2C Slave Mode 
  // SCL/SDA Generation state machine                            
  //////////////////////////////////////////////////////////////////////////////
   always @ (posedge clk)
     if (rst)
       sscl_state <= 8'h01;
     else
       sscl_state <= sscl_next_state;
   
  //Shift the slave data. 
   always @ (posedge clk)
     if (rst)
       sdaOutSlave <= 1'b1;
     else if (i2c_state[ST_I2C_XMIT_DATA])
       sdaOutSlave <= shiftOut;
     else if ((addrMatch && i2c_state[ST_I2C_ACK_HEADER]) || i2c_state[ST_I2C_ACK_DATA])
       sdaOutSlave <= txak;
     else
       sdaOutSlave <= 1'b1;
   
  always @ (posedge clk)
    if (rst)
      sclkCount <= 4'd0;
    else if (sclkCountClr)
      sclkCount <= 4'd0;
    else
      sclkCount <= sclkCount + 1;


   /////////////////////////////////////////
   // I2C Slave Controller FSM.
   /////////////////////////////////////////
   always @ (*)
     begin
	// Set defaults
	sscl_next_state = 8'h00;
	sclkCountClr = 1'b1; // clear/disable clk counter
	sclOutSlave = 1'b1;
	
	case (1'b1)
	  sscl_state[ST_SCL_IDLE] :
            begin
               // leave idle when slave mode and SCL negedge
               if (~master && sclNegedge &&
		   ((i2c_state[ST_I2C_ACK_HEADER] && addrMatch && i2cHeader[0]) ||
		    i2c_state[ST_I2C_ACK_DATA] ||
		    (i2c_state[ST_I2C_WAIT_ACK] && ~sdaInData)))
		 sscl_next_state[ST_SCL_WAIT_uC] = 1'b1;
               else
		 sscl_next_state[ST_SCL_IDLE] = 1'b1;
            end
          
	  sscl_state[ST_SCL_WAIT_uC] :
            begin
               sclOutSlave = 1'b0; // Clock Stretch
               if (uc_rd_data || i2c_state[ST_I2C_IDLE])
		 sscl_next_state[ST_SCL_IDLE] = 1'b1;
               else if (uc_wr_data)
		 sscl_next_state[ST_SCL_STOP_WAIT] = 1'b1;
               else
		 sscl_next_state[ST_SCL_WAIT_uC] = 1'b1;
            end
	  
	  sscl_state[ST_SCL_STOP_WAIT] :
            begin
               sclOutSlave = 1'b0; // Maintain Clock Stretch
               sclkCountClr = 1'b0; // enable clk count
               // Wait the required data setup time
               if (sclkCount == T_HD_DATA) 
		 sscl_next_state[ST_SCL_IDLE] = 1'b1;
               else
		 sscl_next_state[ST_SCL_STOP_WAIT] = 1'b1;
            end
	  
	  default : sscl_next_state[ST_SCL_IDLE] = 1'b1;
	endcase
     end
   
   //////////////////////////////////////////////////////////////////////////////
   // I2C main state machine (Master/Slave Mode)                               //
   //////////////////////////////////////////////////////////////////////////////
   always @ (posedge clk)
     if (rst | detectStopS0)
       i2c_state <= 8'h01;
     else if (sclNegedge) // updates on negedge SCL
       i2c_state <= i2c_next_state;
   
   // Create bit counter, counter increments on negedge of SCL
   always @ (posedge clk)
     if (rst)
       bitCount <= 4'd0;
     else if (bitCountClr & sclNegedge)
       bitCount <= 4'd0;
     else if (sclNegedge)
       bitCount <= bitCount + 1;
   
   // Sample valid SDA data on posedge SCL
   always @ (posedge clk)
     if (rst)
       sdaInData <= 1'b1;
     else if (sclPosedge)
       sdaInData <= sda_in;

   /////////////////////////////////////
   //I2c Main State - FSM
   /////////////////////////////////////
   always @ (*)
     begin
	// Set defaults
	i2c_next_state = 8'h00;
	bitCountClr = 1'b1; // clear/disable bit counter
	
	case (1'b1)
	  i2c_state[ST_I2C_IDLE] :
            begin
               if (detectStartS0)
		 i2c_next_state[ST_I2C_HEADER] = 1'b1;
               else
		 i2c_next_state[ST_I2C_IDLE] = 1'b1;
            end
	  
	  i2c_state[ST_I2C_HEADER] :
            begin
               bitCountClr = 1'b0; // enable bit count
               if (detectStopS0)
		 i2c_next_state[ST_I2C_IDLE] = 1'b1;
               else if (bitCount == BYTE_CNT)
		 i2c_next_state[ST_I2C_ACK_HEADER] = 1'b1;
               else
		 i2c_next_state[ST_I2C_HEADER] = 1'b1;
            end
	  
	  i2c_state[ST_I2C_ACK_HEADER] :
            begin
               if (arb_lost | detectStopS0)
		 i2c_next_state[ST_I2C_IDLE] = 1'b1;
               // ack has been received, check for master/slave
               else if (~sdaInData)
		 begin
		    // master mode, check mtx bit for direction
		    if (master)
                      begin
			 if (mtx)
			   i2c_next_state[ST_I2C_XMIT_DATA] = 1'b1;
			 else
			   i2c_next_state[ST_I2C_RCV_DATA] = 1'b1;
                      end
		    // slave mode, check for an address match
		    else if (addrMatch)
                      begin
			 if (i2cHeader[0])
			   i2c_next_state[ST_I2C_XMIT_DATA] = 1'b1;
			 else
			   i2c_next_state[ST_I2C_RCV_DATA] = 1'b1;
                      end
		    // not addressed, go back to IDLE
		    else
                      i2c_next_state[ST_I2C_IDLE] = 1'b1;
		 end
               // no ack received, generate stop if master
               else
		 begin
		    if (master)
                      i2c_next_state[ST_I2C_STOP] = 1'b1;
		    else
                      i2c_next_state[ST_I2C_IDLE] = 1'b1;
		 end
            end
	  
      i2c_state[ST_I2C_RCV_DATA] :
        begin
           if ((rep_start && master) || detectStartS0)
             bitCountClr = 1'b1; // disable bit count
           else
             bitCountClr = 1'b0; // enable bit count
	   
          if (detectStopS0)
            i2c_next_state[ST_I2C_IDLE] = 1'b1;
          else if ((rep_start && master) || detectStartS0)
            i2c_next_state[ST_I2C_HEADER] = 1'b1;
          else if (bitCount == BYTE_CNT)
            i2c_next_state[ST_I2C_ACK_DATA] = 1'b1; // Send an acknowledge
          else
            i2c_next_state[ST_I2C_RCV_DATA] = 1'b1;
        end
          
	  i2c_state[ST_I2C_ACK_DATA] :
            begin
               if (detectStopS0)
		 i2c_next_state[ST_I2C_IDLE] = 1'b1;
               else
		 i2c_next_state[ST_I2C_RCV_DATA] = 1'b1;
            end
	  
	  i2c_state[ST_I2C_XMIT_DATA] :
            begin
               if ((rep_start && master) || detectStartS0)
		 bitCountClr = 1'b1; // disable bit count
               else
		 bitCountClr = 1'b0; // enable bit count
	       
               if (detectStopS0)
		 i2c_next_state[ST_I2C_IDLE] = 1'b1;
               else if ((rep_start && master) || detectStartS0)
		 i2c_next_state[ST_I2C_HEADER] = 1'b1;
               else if (bitCount == BYTE_CNT)
		 i2c_next_state[ST_I2C_WAIT_ACK] = 1'b1; // Wait for acknowledge
               else
		 i2c_next_state[ST_I2C_XMIT_DATA] = 1'b1;
            end
	  
	  i2c_state[ST_I2C_WAIT_ACK] :
            begin
               if (arb_lost | detectStopS0)
		 i2c_next_state[ST_I2C_IDLE] = 1'b1;
               // ack has been received, transmit next byte
               else if (~sdaInData)
		 i2c_next_state[ST_I2C_XMIT_DATA] = 1'b1;
               // no ack received, generate a stop if master
               else
		 begin
		    if (master)
                      i2c_next_state[ST_I2C_STOP] = 1'b1;
		    else
                      i2c_next_state[ST_I2C_IDLE] = 1'b1;
		 end
            end
	  
	  i2c_state[ST_I2C_STOP] : i2c_next_state[ST_I2C_IDLE] = 1'b1;
	endcase
     end
   
   //////////////////////////////////////////////////////////////////////////////
   // I2C Header/Address Shift Register
   //
  assign i2cHeaderEn = (detectStartS0 || i2c_state[ST_I2C_HEADER]);

  always @ (posedge clk)
    if (rst)
      i2cHeader <= 8'd0;
    else if (i2cHeaderEn & sclNegedge)
      i2cHeader <= {i2cHeader[6:0], sdaInData};

  assign addrMatch = (i2cHeader[7:1] == MADR[7:1]);
      
  //////////////////////////////////////////////////////////////////////////////
  // I2C Data Shift Register
  //
  assign forceUpdate = (uc_wr_data &&
                        (mscl_state[ST_SCL_WAIT_uC] || sscl_state[ST_SCL_WAIT_uC]));
  assign shiftRegLd  = ((i2c_state[ST_I2C_IDLE] && master) ||
                        i2c_state[ST_I2C_WAIT_ACK] ||
                        (i2c_state[ST_I2C_ACK_HEADER] && i2cHeader[0] && ~master) ||
                        (i2c_state[ST_I2C_ACK_HEADER] && mtx && master));
  assign shiftRegEn  = ((i2c_state[ST_I2C_HEADER] && master) ||
                        ((i2c_state[ST_I2C_RCV_DATA] || i2c_state[ST_I2C_XMIT_DATA]) && 
                         !(rep_start || detectStartS0)));

  // Microcontroller inbound data load, and shift register
  always @ (posedge clk)
    if (rst)
      shiftReg <= 8'd0;
    else if ((shiftRegLd & sclNegedge) | forceUpdate)
      shiftReg <= MIDR; // sample inbound data reg
    else if (shiftRegEn & sclNegedge)
      shiftReg <= {shiftReg[6:0], sdaInData};

  assign shiftOut = shiftReg[7];

  // Microcontroller outbound data
  always @ (posedge clk)
    if (rst)
      MODR <= 8'd0;
    else if (i2c_state[ST_I2C_ACK_DATA] || i2c_state[ST_I2C_WAIT_ACK])
      MODR <= shiftReg; // update outbound data reg

  //////////////////////////////////////////////////////////////////////////////
  // Arbitration Loss Detection 
  //
  // #1 It checks the master's outgoing SDA with the incoming SDA to
  // determine if control of the bus has been lost. When SCL is high, SDA is checked only
  // within  states IDLE, HEADER, XMIT_DATA, ACK_DATA and in
  // master mode. 
  // #2 When arbitration is lost, a reset is generated for the MSTA
  // bit. 
  // #3 When arbitration is lost, the mode is switched to slave and
  // SCL continues to be generated until the byte transfer is complete arb_lost
  // stays set until scl state machine goes to the IDLE state
  //
  always @ (posedge clk)
    if (rst || mscl_state[ST_SCL_IDLE])
      arb_lost <= 1'b0;
    else if (master && ~arb_lost && scl_in && sclInS0 &&
             (i2c_state[ST_I2C_IDLE] || i2c_state[ST_I2C_HEADER] ||
              i2c_state[ST_I2C_XMIT_DATA] || i2c_state[ST_I2C_ACK_DATA]))
      begin
	 if (sdaOutS0 == sdaInS0)
           arb_lost <= 1'b0;	 
         else
           arb_lost <= 1'b0; 
      end
   
  // sample SDA in
  always @ (posedge clk)
    if (rst)
      sdaInS0 <= 1'b1;
    else
      sdaInS0 <= sda_in;
  
  // sample SDA out
  always @ (posedge clk)
    if (rst)
      sdaOutS0 <= 1'b1;
    else
      sdaOutS0 <= sda_out;
   
  /////////////////////////////
  //I2c Status Register 
  assign MBSR[7] = mcf;  // Data transfering bit
                         // '1' - transfer is complete
                         // '0' - transfer in progress. 
  assign MBSR[6] = maas; // Addressed as Slave bit
  assign MBSR[5] = mbb;  // Bus Busy bit
                         // '1' indicates the bus is busy
                         // '0' indicates the bus is idle. 
  assign MBSR[4] = mal;  // Arbitration lost
                         // This bit is set by microcontroller when arbitration loss.
  assign MBSR[3] = wuc;  // Wait microcontroller
  assign MBSR[2] = srw;  // Slave Read/Write bit
  assign MBSR[1] = mif;  // Interrupt bit
  assign MBSR[0] = rxak; // Receive Acknowledge bit

  // MCF - Data transferring bit
  // While one byte of data is being transferred, this bit is cleared. It 
  // is set by the falling edge of the 9th clock of a byte transfer.
  always @ (posedge clk)
    if (rst)
      mcf <= 1'b0;
    else if ((bitCount == XFER_DONE) && (sclNegedge))
      mcf <= 1'b1;
    else if (wuc_negedge) // exiting WAIT_uC state
      mcf <= 1'b0;

  // MAAS - Addressed As Slave Bit
  // When its own specific address (MADR) matches the I2C Address, this bit 
  // is set. The CPU is interrupted provided the MIEN is set. Then the CPU 
  // needs to check the SRW bit and set its TX-RX mode accordingly. Writing 
  // to the MBCR clears this bit
  always @ (posedge clk)
    if (rst | mbcr_wr)
      maas <= 1'b0;
    else if (i2c_state[ST_I2C_ACK_HEADER])
      maas <= addrMatch;
  //  
  // Latch the fact that there was a write to the mbcr
  always @( negedge (mbcr_wr) or posedge (mbcr_wr2) or posedge (rst) )
  begin
    if (mbcr_wr2 || rst)
      mbcr_wr1 <= 1'b0;
    else
      mbcr_wr1 <= 1'b1;
  end

  // Sync the latched mbcr to the clock and use this
  // signal to reset the latch thus creating a mbcr_wr2
  // which is one clock pulse wide and occurs once
  // every time the mbcr is written to.
  always @( posedge (clk) )
  begin
    if (rst)
      mbcr_wr2 <= 1'b0;
    else
      mbcr_wr2 <= mbcr_wr1;
  end

  // Set the rep_start signal true whenever the mbcr is
  // written to with the rsta bit set. This signal is
  // cleared when we reach the header state, stop is detected
  // or arbitration ois lost.
  always @( posedge (clk) )
  begin
    if (detectStartClr || mal)
      rep_start <= 1'b0;
    else
    begin
      if (mbcr_wr2 && rsta) // rsta was set last time mbcr was written
        rep_start <= 1'b1;
      else if (detectStopS0)
        rep_start <= 1'b0;
    end
  end
  

  // MBB - Bus Busy Bit
  // This bit indicates the status of the bus. This bit is set when a 
  // START signal is detected and cleared when a stop signal is detected. 
  // It is also cleared on reset.
  always @ (posedge clk)
    if (rst)
      mbb <= 1'b0;
    else if (detectStartS0)
      mbb <= 1'b1;
    else if (detectStopS0)
      mbb <= 1'b0;
    
  // sample mbb
  always @ (posedge clk)
    if (rst)
      mbbS0 <= 1'b0;
    else
      mbbS0 <= mbb;

  // MAL - Arbitration Lost Bit
  // This bit is set when the arbitration procedure is lost. Arbitration 
  // is lost when:
  //      1. SDA is sampled low when the master drives high during addr or 
  //         data transmit cycle
  //      2. SDA is sampled low when the master drives high during the 
  //         acknowledge bit of a data receive cycle
  //      3. A start cycle is attempted when the bus is busy
  //      4. A repeated start is requested in slave mode
  //      5. A stop condition is detected when the master did not requested.
 
  always @ (posedge clk)
    if (rst | mal_clr)
      mal <= 1'b0;
    else if (master)
      begin
        if ((arb_lost) ||                // Condition 1,2 above
            (mbbS0 && genStart) ||      // Condition 3 above
            (detectStopS0 && !detectStopS1 && !genStop)) // Condition 5 above
          mal <= 1'b1;
      end
    else if (rep_start) // Condition 4 above
      mal <= 1'b1;

  // WUC - Wait microcontroller. 
  // This bit is set when waiting on the microcontroller to read/write to the data
  // register MBDR.
  assign wuc = (mscl_state[ST_SCL_WAIT_uC] || sscl_state[ST_SCL_WAIT_uC]);

  // sample wuc
  always @ (posedge clk)
    if (rst)
      wucS0 <= 1'b0;
    else
      wucS0 <= wuc;

  assign wuc_negedge = (wucS0 & ~wuc);
                        
  // SRW - Slave Read/Write Bit
  // When MAAS is set, SRW indicates the value of the R/W command bit of 
  // the calling address sent from the master. This bit is only valid when 
  // a complete transfer has occurred and no other transfers have been 
  // initiated. The CPU uses this bit to set the slave transmit/receive mode.
  always @ (posedge clk)
    if (rst)
      srw <= 1'b0;
    else if (i2c_state[ST_I2C_ACK_HEADER] && addrMatch)
      srw <= i2cHeader[0];

  // MIF - M-bus Interrupt
  // The MIF bit is set when an interrupt is pending, which causes a 
  // processor interrupt request provided MIEN is set. MIF is set when:
  //      1. Byte transfer is complete (set at the falling edge of the 9th clock
  //      2. MAAS is set when in slave receive mode
  //      3. Arbitration is lost
  // This bit is cleared by reset and software writting a '0'to it.
  always @ (posedge clk)
    if (rst | mif_clr)
      mif <= 1'b0;
    else if (mien && (mcf || (maas && ~i2cHeader[0] && ~master) || mal))
      mif <= 1'b1;

  // RXAK - Received Acknowledge
  // RXAK contains the value of SDA during the acknowledge bit of a bus 
  // cycle. If =0, then an acknowledge signal has been received, if 1, 
  // then no acknowledge has been received.  This bit is set at reset.
  always @ (posedge clk)
    if (rst)
      rxak <= 1'b1;  // Reset to no ack state
    else if ((i2c_state[ST_I2C_ACK_HEADER] ||
              i2c_state[ST_I2C_ACK_DATA] ||
              i2c_state[ST_I2C_WAIT_ACK]) &&
             sclNegedge)
      rxak <= sdaInData;

endmodule 
////////////////////////////////////////////////////////////////////////////////
// Copyright (C) 2013-2020 Efinix Inc. All rights reserved.
//
// This   document  contains  proprietary information  which   is
// protected by  copyright. All rights  are reserved.  This notice
// refers to original work by Efinix, Inc. which may be derivitive
// of other work distributed under license of the authors.  In the
// case of derivative work, nothing in this notice overrides the
// original author's license agreement.  Where applicable, the
// original license agreement is included in it's original
// unmodified form immediately below this header.
//
// WARRANTY DISCLAIMER.
//     THE  DESIGN, CODE, OR INFORMATION ARE PROVIDED “AS IS” AND
//     EFINIX MAKES NO WARRANTIES, EXPRESS OR IMPLIED WITH
//     RESPECT THERETO, AND EXPRESSLY DISCLAIMS ANY IMPLIED WARRANTIES,
//     INCLUDING, WITHOUT LIMITATION, THE IMPLIED WARRANTIES OF
//     MERCHANTABILITY, NON-INFRINGEMENT AND FITNESS FOR A PARTICULAR
//     PURPOSE.  SOME STATES DO NOT ALLOW EXCLUSIONS OF AN IMPLIED
//     WARRANTY, SO THIS DISCLAIMER MAY NOT APPLY TO LICENSEE.
//
// LIMITATION OF LIABILITY.
//     NOTWITHSTANDING ANYTHING TO THE CONTRARY, EXCEPT FOR BODILY
//     INJURY, EFINIX SHALL NOT BE LIABLE WITH RESPECT TO ANY SUBJECT
//     MATTER OF THIS AGREEMENT UNDER TORT, CONTRACT, STRICT LIABILITY
//     OR ANY OTHER LEGAL OR EQUITABLE THEORY (I) FOR ANY INDIRECT,
//     SPECIAL, INCIDENTAL, EXEMPLARY OR CONSEQUENTIAL DAMAGES OF ANY
//     CHARACTER INCLUDING, WITHOUT LIMITATION, DAMAGES FOR LOSS OF
//     GOODWILL, DATA OR PROFIT, WORK STOPPAGE, OR COMPUTER FAILURE OR
//     MALFUNCTION, OR IN ANY EVENT (II) FOR ANY AMOUNT IN EXCESS, IN
//     THE AGGREGATE, OF THE FEE PAID BY LICENSEE TO EFINIX HEREUNDER
//     (OR, IF THE FEE HAS BEEN WAIVED, $100), EVEN IF EFINIX SHALL HAVE
//     BEEN INFORMED OF THE POSSIBILITY OF SUCH DAMAGES.  SOME STATES DO
//     NOT ALLOW THE EXCLUSION OR LIMITATION OF INCIDENTAL OR
//     CONSEQUENTIAL DAMAGES, SO THIS LIMITATION AND EXCLUSION MAY NOT
//     APPLY TO LICENSEE.
//
////////////////////////////////////////////////////////////////////////////////


////////////////////////////////////////////////////////////////////////////
//           _____       
//          / _______    Copyright (C) 2013-2020 Efinix Inc. All rights reserved.
//         / /       \   
//        / /  ..    /   `IP_MODULE_NAME(pulse_gen).v
//       / / .'     /    
//    __/ /.'      /     Description:
//   __   \       /      Pulse Generation 
//  /_/ /\ \_____/ /     
// ____/  \_______/      
//
// *******************************
// Revisions:
// 1.0 Initial rev
//
// *******************************

/////////////////////////////////////////////////////////////////////////////////
`resetall
`timescale 1ns / 1ps


module `IP_MODULE_NAME(pulse_gen)
    (
     //outputs.
     output reg data_out,     //slow clock signal

     //inputs
     input 	clk,           //system clock
     input 	rst,           //active high reset. 
     input 	data_in        //fast clock signal
     );
//Parameters
   parameter DETECT_POS = 1;
   
//Internal Signals
   wire 	async_set;
   reg [1:0] 	data0;
   reg [2:0] 	data_sync;
   
   wire 	data_sync_pos;
   
   assign async_set = data_in;
   
   always @(posedge clk or posedge async_set)
     if (async_set)
       data0 <= 2'b11;   
     else if (rst)
       data0 <= 2'b0;
     else
       data0 <= {data0[0],1'b0};
   

   always @(posedge clk)
     if (rst)
       data_sync <= 3'b00;
     else
       data_sync <= {data_sync[1:0],data0[1]};

   generate
      if (DETECT_POS == 1)
	assign data_sync_pos = ~data_sync[2] && data_sync[1];
      else
	assign data_sync_pos = ~data_sync[1] && data_sync[2];
   endgenerate
   
   always @(posedge clk)
     if (rst)
       data_out <= 1'b0;
     else if (data_sync_pos)
       data_out <= 1'b1;
     else
       data_out <= 1'b0;
   
   
endmodule // pulse_gen_fts
////////////////////////////////////////////////////////////////////////////////
// Copyright (C) 2013-2020 Efinix Inc. All rights reserved.
//
// This   document  contains  proprietary information  which   is
// protected by  copyright. All rights  are reserved.  This notice
// refers to original work by Efinix, Inc. which may be derivitive
// of other work distributed under license of the authors.  In the
// case of derivative work, nothing in this notice overrides the
// original author's license agreement.  Where applicable, the
// original license agreement is included in it's original
// unmodified form immediately below this header.
//
// WARRANTY DISCLAIMER.
//     THE  DESIGN, CODE, OR INFORMATION ARE PROVIDED “AS IS” AND
//     EFINIX MAKES NO WARRANTIES, EXPRESS OR IMPLIED WITH
//     RESPECT THERETO, AND EXPRESSLY DISCLAIMS ANY IMPLIED WARRANTIES,
//     INCLUDING, WITHOUT LIMITATION, THE IMPLIED WARRANTIES OF
//     MERCHANTABILITY, NON-INFRINGEMENT AND FITNESS FOR A PARTICULAR
//     PURPOSE.  SOME STATES DO NOT ALLOW EXCLUSIONS OF AN IMPLIED
//     WARRANTY, SO THIS DISCLAIMER MAY NOT APPLY TO LICENSEE.
//
// LIMITATION OF LIABILITY.
//     NOTWITHSTANDING ANYTHING TO THE CONTRARY, EXCEPT FOR BODILY
//     INJURY, EFINIX SHALL NOT BE LIABLE WITH RESPECT TO ANY SUBJECT
//     MATTER OF THIS AGREEMENT UNDER TORT, CONTRACT, STRICT LIABILITY
//     OR ANY OTHER LEGAL OR EQUITABLE THEORY (I) FOR ANY INDIRECT,
//     SPECIAL, INCIDENTAL, EXEMPLARY OR CONSEQUENTIAL DAMAGES OF ANY
//     CHARACTER INCLUDING, WITHOUT LIMITATION, DAMAGES FOR LOSS OF
//     GOODWILL, DATA OR PROFIT, WORK STOPPAGE, OR COMPUTER FAILURE OR
//     MALFUNCTION, OR IN ANY EVENT (II) FOR ANY AMOUNT IN EXCESS, IN
//     THE AGGREGATE, OF THE FEE PAID BY LICENSEE TO EFINIX HEREUNDER
//     (OR, IF THE FEE HAS BEEN WAIVED, $100), EVEN IF EFINIX SHALL HAVE
//     BEEN INFORMED OF THE POSSIBILITY OF SUCH DAMAGES.  SOME STATES DO
//     NOT ALLOW THE EXCLUSION OR LIMITATION OF INCIDENTAL OR
//     CONSEQUENTIAL DAMAGES, SO THIS LIMITATION AND EXCLUSION MAY NOT
//     APPLY TO LICENSEE.
//
////////////////////////////////////////////////////////////////////////////////



////////////////////////////////////////////////////////////////////////////
//           _____       
//          / _______    Copyright (C) 2013-2020 Efinix Inc. All rights reserved.
//         / /       \   
//        / /  ..    /   `IP_MODULE_NAME(rom_parser).v
//       / / .'     /    
//    __/ /.'      /     Description:
//   __   \       /      Parse configuration to DDR calibration logic
//  /_/ /\ \_____/ /     
// ____/  \_______/      
//
// *******************************
// Revisions:
// 1.0 Initial rev
//
// *******************************

//////////////////////////////////////////////////////////////////////////////

`resetall
`timescale 1ns / 1ps


module `IP_MODULE_NAME(rom_parser)
  #(	parameter [1:0] DDR_TYPE = 2'b00,
	parameter ROM_DATA_WIDTH = 56,
              ROM_OUTPUT_REG 	 = 0,
              ROM_DATA_DEPTH0 	 = 32,
              ROM_DATA_DEPTH1 	 = 32,
              ROM_DATA_DEPTH2 	 = 32,
              ROM_DATA_DEPTH3 	 = 32, 
              ROM_INIT_FILE0  	 = "rom0.hex",
              ROM_INIT_FILE1  	 = "rom1.hex",
              ROM_INIT_FILE2  	 = "rom2.hex",
              ROM_INIT_FILE3  	 = "rom3.hex"
              )
   
    
  (
   //inputs
   input clk,              //System clock 
   input rst_n,            //Active low Reset
   input [3:0] cal_mode,   //cal_mode
   input [1:0] cal_type,
   input restart,          //To reset all the ROM address. 
   input [1:0]sel_reset,   //reset intended ROM address only 
   input [3:0] sel,        //to select which ROM.
   input rd_en,            //to read the data from ROM. 
   //outputs
   output [3:0] rom_rd_full,
   output reg [ROM_DATA_WIDTH-1: 0] ram_data_out //read data from ROM. 2 CLs after read_en. 
   );
   
function integer depth2width;
input [31:0] depth;
// Description:
//   Converts a depth value into a Width.  For instance a depth of
//        a=depth2width(64);
//   sets "a" to 6. 
//  
//   One way to use this is to convert a depth to a width value on a
//   register.  For instance:
//  
//        reg [depth2width(MEM_WIDTH)-1:0] a;
//  
//   
begin : fnDepth2Width
  if (depth > 1) begin
     depth = depth - 1;
     for (depth2width=0; depth>0; depth2width = depth2width + 1)
       depth = depth>>1;
  end
  else
    depth2width = 0;
end
endfunction 

//Internal Signals 
   localparam cROM_DATA_DEPTH = depth2width(ROM_DATA_DEPTH0);
  
   reg [cROM_DATA_DEPTH-1:0] addr0;
   reg [cROM_DATA_DEPTH-1:0] addr1;
   reg [cROM_DATA_DEPTH-1:0] addr2;
   reg [cROM_DATA_DEPTH-1:0] addr3;
   reg [cROM_DATA_DEPTH-1:0] start_addr0;
   reg [cROM_DATA_DEPTH-1:0] start_addr1;
   reg [cROM_DATA_DEPTH-1:0] start_addr2;
   reg [cROM_DATA_DEPTH-1:0] start_addr3;
   wire [ROM_DATA_WIDTH-1:0] data0,data1,data2,data3;
   wire 		     rom0_rd_full,rom1_rd_full,rom2_rd_full,rom3_rd_full;
   wire [1:0] ddr_type;
   wire [3:0] ddr_op;
   
   assign rom_rd_full  = {rom3_rd_full,rom2_rd_full,rom1_rd_full,rom0_rd_full};
   assign rom0_rd_full = (addr0==ROM_DATA_DEPTH0-1);
   assign rom1_rd_full = (addr1==ROM_DATA_DEPTH1-1);
   assign rom2_rd_full = (addr2==ROM_DATA_DEPTH2-1);
   assign rom3_rd_full = (addr3==ROM_DATA_DEPTH3-1);
   assign ddr_type     = DDR_TYPE;
   assign ddr_op       = {ddr_type, cal_type};  
 
   always @(posedge clk)
   begin
	case(cal_mode)
	4'b0001://gl 
	begin
		if(ddr_op == 4'b0010) begin 	//lpddr3_x32_x16
			start_addr0 <= 'hE;
			start_addr1 <= 'h5;
			start_addr2 <= 'h0;
			start_addr3 <= 'h0;
		end
		else if(ddr_op == 4'b0111) begin //ddr3_x32_x16
			start_addr0 <= 'h1A; 
			start_addr1 <= 'h6;  
			start_addr2 <= 'h0;  
			start_addr3 <= 'h0;  
		end
		else if(ddr_op == 4'b1010) begin //lpddr2_x16
			start_addr0 <= 'h0; 
			start_addr1 <= 'h0;
			start_addr2 <= 'h0;  
			start_addr3 <= 'h0;  
		end
		else begin
			start_addr0 <= 'h0;
			start_addr1 <= 'h0;
			start_addr2 <= 'h0;
			start_addr3 <= 'h0;
		end
	end
	4'b0010://wl
	begin
		
			start_addr0 <= 'h0;
			start_addr1 <= 'h0;
			start_addr2 <= 'h0;
			start_addr3 <= 'h0;
	
	end
	4'b0100://rl
	begin
		if(ddr_op == 4'b0010) begin //lpddr3_x16
			start_addr0 <= 'h27; 
			start_addr1 <= 'h12;
			start_addr2 <= 'h0;
			start_addr3 <= 'h0;
		end
		else if(ddr_op == 4'b0111) begin //ddr3_x32_x16
			start_addr0 <= 'h44; 
			start_addr1 <= 'h13;
			start_addr2 <= 'h0;
			start_addr3 <= 'h0;
		end
		else if(ddr_op == 4'b1010) begin //lpddr2_x32_x16
			start_addr0 <= 'h1D;
			start_addr1 <= 'hD;
			start_addr2 <= 'h0;
			start_addr3 <= 'h0;
		end
		else begin
			start_addr0 <= 'h0;
			start_addr1 <= 'h0;
			start_addr2 <= 'h0;
			start_addr3 <= 'h0;
		end
	end
	default:
	begin
		start_addr0 <= 'h0;
		start_addr1 <= 'h0;
		start_addr2 <= 'h0;
		start_addr3 <= 'h0;
	end
	endcase
   end

   always @(posedge clk)
     if (~rst_n || restart || sel_reset[0]) 
       begin
	  addr1 <= start_addr1;
	  addr2 <= start_addr2;
	  addr3 <= start_addr3;
       end
     else if (rd_en)
       begin
	  case(sel[3:1])
	    3'h1: addr1 <= addr1 + 1'b1;
	    3'h2: addr2 <= addr2 + 1'b1;
	    3'h4: addr3 <= addr3 + 1'b1;
	    default : ;
	  endcase // case (sel[3:0])
       end // else: !if(~rst_n)

   always @(posedge clk)
     if (~rst_n || restart || sel_reset[1]) 
       begin
	  addr0 <= start_addr0;
       end
     else if (rd_en)
       begin
	    if(sel[0])
	    	addr0 <= addr0 + 1;
	    else
		addr0 <= addr0;
       end 
   

   always @(posedge clk)
     if (~rst_n)
       ram_data_out <= 'h0;
     else
       case (sel[3:0])
	 4'h1 : ram_data_out <= data0;
	 4'h2 : ram_data_out <= data1;
	 4'h4 : ram_data_out <= data2;
	 4'h8 : ram_data_out <= data3;
	 default : ;
       endcase // case (sel[3:0])
   
   //Every ROM has different size of depth
   //ROM 0
   `IP_MODULE_NAME(single_port_rom) 
     #(.DATA_WIDTH(ROM_DATA_WIDTH),
       .ADDR_WIDTH(depth2width(ROM_DATA_DEPTH0)),
       .OUTPUT_REG(ROM_OUTPUT_REG),
       .RAM_INIT_FILE(ROM_INIT_FILE0))
   u_rom0
     (
      // Outputs
      .data				(data0),
      // Inputs
      .addr				(addr0),
      .clk				(clk));

   //ROM 1
    `IP_MODULE_NAME(single_port_rom) 
     #(.DATA_WIDTH(ROM_DATA_WIDTH),
       .ADDR_WIDTH(depth2width(ROM_DATA_DEPTH1)),
       .OUTPUT_REG(ROM_OUTPUT_REG),
       .RAM_INIT_FILE(ROM_INIT_FILE1))
   u_rom1
     (
      // Outputs
      .data				(data1),
      // Inputs
      .addr				(addr1),
      .clk				(clk));


    `IP_MODULE_NAME(single_port_rom) 
     #(.DATA_WIDTH(ROM_DATA_WIDTH),
       .ADDR_WIDTH(depth2width(ROM_DATA_DEPTH2)),
       .OUTPUT_REG(ROM_OUTPUT_REG),
       .RAM_INIT_FILE(ROM_INIT_FILE2))
   u_rom2
     (
      // Outputs
      .data				(data2),
      // Inputs
      .addr				(addr2),
      .clk				(clk));


    `IP_MODULE_NAME(single_port_rom) 
     #(.DATA_WIDTH(ROM_DATA_WIDTH),
       .ADDR_WIDTH(depth2width(ROM_DATA_DEPTH3)),
       .OUTPUT_REG(ROM_OUTPUT_REG),
       .RAM_INIT_FILE(ROM_INIT_FILE3))
   u_rom3
     (
      // Outputs
      .data				(data3),
      // Inputs
      .addr				(addr3),
      .clk				(clk));


   
endmodule // rom_parser
/////////////////////////////////////////////////////////////////////////////
// Copyright (C) 2013-2020 Efinix Inc. All rights reserved.
//
// This   document  contains  proprietary information  which   is
// protected by  copyright. All rights  are reserved.  This notice
// refers to original work by Efinix, Inc. which may be derivitive
// of other work distributed under license of the authors.  In the
// case of derivative work, nothing in this notice overrides the
// original author's license agreement.  Where applicable, the 
// original license agreement is included in it's original 
// unmodified form immediately below this header.
//
// WARRANTY DISCLAIMER.  
//     THE  DESIGN, CODE, OR INFORMATION ARE PROVIDED “AS IS” AND 
//     EFINIX MAKES NO WARRANTIES, EXPRESS OR IMPLIED WITH 
//     RESPECT THERETO, AND EXPRESSLY DISCLAIMS ANY IMPLIED WARRANTIES, 
//     INCLUDING, WITHOUT LIMITATION, THE IMPLIED WARRANTIES OF 
//     MERCHANTABILITY, NON-INFRINGEMENT AND FITNESS FOR A PARTICULAR 
//     PURPOSE.  SOME STATES DO NOT ALLOW EXCLUSIONS OF AN IMPLIED 
//     WARRANTY, SO THIS DISCLAIMER MAY NOT APPLY TO LICENSEE.
//
// LIMITATION OF LIABILITY.  
//     NOTWITHSTANDING ANYTHING TO THE CONTRARY, EXCEPT FOR BODILY 
//     INJURY, EFINIX SHALL NOT BE LIABLE WITH RESPECT TO ANY SUBJECT 
//     MATTER OF THIS AGREEMENT UNDER TORT, CONTRACT, STRICT LIABILITY 
//     OR ANY OTHER LEGAL OR EQUITABLE THEORY (I) FOR ANY INDIRECT, 
//     SPECIAL, INCIDENTAL, EXEMPLARY OR CONSEQUENTIAL DAMAGES OF ANY 
//     CHARACTER INCLUDING, WITHOUT LIMITATION, DAMAGES FOR LOSS OF 
//     GOODWILL, DATA OR PROFIT, WORK STOPPAGE, OR COMPUTER FAILURE OR 
//     MALFUNCTION, OR IN ANY EVENT (II) FOR ANY AMOUNT IN EXCESS, IN 
//     THE AGGREGATE, OF THE FEE PAID BY LICENSEE TO EFINIX HEREUNDER 
//     (OR, IF THE FEE HAS BEEN WAIVED, $100), EVEN IF EFINIX SHALL HAVE 
//     BEEN INFORMED OF THE POSSIBILITY OF SUCH DAMAGES.  SOME STATES DO 
//     NOT ALLOW THE EXCLUSION OR LIMITATION OF INCIDENTAL OR 
//     CONSEQUENTIAL DAMAGES, SO THIS LIMITATION AND EXCLUSION MAY NOT 
//     APPLY TO LICENSEE.
//
/////////////////////////////////////////////////////////////////////////////



////////////////////////////////////////////////////////////////////////////
//           _____       
//          / _______    Copyright (C) 2013-2020 Efinix Inc. All rights reserved.
//         / /       \   
//        / /  ..    /   ddr_cal_controller.v
//       / / .'     /    
//    __/ /.'      /     Description:
//   __   \       /      DDR calibration logic main FSM 
//  /_/ /\ \_____/ /     
// ____/  \_______/      
//
// *******************************
// Revisions:
// 1.0 Initial rev
//
// *******************************

/////////////////////////////////////////////////////////////////////////////////
module `IP_MODULE_NAME(single_port_rom) 
#(
	parameter DATA_WIDTH = 16,
	parameter ADDR_WIDTH = 8,
	parameter OUTPUT_REG = 0,
	parameter RAM_INIT_FILE = ""
)
(
	input [ADDR_WIDTH-1:0] addr,
	input clk,
	output [DATA_WIDTH-1:0] data
);
localparam MEMORY_DEPTH = 2**ADDR_WIDTH;

reg	[DATA_WIDTH-1:0]r_rdata_1P;
reg	[DATA_WIDTH-1:0]r_rdata_2P;

//reg [DATA_WIDTH-1:0] rom[MEMORY_DEPTH-1:0];
//29/10/2019 - Removed warning from NCSIM.
reg [DATA_WIDTH-1:0] rom[0:MEMORY_DEPTH-1];
initial	begin
	$readmemh(RAM_INIT_FILE, rom);
	end

always@(posedge clk)
begin
	r_rdata_1P <= rom[addr];
	r_rdata_2P <= r_rdata_1P;
end

generate
	if (OUTPUT_REG == 1)
		assign	data = r_rdata_2P;
	else
		assign	data = r_rdata_1P;
endgenerate

endmodule
////////////////////////////////////////////////////////////////////////////////
// Copyright (C) 2013-2020 Efinix Inc. All rights reserved.
//
// This   document  contains  proprietary information  which   is
// protected by  copyright. All rights  are reserved.  This notice
// refers to original work by Efinix, Inc. which may be derivitive
// of other work distributed under license of the authors.  In the
// case of derivative work, nothing in this notice overrides the
// original author's license agreement.  Where applicable, the
// original license agreement is included in it's original
// unmodified form immediately below this header.
//
// WARRANTY DISCLAIMER.
//     THE  DESIGN, CODE, OR INFORMATION ARE PROVIDED “AS IS” AND
//     EFINIX MAKES NO WARRANTIES, EXPRESS OR IMPLIED WITH
//     RESPECT THERETO, AND EXPRESSLY DISCLAIMS ANY IMPLIED WARRANTIES,
//     INCLUDING, WITHOUT LIMITATION, THE IMPLIED WARRANTIES OF
//     MERCHANTABILITY, NON-INFRINGEMENT AND FITNESS FOR A PARTICULAR
//     PURPOSE.  SOME STATES DO NOT ALLOW EXCLUSIONS OF AN IMPLIED
//     WARRANTY, SO THIS DISCLAIMER MAY NOT APPLY TO LICENSEE.
//
// LIMITATION OF LIABILITY.
//     NOTWITHSTANDING ANYTHING TO THE CONTRARY, EXCEPT FOR BODILY
//     INJURY, EFINIX SHALL NOT BE LIABLE WITH RESPECT TO ANY SUBJECT
//     MATTER OF THIS AGREEMENT UNDER TORT, CONTRACT, STRICT LIABILITY
//     OR ANY OTHER LEGAL OR EQUITABLE THEORY (I) FOR ANY INDIRECT,
//     SPECIAL, INCIDENTAL, EXEMPLARY OR CONSEQUENTIAL DAMAGES OF ANY
//     CHARACTER INCLUDING, WITHOUT LIMITATION, DAMAGES FOR LOSS OF
//     GOODWILL, DATA OR PROFIT, WORK STOPPAGE, OR COMPUTER FAILURE OR
//     MALFUNCTION, OR IN ANY EVENT (II) FOR ANY AMOUNT IN EXCESS, IN
//     THE AGGREGATE, OF THE FEE PAID BY LICENSEE TO EFINIX HEREUNDER
//     (OR, IF THE FEE HAS BEEN WAIVED, $100), EVEN IF EFINIX SHALL HAVE
//     BEEN INFORMED OF THE POSSIBILITY OF SUCH DAMAGES.  SOME STATES DO
//     NOT ALLOW THE EXCLUSION OR LIMITATION OF INCIDENTAL OR
//     CONSEQUENTIAL DAMAGES, SO THIS LIMITATION AND EXCLUSION MAY NOT
//     APPLY TO LICENSEE.
//
////////////////////////////////////////////////////////////////////////////////


`undef IP_UUID
`undef IP_NAME_CONCAT
`undef IP_MODULE_NAME
