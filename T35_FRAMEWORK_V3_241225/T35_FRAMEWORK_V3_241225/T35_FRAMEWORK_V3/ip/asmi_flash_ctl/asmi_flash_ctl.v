// =============================================================================
// Generated by efx_ipmgr
// Version: 2021.2.323
// IP Version: 2.1
// =============================================================================

////////////////////////////////////////////////////////////////////////////////
// Copyright (C) 2013-2021 Efinix Inc. All rights reserved.              
//
// This   document  contains  proprietary information  which   is        
// protected by  copyright. All rights  are reserved.  This notice       
// refers to original work by Efinix, Inc. which may be derivitive       
// of other work distributed under license of the authors.  In the       
// case of derivative work, nothing in this notice overrides the         
// original author's license agreement.  Where applicable, the           
// original license agreement is included in it's original               
// unmodified form immediately below this header.                        
//                                                                       
// WARRANTY DISCLAIMER.                                                  
//     THE  DESIGN, CODE, OR INFORMATION ARE PROVIDED “AS IS” AND        
//     EFINIX MAKES NO WARRANTIES, EXPRESS OR IMPLIED WITH               
//     RESPECT THERETO, AND EXPRESSLY DISCLAIMS ANY IMPLIED WARRANTIES,  
//     INCLUDING, WITHOUT LIMITATION, THE IMPLIED WARRANTIES OF          
//     MERCHANTABILITY, NON-INFRINGEMENT AND FITNESS FOR A PARTICULAR    
//     PURPOSE.  SOME STATES DO NOT ALLOW EXCLUSIONS OF AN IMPLIED       
//     WARRANTY, SO THIS DISCLAIMER MAY NOT APPLY TO LICENSEE.           
//                                                                       
// LIMITATION OF LIABILITY.                                              
//     NOTWITHSTANDING ANYTHING TO THE CONTRARY, EXCEPT FOR BODILY       
//     INJURY, EFINIX SHALL NOT BE LIABLE WITH RESPECT TO ANY SUBJECT    
//     MATTER OF THIS AGREEMENT UNDER TORT, CONTRACT, STRICT LIABILITY   
//     OR ANY OTHER LEGAL OR EQUITABLE THEORY (I) FOR ANY INDIRECT,      
//     SPECIAL, INCIDENTAL, EXEMPLARY OR CONSEQUENTIAL DAMAGES OF ANY    
//     CHARACTER INCLUDING, WITHOUT LIMITATION, DAMAGES FOR LOSS OF      
//     GOODWILL, DATA OR PROFIT, WORK STOPPAGE, OR COMPUTER FAILURE OR   
//     MALFUNCTION, OR IN ANY EVENT (II) FOR ANY AMOUNT IN EXCESS, IN    
//     THE AGGREGATE, OF THE FEE PAID BY LICENSEE TO EFINIX HEREUNDER    
//     (OR, IF THE FEE HAS BEEN WAIVED, $100), EVEN IF EFINIX SHALL HAVE 
//     BEEN INFORMED OF THE POSSIBILITY OF SUCH DAMAGES.  SOME STATES DO 
//     NOT ALLOW THE EXCLUSION OR LIMITATION OF INCIDENTAL OR            
//     CONSEQUENTIAL DAMAGES, SO THIS LIMITATION AND EXCLUSION MAY NOT   
//     APPLY TO LICENSEE.                                                
//
////////////////////////////////////////////////////////////////////////////////

`define IP_UUID _809e05252d5b4e67b40dadb316b19da2
`define IP_NAME_CONCAT(a,b) a``b
`define IP_MODULE_NAME(name) `IP_NAME_CONCAT(name,`IP_UUID)
module asmi_flash_ctl (
input rst_in,
input clk_in,
input fast_read,
input sector_erase,
input page_write,
input fast_read_dual,
input quad_fast_read,
input quad_io_fast_read,
input quad_page_write,
input quad_enable,
input rden,
input wren,
input shift_bytes,
input [7:0] datain,
output [7:0] dataout,
output data_valid,
output busy,
input miso,
input miso_1,
input miso_2,
input miso_3,
output sclk,
output nss,
output mosi,
output mosi_1,
output mosi_2,
output mosi_3,
output mosi_oe,
input [23:0] address
);
`IP_MODULE_NAME(efx_flash_controller_top) #(
.SCLK_DIV (4),
.ADDR_WIDTH (24)
) u_efx_flash_controller_top(
.rst_in ( rst_in ),
.clk_in ( clk_in ),
.fast_read ( fast_read ),
.sector_erase ( sector_erase ),
.page_write ( page_write ),
.fast_read_dual ( fast_read_dual ),
.quad_fast_read ( quad_fast_read ),
.quad_io_fast_read ( quad_io_fast_read ),
.quad_page_write ( quad_page_write ),
.quad_enable ( quad_enable ),
.rden ( rden ),
.wren ( wren ),
.shift_bytes ( shift_bytes ),
.datain ( datain ),
.dataout ( dataout ),
.data_valid ( data_valid ),
.busy ( busy ),
.miso ( miso ),
.miso_1 ( miso_1 ),
.miso_2 ( miso_2 ),
.miso_3 ( miso_3 ),
.sclk ( sclk ),
.nss ( nss ),
.mosi ( mosi ),
.mosi_1 ( mosi_1 ),
.mosi_2 ( mosi_2 ),
.mosi_3 ( mosi_3 ),
.mosi_oe ( mosi_oe ),
.address ( address )
);

endmodule

/////////////////////////////////////////////////////////////////////////////
//           _____       
//          / _______    Copyright (C) 2013-2020 Efinix Inc. All rights reserved.
//         / /       \   
//        / /  ..    /   `IP_MODULE_NAME(dual_clock_fifo_wrapper).v
//       / / .'     /    
//    __/ /.'      /     Description:
//   __   \       /      Dual Clock FIFO
//  /_/ /\ \_____/ /     
// ____/  \_______/      
//
//********************************
// Revisions:
// 0.0 Initial rev
// 0.1 Added read/write count, almost full, almost empty signal
//********************************

module `IP_MODULE_NAME(dual_clock_fifo_wrapper)
#(
	parameter	DATA_WIDTH		= 8,
	parameter	ADDR_WIDTH		= 8,
	parameter	LATENCY			= 1,
	parameter	FIFO_MODE		= "STD_FIFO",
	parameter	RAM_INIT_FILE	= "",
	/////////////////////////////////////////////////////////////////////////////////////
	// compatibility	output_reg			check_full_overflow		check_empty_underflow
	/////////////////////////////////////////////////////////////////////////////////////
	// E				user configurable	user configurable		user configurable
	// X				user configurable	always on				always on
	// A				always off			user configurable		user configurable
	parameter	COMPATIBILITY	= "E",
	parameter	OUTPUT_REG		= "TRUE",
	parameter	CHECK_FULL		= "TRUE",
	parameter	CHECK_EMPTY		= "TRUE",
	parameter	AFULL_THRESHOLD	= 512,	
	parameter	AEMPTY_THRESHOLD= 1					
)
(
	input						i_arst,
	
	input						i_wclk,
	input						i_we,
	input	[DATA_WIDTH-1:0]	i_wdata,
	
	input						i_rclk,
	input						i_re,
	
	output						o_full,
	output						o_empty,
	output	[DATA_WIDTH-1:0]	o_rdata,
	
	output						o_afull,	
	output	[ADDR_WIDTH-1:0]	o_wcnt,		
	output						o_aempty,	
	output	[ADDR_WIDTH-1:0]	o_rcnt		
);

generate
	if (COMPATIBILITY == "X")
	begin
		if (FIFO_MODE == "BYPASS")
		begin
			`IP_MODULE_NAME(dual_clock_fifo)
			#(
				.DATA_WIDTH			(DATA_WIDTH),
				.ADDR_WIDTH			(ADDR_WIDTH),
				.LATENCY			(LATENCY+4),
				.FIFO_MODE			(FIFO_MODE),
				.RAM_INIT_FILE		(RAM_INIT_FILE),
				.COMPATIBILITY		(COMPATIBILITY),
				.OUTPUT_REG			("FALSE"),
				.CHECK_FULL			("TRUE"),
				.CHECK_EMPTY		("TRUE"),
				.AFULL_THRESHOLD	(AFULL_THRESHOLD),
				.AEMPTY_THRESHOLD	(AEMPTY_THRESHOLD)
			)
			inst_dual_clock_fifo
			(
				.i_arst		(i_arst),
				.i_wclk		(i_wclk),
				.i_we		(i_we),
				.i_wdata	(i_wdata),
				.i_rclk		(i_rclk),
				.i_re		(i_re),
				.o_full		(o_full),
				.o_empty	(o_empty),
				.o_rdata	(o_rdata),
				
				.o_afull	(o_afull),
				.o_wcnt		(o_wcnt),
				.o_aempty	(o_aempty),
				.o_rcnt		(o_rcnt)
			);
		end
		else
		begin
			`IP_MODULE_NAME(dual_clock_fifo)
			#(
				.DATA_WIDTH			(DATA_WIDTH),
				.ADDR_WIDTH			(ADDR_WIDTH),
				.LATENCY			(LATENCY+2),
				.FIFO_MODE			(FIFO_MODE),
				.RAM_INIT_FILE		(RAM_INIT_FILE),
				.COMPATIBILITY		(COMPATIBILITY),
				.OUTPUT_REG			(OUTPUT_REG),
				.CHECK_FULL			("TRUE"),
				.CHECK_EMPTY		("TRUE"),
				.AFULL_THRESHOLD	(AFULL_THRESHOLD),
				.AEMPTY_THRESHOLD	(AEMPTY_THRESHOLD)
			)
			inst_dual_clock_fifo
			(
				.i_arst		(i_arst),
				.i_wclk		(i_wclk),
				.i_we		(i_we),
				.i_wdata	(i_wdata),
				.i_rclk		(i_rclk),
				.i_re		(i_re),
				.o_full		(o_full),
				.o_empty	(o_empty),
				.o_rdata	(o_rdata),
				
				.o_afull	(o_afull),
				.o_wcnt		(o_wcnt),
				.o_aempty	(o_aempty),
				.o_rcnt		(o_rcnt)
			);
		end
	end
	else if (COMPATIBILITY == "A")
	begin
		`IP_MODULE_NAME(dual_clock_fifo)
		#(
			.DATA_WIDTH			(DATA_WIDTH),
			.ADDR_WIDTH			(ADDR_WIDTH),
			.LATENCY			(LATENCY),
			.FIFO_MODE			(FIFO_MODE),
			.RAM_INIT_FILE		(RAM_INIT_FILE),
			.COMPATIBILITY		(COMPATIBILITY),
			.OUTPUT_REG			("FALSE"),
			.CHECK_FULL			(CHECK_FULL),
			.CHECK_EMPTY		(CHECK_EMPTY),
			.AFULL_THRESHOLD	(AFULL_THRESHOLD),
			.AEMPTY_THRESHOLD	(AEMPTY_THRESHOLD)
		)
		inst_dual_clock_fifo
		(
			.i_arst		(i_arst),
			.i_wclk		(i_wclk),
			.i_we		(i_we),
			.i_wdata	(i_wdata),
			.i_rclk		(i_rclk),
			.i_re		(i_re),
			.o_full		(o_full),
			.o_empty	(o_empty),
			.o_rdata	(o_rdata),
			
			.o_afull	(o_afull),
			.o_wcnt		(o_wcnt),
			.o_aempty	(o_aempty),
			.o_rcnt		(o_rcnt)
		);
	end
	else
	begin
		`IP_MODULE_NAME(dual_clock_fifo)
		#(
			.DATA_WIDTH			(DATA_WIDTH),
			.ADDR_WIDTH			(ADDR_WIDTH),
			.LATENCY			(LATENCY),
			.FIFO_MODE			(FIFO_MODE),
			.RAM_INIT_FILE		(RAM_INIT_FILE),
			.COMPATIBILITY		(COMPATIBILITY),
			.OUTPUT_REG			(OUTPUT_REG),
			.CHECK_FULL			(CHECK_FULL),
			.CHECK_EMPTY		(CHECK_EMPTY),
			.AFULL_THRESHOLD	(AFULL_THRESHOLD),
			.AEMPTY_THRESHOLD	(AEMPTY_THRESHOLD)
		)
		inst_dual_clock_fifo
		(
			.i_arst		(i_arst),
			.i_wclk		(i_wclk),
			.i_we		(i_we),
			.i_wdata	(i_wdata),
			.i_rclk		(i_rclk),
			.i_re		(i_re),
			.o_full		(o_full),
			.o_empty	(o_empty),
			.o_rdata	(o_rdata),
			
			.o_afull	(o_afull),
			.o_wcnt		(o_wcnt),
			.o_aempty	(o_aempty),
			.o_rcnt		(o_rcnt)
		);
	end
endgenerate

endmodule


//////////////////////////////////////////////////////////////////////////////
// Copyright (C) 2013-2019 Efinix Inc. All rights reserved.
//
// This   document  contains  proprietary information  which   is
// protected by  copyright. All rights  are reserved.  This notice
// refers to original work by Efinix, Inc. which may be derivitive
// of other work distributed under license of the authors.  In the
// case of derivative work, nothing in this notice overrides the
// original author's license agreement.  Where applicable, the 
// original license agreement is included in it's original 
// unmodified form immediately below this header.
//
// WARRANTY DISCLAIMER.  
//     THE  DESIGN, CODE, OR INFORMATION ARE PROVIDED “AS IS” AND 
//     EFINIX MAKES NO WARRANTIES, EXPRESS OR IMPLIED WITH 
//     RESPECT THERETO, AND EXPRESSLY DISCLAIMS ANY IMPLIED WARRANTIES, 
//     INCLUDING, WITHOUT LIMITATION, THE IMPLIED WARRANTIES OF 
//     MERCHANTABILITY, NON-INFRINGEMENT AND FITNESS FOR A PARTICULAR 
//     PURPOSE.  SOME STATES DO NOT ALLOW EXCLUSIONS OF AN IMPLIED 
//     WARRANTY, SO THIS DISCLAIMER MAY NOT APPLY TO LICENSEE.
//
// LIMITATION OF LIABILITY.  
//     NOTWITHSTANDING ANYTHING TO THE CONTRARY, EXCEPT FOR BODILY 
//     INJURY, EFINIX SHALL NOT BE LIABLE WITH RESPECT TO ANY SUBJECT 
//     MATTER OF THIS AGREEMENT UNDER TORT, CONTRACT, STRICT LIABILITY 
//     OR ANY OTHER LEGAL OR EQUITABLE THEORY (I) FOR ANY INDIRECT, 
//     SPECIAL, INCIDENTAL, EXEMPLARY OR CONSEQUENTIAL DAMAGES OF ANY 
//     CHARACTER INCLUDING, WITHOUT LIMITATION, DAMAGES FOR LOSS OF 
//     GOODWILL, DATA OR PROFIT, WORK STOPPAGE, OR COMPUTER FAILURE OR 
//     MALFUNCTION, OR IN ANY EVENT (II) FOR ANY AMOUNT IN EXCESS, IN 
//     THE AGGREGATE, OF THE FEE PAID BY LICENSEE TO EFINIX HEREUNDER 
//     (OR, IF THE FEE HAS BEEN WAIVED, $100), EVEN IF EFINIX SHALL HAVE 
//     BEEN INFORMED OF THE POSSIBILITY OF SUCH DAMAGES.  SOME STATES DO 
//     NOT ALLOW THE EXCLUSION OR LIMITATION OF INCIDENTAL OR 
//     CONSEQUENTIAL DAMAGES, SO THIS LIMITATION AND EXCLUSION MAY NOT 
//     APPLY TO LICENSEE.
//
/////////////////////////////////////////////////////////////////////////////



/////////////////////////////////////////////////////////////////////////////
//           _____       
//          / _______    Copyright (C) 2013-2020 Efinix Inc. All rights reserved.
//         / /       \   
//        / /  ..    /   `IP_MODULE_NAME(dual_clock_fifo).v
//       / / .'     /    
//    __/ /.'      /     Description:
//   __   \       /      Dual Clock FIFO
//  /_/ /\ \_____/ /     
// ____/  \_______/      
//
//********************************
// Revisions:
// 0.0 Initial rev
// 0.1 Added read/write count, almost full, almost empty signal
//********************************

module `IP_MODULE_NAME(dual_clock_fifo)
#(
	parameter	DATA_WIDTH		= 8,
	parameter	ADDR_WIDTH		= 8,
	parameter	LATENCY			= 1,
	parameter	FIFO_MODE		= "STD_FIFO",
	parameter	RAM_INIT_FILE	= "",
	parameter	COMPATIBILITY	= "E",
	parameter	OUTPUT_REG		= "FALSE",
	parameter	CHECK_FULL		= "TRUE",
	parameter	CHECK_EMPTY		= "TRUE",
	parameter	AFULL_THRESHOLD	        = 511,
	parameter	AEMPTY_THRESHOLD= 1
)
(
	input						i_arst,
	
	input						i_wclk,
	input						i_we,
	input	[DATA_WIDTH-1:0]	i_wdata,
	
	input						i_rclk,
	input						i_re,
	
	output						o_full,
	output						o_empty,
	output	[DATA_WIDTH-1:0]	o_rdata,
	
	output						o_afull,
	output	[ADDR_WIDTH-1:0]	o_wcnt,
	output						o_aempty,
	output	[ADDR_WIDTH-1:0]	o_rcnt
);

reg		[ADDR_WIDTH:0]	r_waddrb_1P;
reg						r_wflag_1P;
reg		[ADDR_WIDTH-1:0]r_waddrg_1P;
reg		[ADDR_WIDTH-1:0]r_waddrg_2P;

reg		[ADDR_WIDTH:0]r_raddrb_wclk_1P;
reg		[ADDR_WIDTH:0]r_raddrb_wclk_neg;
reg		[ADDR_WIDTH:0]wr_cnt;

reg		[ADDR_WIDTH:0]r_waddrb_rclk_1P;
reg		[ADDR_WIDTH:0]r_waddrb_rclk_neg;
reg		[ADDR_WIDTH:0]rd_cnt;

reg						r_we_1P;
reg						r_re_1P;
reg		[ADDR_WIDTH:0]	r_raddrb_1P;
reg						r_rflag_1P;
reg		[ADDR_WIDTH-1:0]r_raddrg_1P;
reg						r_rflag_2P;
reg		[ADDR_WIDTH-1:0]r_raddrg_2P;

reg		[LATENCY-1:0]	r_empty;
reg		[LATENCY:0]		r_full;

wire	[ADDR_WIDTH:0]	w_waddrb_1P;
wire					w_wflag_1P;
wire	[ADDR_WIDTH-1:0]w_waddrg_1P;

wire	[ADDR_WIDTH:0]	w_raddrb_1P;
wire					w_rflag_1P;
wire	[ADDR_WIDTH-1:0]w_raddrg_1P;

wire	w_empty;
wire	w_full;

wire	w_empty_P;
wire	w_full_P;

wire					w_we;
wire					w_re;
wire	[ADDR_WIDTH-1:0]w_raddr;

assign	w_waddrb_1P					=	r_waddrb_1P + 1'b1;
assign	w_wflag_1P					=	w_waddrb_1P[ADDR_WIDTH];
assign	w_waddrg_1P[ADDR_WIDTH-1]	=	w_waddrb_1P[ADDR_WIDTH-1] ^ 1'b0;
assign	w_waddrg_1P[ADDR_WIDTH-2:0]	=	w_waddrb_1P[ADDR_WIDTH-2:0] ^ w_waddrb_1P[ADDR_WIDTH-1:1];

assign	w_full	=	((r_waddrg_1P == r_raddrg_1P) &
					(r_wflag_1P != r_rflag_1P))?
						1'b1:
					(i_we &
					((w_waddrg_1P == r_raddrg_2P) &
					(w_wflag_1P != r_rflag_2P)))?
						1'b1:
						1'b0;

always@(posedge i_arst or posedge i_wclk)
begin
	if (i_arst) begin
		r_raddrb_wclk_1P	<= {ADDR_WIDTH+1{1'b0}};
	end
	else begin
		r_raddrb_wclk_1P	<= r_raddrb_1P;
	end
end

always@(posedge i_arst or posedge i_wclk)
begin
	if (i_arst) begin
		r_raddrb_wclk_neg	<= {ADDR_WIDTH+1{1'b0}};
	end
	else begin
		r_raddrb_wclk_neg	<= ~r_raddrb_wclk_1P + 1'b1;
	end
end

always@(posedge i_arst or posedge i_wclk)
begin
	if (i_arst) begin
		wr_cnt			<= {ADDR_WIDTH+1{1'b0}};
	end
	else begin
		wr_cnt			<= r_waddrb_1P + r_raddrb_wclk_neg;
	end
end

always@(posedge i_arst or posedge i_rclk)
begin
	if (i_arst) begin
		r_waddrb_rclk_1P	<= {ADDR_WIDTH+1{1'b0}};
	end
	else begin
		r_waddrb_rclk_1P	<= r_waddrb_1P;
	end
end

always@(posedge i_arst or posedge i_rclk)
begin
	if (i_arst) begin
		r_waddrb_rclk_neg	<= {ADDR_WIDTH+1{1'b0}};
	end
	else begin
		r_waddrb_rclk_neg	<= ~r_waddrb_rclk_1P;
	end
end

always@(posedge i_arst or posedge i_rclk)
begin
	if (i_arst) begin
		rd_cnt			<= {ADDR_WIDTH+1{1'b0}};
	end
	else begin
		rd_cnt			<= r_raddrb_1P + r_waddrb_rclk_neg;
	end
end

always@(posedge i_arst or posedge i_wclk)
begin
	if (i_arst)
	begin
		r_we_1P			<= 1'b0;
		r_waddrb_1P		<= {ADDR_WIDTH{1'b0}};
		r_wflag_1P		<= 1'b0;
		r_waddrg_1P		<= {ADDR_WIDTH{1'b0}};
		r_waddrg_2P		<= {ADDR_WIDTH{1'b0}};
		
		r_full[0]		<= 1'b0;
	end
	else
	begin
		r_we_1P	<= 1'b0;

		if (CHECK_FULL == "TRUE")
		begin
			if (i_we & ~w_full_P)
			begin
				r_we_1P			<= 1'b1;
				r_waddrb_1P		<= w_waddrb_1P;
				r_wflag_1P		<= w_wflag_1P;
				r_waddrg_1P		<= w_waddrg_1P;
			end
		end
		else
		begin
			if (i_we)
			begin
				r_we_1P			<= 1'b1;
				r_waddrb_1P		<= w_waddrb_1P;
				r_wflag_1P		<= w_wflag_1P;
				r_waddrg_1P		<= w_waddrg_1P;
			end
		end
		
		if (r_we_1P)
			r_waddrg_2P		<= r_waddrg_1P;
		
		r_full[0]		<= w_full;
	end
end

assign	w_raddrb_1P					=	r_raddrb_1P + 1'b1;
assign	w_rflag_1P					=	w_raddrb_1P[ADDR_WIDTH];
assign	w_raddrg_1P[ADDR_WIDTH-1]	=	w_raddrb_1P[ADDR_WIDTH-1] ^ 1'b0;
assign	w_raddrg_1P[ADDR_WIDTH-2:0]	=	w_raddrb_1P[ADDR_WIDTH-2:0] ^ w_raddrb_1P[ADDR_WIDTH-1:1];

assign	w_empty	=	((r_waddrg_2P == r_raddrg_1P) &
					(r_wflag_1P == r_rflag_2P))?
						1'b1:
					(i_re &
					((r_waddrg_1P == r_raddrg_1P) &
					(r_wflag_1P == r_rflag_1P)))?
						1'b1:
						1'b0;

always@(posedge i_arst or posedge i_rclk)
begin
	if (i_arst)
	begin
		r_re_1P			<= 1'b0;
		r_raddrb_1P		<= {ADDR_WIDTH{1'b0}};
		r_rflag_1P		<= 1'b0;
		r_raddrg_1P		<= {ADDR_WIDTH{1'b0}};
		r_rflag_2P		<= 1'b0;
		r_raddrg_2P		<= {ADDR_WIDTH{1'b0}};
		
		r_empty[0]		<= 1'b1;
	end
	else
	begin
		r_re_1P	<= 1'b0;
		
		if (CHECK_FULL == "TRUE")
		begin
			if (i_re & ~w_empty_P)
			begin
				r_re_1P			<= 1'b1;
				r_raddrb_1P		<= w_raddrb_1P;
				r_rflag_1P		<= w_rflag_1P;
				r_raddrg_1P		<= w_raddrg_1P;
			end
		end
		else
		begin
			if (i_re)
			begin
				r_re_1P			<= 1'b1;
				r_raddrb_1P		<= w_raddrb_1P;
				r_rflag_1P		<= w_rflag_1P;
				r_raddrg_1P		<= w_raddrg_1P;
			end
		end
		
		if (r_re_1P)
		begin
			r_raddrg_2P		<= r_raddrg_1P;
			r_rflag_2P		<= r_rflag_1P;
		end
		
		r_empty[0]		<= w_empty;
	end
end

genvar i, j;
generate
	for (i=1; i<LATENCY; i=i+1)
	begin: pipe_empty
		always@(posedge i_arst or posedge i_rclk)
		begin
			if (i_arst)
				r_empty[i]	<= 1'b1;
			else
				r_empty[i]	<= r_empty[i-1];
		end
	end
	
	assign	w_empty_P	= w_empty | r_empty[LATENCY-1];
	
	for (j=1; j<LATENCY+1; j=j+1)
	begin: pipe_full
		always@(posedge i_arst or posedge i_wclk)
		begin
			if (i_arst)
				r_full[j]	<= 1'b0;
			else
				r_full[j]	<= r_full[j-1];
		end
	end
	
	if (COMPATIBILITY == "X")
		if (FIFO_MODE == "BYPASS")
			assign	w_full_P	= r_full[0] | r_full[LATENCY-2];
		else
			assign	w_full_P	= r_full[0]	| r_full[LATENCY];
	else
		assign	w_full_P	= r_full[0] | r_full[LATENCY-1];
	
	if (CHECK_FULL == "TRUE")
		assign	w_we	= i_we & ~w_full_P;
	else
		assign	w_we	= i_we;
	
	if (FIFO_MODE == "BYPASS")
	begin
		assign	w_re	= 1'b1;
		if (CHECK_EMPTY == "TRUE")
			assign	w_raddr	= (i_re & ~w_empty_P)?
								w_raddrg_1P[ADDR_WIDTH-1:0]:
								r_raddrg_1P[ADDR_WIDTH-1:0];
		else
			assign	w_raddr	= (i_re)?
								w_raddrg_1P[ADDR_WIDTH-1:0]:
								r_raddrg_1P[ADDR_WIDTH-1:0];
	end
	else
	begin
		if (CHECK_EMPTY == "TRUE")
			assign	w_re	= i_re & ~w_empty_P;
		else
			assign	w_re	= i_re;
		assign	w_raddr	= r_raddrg_1P[ADDR_WIDTH-1:0];
	end

	`IP_MODULE_NAME(simple_dual_port_ram)
	#(
		.DATA_WIDTH(DATA_WIDTH),
		.ADDR_WIDTH(ADDR_WIDTH),
		.OUTPUT_REG(OUTPUT_REG),
		.RAM_INIT_FILE(RAM_INIT_FILE)
	)
	inst_simple_dual_port_ram
	(
		.wdata(i_wdata),
		.waddr(r_waddrg_1P[ADDR_WIDTH-1:0]),
		.raddr(w_raddr),
		.we(w_we),
		.wclk(i_wclk),
		.re(w_re),
		.rclk(i_rclk),
		.rdata(o_rdata)
	);
endgenerate

assign	o_empty	= w_empty_P;
assign	o_full	= w_full_P;

//assign	o_aempty= w_empty_P;
assign	o_aempty= w_empty_P | (rd_cnt[ADDR_WIDTH-1] & rd_cnt[ADDR_WIDTH-2] & rd_cnt[ADDR_WIDTH-3]);
//assign	o_wcnt	= r_waddrb_1P;
assign	o_wcnt	= wr_cnt[ADDR_WIDTH] ? {ADDR_WIDTH{1'b1}} : wr_cnt[ADDR_WIDTH-1:0];
//assign	o_afull	= w_full_P;
assign	o_afull	= w_full_P | wr_cnt[ADDR_WIDTH] | (wr_cnt[ADDR_WIDTH-1] & wr_cnt[ADDR_WIDTH-2] & wr_cnt[ADDR_WIDTH-3]);
//assign	o_rcnt	= r_raddrb_1P;
assign	o_rcnt	= w_full_P ? {ADDR_WIDTH{1'b0}} : rd_cnt[ADDR_WIDTH-1:0];

endmodule

//////////////////////////////////////////////////////////////////////////////
// Copyright (C) 2013-2019 Efinix Inc. All rights reserved.
//
// This   document  contains  proprietary information  which   is
// protected by  copyright. All rights  are reserved.  This notice
// refers to original work by Efinix, Inc. which may be derivitive
// of other work distributed under license of the authors.  In the
// case of derivative work, nothing in this notice overrides the
// original author's license agreement.  Where applicable, the 
// original license agreement is included in it's original 
// unmodified form immediately below this header.
//
// WARRANTY DISCLAIMER.  
//     THE  DESIGN, CODE, OR INFORMATION ARE PROVIDED “AS IS” AND 
//     EFINIX MAKES NO WARRANTIES, EXPRESS OR IMPLIED WITH 
//     RESPECT THERETO, AND EXPRESSLY DISCLAIMS ANY IMPLIED WARRANTIES, 
//     INCLUDING, WITHOUT LIMITATION, THE IMPLIED WARRANTIES OF 
//     MERCHANTABILITY, NON-INFRINGEMENT AND FITNESS FOR A PARTICULAR 
//     PURPOSE.  SOME STATES DO NOT ALLOW EXCLUSIONS OF AN IMPLIED 
//     WARRANTY, SO THIS DISCLAIMER MAY NOT APPLY TO LICENSEE.
//
// LIMITATION OF LIABILITY.  
//     NOTWITHSTANDING ANYTHING TO THE CONTRARY, EXCEPT FOR BODILY 
//     INJURY, EFINIX SHALL NOT BE LIABLE WITH RESPECT TO ANY SUBJECT 
//     MATTER OF THIS AGREEMENT UNDER TORT, CONTRACT, STRICT LIABILITY 
//     OR ANY OTHER LEGAL OR EQUITABLE THEORY (I) FOR ANY INDIRECT, 
//     SPECIAL, INCIDENTAL, EXEMPLARY OR CONSEQUENTIAL DAMAGES OF ANY 
//     CHARACTER INCLUDING, WITHOUT LIMITATION, DAMAGES FOR LOSS OF 
//     GOODWILL, DATA OR PROFIT, WORK STOPPAGE, OR COMPUTER FAILURE OR 
//     MALFUNCTION, OR IN ANY EVENT (II) FOR ANY AMOUNT IN EXCESS, IN 
//     THE AGGREGATE, OF THE FEE PAID BY LICENSEE TO EFINIX HEREUNDER 
//     (OR, IF THE FEE HAS BEEN WAIVED, $100), EVEN IF EFINIX SHALL HAVE 
//     BEEN INFORMED OF THE POSSIBILITY OF SUCH DAMAGES.  SOME STATES DO 
//     NOT ALLOW THE EXCLUSION OR LIMITATION OF INCIDENTAL OR 
//     CONSEQUENTIAL DAMAGES, SO THIS LIMITATION AND EXCLUSION MAY NOT 
//     APPLY TO LICENSEE.
//
/////////////////////////////////////////////////////////////////////////////



/////////////////////////////////////////////////////////////////////////////
//           _____       
//          / _______    Copyright (C) 2013-2020 Efinix Inc. All rights reserved.
//         / /       \   
//        / /  ..    /   `IP_MODULE_NAME(efx_command_ctl).v
//       / / .'     /    
//    __/ /.'      /     Description:
//   __   \       /      EFX Command Controller
//  /_/ /\ \_____/ /     
// ____/  \_______/      
//
// *******************************
// Revisions:
// 1.0 Initial rev
//
// *******************************

`resetall
`timescale 1 ps/1 ps

module `IP_MODULE_NAME(efx_command_ctl)
  (
   //Inputs
   input rst_in,
   input clk_in,
   input wren,
   input shift_bytes, 
   input fast_read,             //Fast Read Control 
   input fast_read_dual,        //Fast Read Dual Control 
   input quad_fast_read,        //Quad Fast Read Control 
   input quad_io_fast_read,	//Quad IO Fast Read Control
   input sector_erase,          //Sector Erase Control
   input page_write,            //Page Write Control
   input quad_page_write,	//Quad page write control
   input quad_enable,
   input busy, 
   input [7:0] flash_rd_status_reg0,
   input [7:0] flash_rd_status_reg1,
   input data_valid,
   //Outputs
   output reg [8:0] byte_cnt_out,
   output spi_cmd_en,             
   output [4:0] spi_cmd,
   output [7:0] spi_wr_data,            
   output [7:0] spi_cmd_instr,
   output busy_out                 //This is final busy status, which indicate the instruction busy status. 
   );


//Internal Signals

   reg [4:0] 	current_st, next_st;

   reg 		spi_cmd_en_0;
   reg 		spi_cmd_en_1;
   reg [4:0] 	spi_cmd_0;
   reg [7:0] 	spi_wr_data_0;
   reg [7:0] 	spi_cmd_instr_0;

   reg [7:0] 	spi_wr_data_1;
   reg [7:0] 	spi_cmd_instr_1;
   reg [4:0] 	instr1_1;
   reg [4:0] 	instr2_1;
   reg [4:0] 	instr1_0;
   reg [4:0] 	instr2_0;

   reg 		busy_1;
   reg [4:0] 	spi_cmd_1;
   reg [8:0] 	byte_cnt;
   reg [5:0] 	soft_reset;
   reg [2:0]	wait_cnt, next_wait_cnt;

   reg 		check_busy_0, check_busy_1;
   

//////////////////////////////////   
//RTL
//////////////////////////////////

   assign busy_out = busy_1;
   
   assign spi_cmd = spi_cmd_1;
   assign spi_cmd_en = spi_cmd_en_1;
   
   assign spi_cmd_instr = spi_cmd_instr_1;
   assign spi_wr_data = spi_wr_data_1;
   
   
/////////////////////////
//Page Write Steps
/////////////////////////
//Write Enable
//Page Program
//Page Done? [Check the status register?]

//Test Case   
//$display("IP Command : Write Enable");
//jtag_intreg_write(`INTREG_IP_CMD,8'h83); //Write Enable Instruction Command. 
//jtag_intreg_write(`INTREG_IP_CMD,8'h00); //Clear Write Enable Instruction Command
//
//$display("HOST START SPI WRITE BURST to SPI FLASH.");
//$display("IP Command : Write");
//jtag_intreg_write(`INTREG_IP_CMD,8'h8c); //Write Instruction Command.
//jtag_intreg_write(`INTREG_IP_CMD,8'h00); //Write Instruction Command.

//Main FSM to handle all command/instructions
   localparam ST_IDLE   = 5'h0;
   localparam ST_CMD0_0 = 5'h1;
   localparam ST_CMD0_1 = 5'h2;
   localparam ST_CMD0_2 = 5'h3;
   localparam ST_CMD0_3 = 5'h4;
   localparam ST_CMD1_0 = 5'h5;
   localparam ST_CMD1_1 = 5'h6;
   localparam ST_CMD1_2 = 5'h7;
   localparam ST_CMD1_3 = 5'h8;
   localparam ST_CMD2_0 = 5'h9;
   localparam ST_CMD2_1 = 5'hA;
   localparam ST_CMD2_2 = 5'hB;
   localparam ST_CMD2_3 = 5'hC;
   localparam ST_CHECK_STATUS0 = 5'hD;
   localparam ST_CHECK_STATUS1 = 5'hE;
   localparam ST_CHECK_STATUS2 = 5'hF;
   localparam ST_REG2_STATUS0 = 5'h10;
   localparam ST_REG2_STATUS1 = 5'h11;
   localparam ST_REG2_STATUS2 = 5'h12;
   localparam ST_WREG2_0 = 5'h13;
   localparam ST_WREG2_1 = 5'h14;
   localparam ST_WREG2_2 = 5'h15;
   localparam ST_WREG2_3 = 5'h16;
   localparam ST_WREG2_4 = 5'h17;
 
  
always @(posedge clk_in)
  if (rst_in) begin
    current_st <= ST_IDLE;
    wait_cnt <= 3'd0;
  end
  else begin
    wait_cnt <= next_wait_cnt;
    current_st <= next_st;
  end
   
always @(*)
  begin
     next_wait_cnt = wait_cnt;
     next_st = current_st;
     spi_cmd_en_0 = 1'b0;
     spi_cmd_0 = 5'd0;
     spi_wr_data_0 = spi_wr_data_1;
     spi_cmd_instr_0 = spi_cmd_instr_1;

     instr1_0 = instr1_1;
     instr2_0 = instr2_1;

     check_busy_0 = check_busy_1;
     
     case (current_st)
       ST_IDLE: begin
	  //To decide which instruction to kick off.
	  if (sector_erase) begin 
	     next_st = ST_CMD0_0;
	     instr1_0 = 5'h8;
	     instr2_0 = 5'hd;             //Sector Erase
	     check_busy_0 = 1'b1;
	  end
	  
	  else if (fast_read) begin 
	     next_st = ST_CMD1_0;         //Skip WEL
	     instr1_0 = 5'h8;
	     instr2_0 = 5'h14;            //Fast Read
	     check_busy_0 = 1'b0;
	  end

	  else if (fast_read_dual) begin 
	     next_st = ST_CMD1_0;         //Skip WEL
	     instr1_0 = 5'h8;
	     instr2_0 = 5'h15;            //Fast Read Dual
	     check_busy_0 = 1'b0;
	  end
	  
	  else if (quad_fast_read) begin 
	     next_st = ST_CMD1_0;         //Skip WEL
	     instr1_0 = 5'h8;
	     instr2_0 = 5'h17;            //Fast Read Dual
	     check_busy_0 = 1'b0;
	  end
	  
	  else if (page_write) begin 
	     next_st = ST_CMD0_0;
	     instr1_0 = 5'h8;
	     instr2_0 = 5'hc;             //Page Write
	     check_busy_0 = 1'b1; 
	  end

	  else if (quad_page_write) begin 
	     next_st = ST_CMD0_0;
	     instr1_0 = 5'h8;
	     instr2_0 = 5'h16;             //Quad Page Write
	     check_busy_0 = 1'b1; 
	  end

	  else if (quad_enable) begin 
	     next_st = ST_REG2_STATUS0;
	     instr1_0 = 5'h8;
	     instr2_0 = 5'ha;            //Quad Enable - read statreg2 first then write enable, finally write reg2
	     check_busy_0 = 1'b1; 
	  end


	  else if (soft_reset[5]) begin
	     next_st = ST_CMD1_0;         //Skip WEL
	     instr1_0 = 5'h8;
	     instr2_0 = 5'h1;             //Soft Reset
	     check_busy_0 = 1'b1;
	  end
	  
	   
       end

       ST_CMD0_0: begin
	  spi_cmd_instr_0 = 8'h20;
	  spi_cmd_en_0 = 1'b1;
	  spi_cmd_0 = instr1_1;         //Write Enable Instruction
	  next_st = ST_CMD0_1;
  
       end

       ST_CMD0_1: begin
	  spi_cmd_instr_0 = 8'h20;
	  spi_cmd_en_0 = 1'b0;     //Clear the cmd_en
	  spi_cmd_0 = instr1_1;         
	  next_st = ST_CMD0_2;
       end

       ST_CMD0_2: begin
	  spi_cmd_instr_0 = 8'h20;
	  spi_cmd_en_0 = 1'b0;     
	  spi_cmd_0 = instr1_1;
          if (busy)                //Check for busy status 
	    next_st = ST_CMD0_3;
       end

       ST_CMD0_3 : begin
	  spi_cmd_instr_0 = 8'h20;
	  spi_cmd_en_0 = 1'b0;     
	  spi_cmd_0 = instr1_1;
	  if (~busy)
	    next_st = ST_CMD1_0;
       end


       ST_CMD1_0: begin
	  spi_cmd_instr_0 = 8'h20;
	  spi_cmd_en_0 = 1'b1;
	  spi_cmd_0 = instr2_1;         //Sector Erase Instruction
	  next_st = ST_CMD1_1;
  
       end

       ST_CMD1_1: begin
	  spi_cmd_instr_0 = 8'h20;
	  spi_cmd_en_0 = 1'b0;     //Clear the cmd_en
	  spi_cmd_0 = instr2_1;         
	  next_st = ST_CMD1_2;
       end

       ST_CMD1_2: begin
	  spi_cmd_instr_0 = 8'h20;
	  spi_cmd_en_0 = 1'b0;     
	  spi_cmd_0 = instr2_1;
          if (busy)                //Check for busy status 
	    next_st = ST_CMD1_3;
       end

       ST_CMD1_3 : begin
	  spi_cmd_instr_0 = 8'h20;
	  spi_cmd_en_0 = 1'b0;     
	  spi_cmd_0 = instr2_1;
	  if (~busy) begin 
	     if (check_busy_1)
	       next_st = ST_CMD2_0;
	     else 
	       next_st = ST_IDLE;
	  end
       end // case: ST_CMD1_3
       
	  
       ST_CMD2_0: begin
	  spi_cmd_instr_0 = 8'h20;
	  spi_cmd_en_0 = 1'b1;
	  spi_cmd_0 = 5'd14;         //Read Status Register 1
	  next_st = ST_CMD2_1;
       end
       

       ST_CMD2_1: begin
	  spi_cmd_instr_0 = 8'h20;
	  spi_cmd_en_0 = 1'b0;     //Clear the cmd_en
	  spi_cmd_0 = 5'd14;         
	  next_st = ST_CMD2_2;
       end

       ST_CMD2_2: begin
	  spi_cmd_instr_0 = 8'h20;
	  spi_cmd_en_0 = 1'b0;     
	  spi_cmd_0 = 5'd14;
          if (busy)                //Check for busy status 
	    next_st = ST_CMD2_3;
       end

       ST_CMD2_3 : begin
	  spi_cmd_instr_0 = 8'h20;
	  spi_cmd_en_0 = 1'b0;     
	  spi_cmd_0 = 5'd14;
	  if (~busy)
	    next_st = ST_CHECK_STATUS0;
       end

       ST_CHECK_STATUS0 : next_st = ST_CHECK_STATUS1;
       ST_CHECK_STATUS1 : next_st = ST_CHECK_STATUS2;
       
       ST_CHECK_STATUS2 : begin
	  spi_cmd_instr_0 = 8'h20;
	  spi_cmd_en_0 = 1'b0;     
	  spi_cmd_0 = 5'd14;
	  if (~flash_rd_status_reg0[0])
	    next_st = ST_IDLE;
	  else
	    next_st = ST_CMD2_0;
       end

       ST_REG2_STATUS0 : begin
	  spi_cmd_instr_0 = 8'h20;
	  spi_cmd_en_0 = 1'b1;     
	  spi_cmd_0 = 5'd15;
	  next_wait_cnt = 3'd0;
	  next_st = ST_REG2_STATUS1;
       end

       ST_REG2_STATUS1 : begin
	  spi_cmd_instr_0 = 8'h20;
	  spi_cmd_en_0 = 1'b0;     
	  spi_cmd_0 = 5'd15;
	  if (busy == 1'b0 && wait_cnt >= 3'd3) begin
	     next_wait_cnt = 3'd0;
	     next_st = ST_REG2_STATUS2;
	  end
	  else begin
	     next_wait_cnt = wait_cnt + 1'b1;
          end
       end
       
       ST_REG2_STATUS2 : begin
	  if (flash_rd_status_reg1[1])
	    next_st = ST_IDLE;		// QUAD_ENABLE already on, no action
          else begin  
	    next_st = ST_WREG2_0;	// write status reg2
    	  end
       end

       ST_WREG2_0 : begin
	  spi_cmd_instr_0 = 8'h20;
	  spi_cmd_en_0 = 1'b1;
	  spi_cmd_0 = instr1_1;         //Write Enable Instruction
	  next_st = ST_WREG2_1;
       end

       ST_WREG2_1: begin
	  spi_cmd_instr_0 = 8'h20;
	  spi_cmd_en_0 = 1'b0;     //Clear the cmd_en
	  spi_cmd_0 = instr1_1;
 	  if (busy)	  
	    next_st = ST_WREG2_2;
       end

       ST_WREG2_2: begin
	  spi_cmd_instr_0 = 8'h20;
	  spi_cmd_en_0 = 1'b0;     
	  spi_cmd_0 = instr1_1;
          if (~busy)                //Check for busy status 
	    next_st = ST_WREG2_3;
       end

       ST_WREG2_3 : begin
	  spi_cmd_instr_0 = 8'h20;
	  spi_cmd_en_0 = 1'b1;     
	  spi_cmd_0 = instr2_1;
	  spi_wr_data_0 = flash_rd_status_reg1 | 8'h02; // set bit-9 = 1
	  if (busy == 1'b0 && wait_cnt >= 3'd3) begin
	    spi_cmd_en_0 = 1'b0;
	    next_wait_cnt = 3'd0;
	    next_st = ST_WREG2_4;
          end
	  else begin
	    next_wait_cnt = wait_cnt + 1'b1;
          end
       end

       ST_WREG2_4 : begin
	  next_st = ST_CMD2_0;
       end
      
     endcase // case (current_st)
    
  end // always @ (*)
   

   
   always @(posedge clk_in)
     if (rst_in)
       begin
	  spi_wr_data_1 <= 8'h0;
	  spi_cmd_instr_1 <= 8'd0;
	  spi_cmd_en_1 <= 1'b0;
	  spi_cmd_1 <= 5'b0;
	  instr1_1 <= 5'd0;
	  instr2_1 <= 5'd0;
	  busy_1 <= 1'b0;
	  check_busy_1 <= 1'b0;
       end
     else
       begin
	  spi_wr_data_1 <= spi_wr_data_0;
	  spi_cmd_instr_1 <= spi_cmd_instr_0;
	  spi_cmd_en_1 <= spi_cmd_en_0;
	  spi_cmd_1 <= spi_cmd_0;
	  instr1_1 <= instr1_0;
	  instr2_1 <= instr2_0;
	  busy_1 <= (current_st != ST_IDLE);
	  check_busy_1 <= check_busy_0;
       end // else: !if(rst_in)


   always @(posedge clk_in)
     if (rst_in | ((page_write | quad_page_write) & wren))
       begin
	  byte_cnt <= 9'h000;
       end

     else if (wren & shift_bytes)
       begin
	  byte_cnt <= byte_cnt + 1;
       end

   //Support 1-256
   always @(posedge clk_in)
     if (rst_in)
       byte_cnt_out <= 9'h000;
     else if ((page_write | quad_page_write) & wren)
       byte_cnt_out <= byte_cnt;
 
       
   
   always @(posedge clk_in)
     if (rst_in)
       soft_reset <= 6'b00_0001;
     else
       soft_reset <= soft_reset << 1;
   
/////////////////////////
//Sector Erase Steps
/////////////////////////
//Write Enable Instruction
//Erase
//Erase Done? [Check the status register?]

//Test Case
////Set the Erase Command Instruction to Sector Erase (0x20)
//jtag_intreg_write(`INTREG_IP_INSTR,8'h20); //Erase Instruction Command Setting/Type
//jtag_intreg_read(`INTREG_IP_INSTR,8'h20); //Erase Instruction Command Setting/Type
//
//#100000;
//
////Issue Write Enable Before Any Erase Commands. 
//$display("IP Command : Write Enable");
//jtag_intreg_write(`INTREG_IP_CMD,8'h83); //Write Enable Instruction Command. 
//jtag_intreg_write(`INTREG_IP_CMD,8'h00); //Clear Write Enable Instruction Command
//
//#100000;
//
//$display("IP Command : ERASE");
//jtag_intreg_write(`INTREG_IP_CMD,8'h8d); //Erase Instruction Command.
//jtag_intreg_write(`INTREG_IP_CMD,8'h00); //Erase Instruction Command.

   

//////////////////////////
//Fast Read
//////////////////////////
//Read the data        
//If there's busy status, ignore the fast read instruction. 

//Test Case
//$display("IP Command : Write Enable");
//jtag_intreg_write(`INTREG_IP_CMD,8'h83); //Write Enable Instruction Command. 
//jtag_intreg_write(`INTREG_IP_CMD,8'h00); //Clear Write Enable Instruction Command
//
//#1000;
//
//jtag_intreg_write(`INTREG_IP_CMD,8'h8e); //Burst fast Read Instruction Command.
//jtag_intreg_write(`INTREG_IP_CMD,8'h00); //Burst Read Instruction Command.   
   
   

endmodule // efx_command_ctl



//////////////////////////////////////////////////////////////////////////////
// Copyright (C) 2013-2019 Efinix Inc. All rights reserved.
//
// This   document  contains  proprietary information  which   is
// protected by  copyright. All rights  are reserved.  This notice
// refers to original work by Efinix, Inc. which may be derivitive
// of other work distributed under license of the authors.  In the
// case of derivative work, nothing in this notice overrides the
// original author's license agreement.  Where applicable, the 
// original license agreement is included in it's original 
// unmodified form immediately below this header.
//
// WARRANTY DISCLAIMER.  
//     THE  DESIGN, CODE, OR INFORMATION ARE PROVIDED “AS IS” AND 
//     EFINIX MAKES NO WARRANTIES, EXPRESS OR IMPLIED WITH 
//     RESPECT THERETO, AND EXPRESSLY DISCLAIMS ANY IMPLIED WARRANTIES, 
//     INCLUDING, WITHOUT LIMITATION, THE IMPLIED WARRANTIES OF 
//     MERCHANTABILITY, NON-INFRINGEMENT AND FITNESS FOR A PARTICULAR 
//     PURPOSE.  SOME STATES DO NOT ALLOW EXCLUSIONS OF AN IMPLIED 
//     WARRANTY, SO THIS DISCLAIMER MAY NOT APPLY TO LICENSEE.
//
// LIMITATION OF LIABILITY.  
//     NOTWITHSTANDING ANYTHING TO THE CONTRARY, EXCEPT FOR BODILY 
//     INJURY, EFINIX SHALL NOT BE LIABLE WITH RESPECT TO ANY SUBJECT 
//     MATTER OF THIS AGREEMENT UNDER TORT, CONTRACT, STRICT LIABILITY 
//     OR ANY OTHER LEGAL OR EQUITABLE THEORY (I) FOR ANY INDIRECT, 
//     SPECIAL, INCIDENTAL, EXEMPLARY OR CONSEQUENTIAL DAMAGES OF ANY 
//     CHARACTER INCLUDING, WITHOUT LIMITATION, DAMAGES FOR LOSS OF 
//     GOODWILL, DATA OR PROFIT, WORK STOPPAGE, OR COMPUTER FAILURE OR 
//     MALFUNCTION, OR IN ANY EVENT (II) FOR ANY AMOUNT IN EXCESS, IN 
//     THE AGGREGATE, OF THE FEE PAID BY LICENSEE TO EFINIX HEREUNDER 
//     (OR, IF THE FEE HAS BEEN WAIVED, $100), EVEN IF EFINIX SHALL HAVE 
//     BEEN INFORMED OF THE POSSIBILITY OF SUCH DAMAGES.  SOME STATES DO 
//     NOT ALLOW THE EXCLUSION OR LIMITATION OF INCIDENTAL OR 
//     CONSEQUENTIAL DAMAGES, SO THIS LIMITATION AND EXCLUSION MAY NOT 
//     APPLY TO LICENSEE.
//
/////////////////////////////////////////////////////////////////////////////



/////////////////////////////////////////////////////////////////////////////
//           _____       
//          / _______    Copyright (C) 2013-2020 Efinix Inc. All rights reserved.
//         / /       \   
//        / /  ..    /   `IP_MODULE_NAME(efx_flash_controller_top).v
//       / / .'     /    
//    __/ /.'      /     Description:
//   __   \       /      flash controller top module
//  /_/ /\ \_____/ /     
// ____/  \_______/      
//
// *******************************
// Revisions:
// 1.0 Initial rev
//
// *******************************

`resetall
`timescale 1 ps/1 ps

  module `IP_MODULE_NAME(efx_flash_controller_top) (
       //User Logics 
       //Inputs 
       rst_in, //Active High Reset
       clk_in, //Input System Clock

   //Command Instruction
       fast_read, //FAST READ
       sector_erase, //SECTOR ERASE
       page_write, //PAGE WRITE
       fast_read_dual, //FAST READ DUAL 
       quad_fast_read,
       quad_io_fast_read,
       quad_page_write,
       quad_enable,

   //User Control 
       address, //24-bits ADDR
       rden, 
       wren,
       shift_bytes, //Shift the data for 
       datain,
       dataout,
       data_valid,
   
   //Status Flags
       busy, //Busy Status
   
   //Serial Flash Interface
       miso,    //MISO
       miso_1,  //MISO Bit-1
       miso_2,  //MISO Bit-2
       miso_3,  //MISO Bit-3
       sclk,    //SCLK
       nss,     //Chip Select
       mosi,    //MOSI
       mosi_1,    //MOSI Bit-1
       mosi_2,    //MOSI Bit-2
       mosi_3,    //MOSI Bit-3
       mosi_oe  //Active High Output Enable of MOSI Pin
   );
   
    parameter ADDR_WIDTH = 24;  //Support 24
    parameter SCLK_DIV = 8;      //Support 1-32
    
   //User Logics 
   //Inputs 
   input 		  rst_in; //Active High Reset
   input 		  clk_in; //Input System Clock

   //Command Instruction
   input 		  fast_read; //FAST READ
   input 		  sector_erase; //SECTOR ERASE
   input 		  page_write; //PAGE WRITE
   input 		  fast_read_dual; //FAST READ DUAL 
   input		  quad_fast_read;  // quad fast read
   input		  quad_io_fast_read;  // quad io fast read
   input		  quad_page_write;  // quad page write
   input		  quad_enable;  // set quad enable bit

   //User Control 
   input [ADDR_WIDTH-1:0] address; //24-bits ADDR
   input 		  rden; 
   input 		  wren;
   input 		  shift_bytes; //Shift the data for 
   input [7:0]    datain;
   
   output [7:0]   dataout;
   output 		  data_valid;
   
   //Status Flags
   output 		  busy; //Busy Status
   
   //Serial Flash Interface
   input 		  miso;    //MISO
   input 		  miso_1;  //MISO Bit-1
   input 		  miso_2;  //MISO Bit-2
   input 		  miso_3;  //MISO Bit-3
   output 		  sclk;    //SCLK
   output 		  nss;     //Chip Select
   output 		  mosi;    //MOSI
   output 		  mosi_1;    //MOSI Bit-1
   output 		  mosi_2;    //MOSI Bit-2
   output 		  mosi_3;    //MOSI Bit-3
   output         mosi_oe;  //Active High Output Enable of MOSI Pin

   //Internal Signals
   wire   fifo_we;
   wire [7:0] fifo_datain;
   wire [7:0] wfifo_data;
   wire       wfifo_rd;
   wire       page_program_done;
   wire       busy_int;

   wire       spi_cmd_en;
   wire [4:0] spi_cmd;
   wire [7:0] spi_wr_data;
   wire [7:0] spi_cmd_instr;
   wire       fast_read_final;
   wire       fast_read_dual_final;
   wire       quad_fast_read_final;
   wire       quad_io_fast_read_final;
   wire [8:0] byte_cnt;
   wire [7:0] flash_rd_status_reg0;
   wire [7:0] flash_rd_status_reg1;
   

   localparam WFIFO_DEPTH_256 = 8'd1;  //fix to maximum 256 burst
   localparam RFIFO_DEPTH_256 = 8'd1;
  
   wire       data_valid_w;
   
   assign     data_valid = data_valid_w;

// Flash Controller from EFX-A001 Project.
   `IP_MODULE_NAME(efx_spi_shifter)
     #(
       .WFIFO_DEPTH_256(WFIFO_DEPTH_256),
       .RFIFO_DEPTH_256(RFIFO_DEPTH_256),
       .SCLK_FREQ((SCLK_DIV-1)),
       .ADDR_WIDTH(ADDR_WIDTH)
       )
     u_efx_spi_shifter
     (
      //Outputs
      .jedec_id_reg                     (),
      .manufacturing_id_reg             (),
      .unique_id_reg                    (),
      .device_id_reg                    (),
      .spi_flash_rd_status_reg0         (flash_rd_status_reg0),
      .spi_flash_rd_status_reg1         (flash_rd_status_reg1),
      .spi_flash_rd_status_reg2         (),
      .erase_en                         (),
      .fsm_status                       (), 
    
      // Outputs
      .pll_rst				(),                     //active low pll reset. 
      .data_out				(dataout),              //Flash Controller - Return Read Data (Byte) 
      .data_valid			(data_valid_w),           //Flash Controller - Read Data Valid Flag. 
      .busy				(busy_int),                        
     
      .sclk				(sclk),                 //spi flash SCLK (Port)  
      .nss				(nss),                  //spi active low chip select (Port) 
      .mosi				(mosi),                 //spi MOSI (Port)
      .mosi_1				(mosi_1),                 //spi MOSI (Port)
      .mosi_2				(mosi_2),                 //spi MOSI (Port)
      .mosi_3				(mosi_3),                 //spi MOSI (Port)
      .mosi_oe                          (mosi_oe),              //spi MOSI Output Enable (Active High)
      .wfifo_rd                         (wfifo_rd),             //write fifo (read). 
      .page_program_done                (page_program_done),    // write done flag. 
      
      // Inputs
      .nrst				(~rst_in),               //active low system reset. 
      .clkin				(clk_in),                //2X SCLK Clock 
      .locked				(1'b1),                  //PLL Locked
      .rden                             (rden),             
      .spi_cmd_en                       (spi_cmd_en),         //From efx spi pgm
      .spi_cmd				(spi_cmd[4:0]),       //From efx spi pgm
      .address				(address),            //24 bits ADDRESS FROM USER. 
      .data_in				(spi_wr_data[7:0]),   //From efx spi pgm
      .spi_cmd_instr                    (spi_cmd_instr[7:0]), //From efx spi pgm
      
      .burst_data_wr                    (wfifo_data),
      .miso				(miso),           //spi flash MISO (Port)
      .miso_1                           (miso_1),         //Bit-1 MISO
      .miso_2                           (miso_2),         //Bit-1 MISO
      .miso_3                           (miso_3),         //Bit-1 MISO
      .byte_cnt                         (byte_cnt),      
      .w_burst_size                     (8'h01),          //spi burst write data size. 
      .r_burst_size                     (8'h10)           //spi burst read data size. 
      );


//Write FIFO (Store the data)

   function integer depth2width;
      input [31:0] depth;
      begin
	 if (depth > 1) begin
	    depth = depth - 1;
	    for (depth2width=0; depth>0; depth2width = depth2width + 1)
	      depth = depth>>1;
	 end
	 else
	   depth2width = 0;
      end
   endfunction
   
   //FIFO Parameters
   parameter WFIFO_DEPTH = WFIFO_DEPTH_256 * 256;
   parameter SPI_ADDR_WIDTH = depth2width(WFIFO_DEPTH);
   
			     
 
   assign fifo_we = wren & shift_bytes;
   assign fifo_datain = datain;
   
   /*efx_fifo_top #(
       .DATA_WIDTH (8),    
       .DEPTH      (WFIFO_DEPTH),
       .SYNC_CLK   (1),
       .MODE       ("STANDARD")
   ) u_wfifo (
       .a_rst_i    (rst_in),
       .clk_i      (clk_in),
       .wdata      (fifo_datain),
       .wr_en_i    (fifo_we),
       .rdata      (wfifo_data),
       .rd_en_i    (wfifo_rd)
   );*/

   `IP_MODULE_NAME(dual_clock_fifo_wrapper)
     #(
       .DATA_WIDTH(8),                   //Data Width - 8 bits.      
       .ADDR_WIDTH(SPI_ADDR_WIDTH),      //Address - 24 bits.
       .LATENCY(1),                      //Flag latency - 1 
       .FIFO_MODE("STD_FIFO"),           //Standard FIFO
       .RAM_INIT_FILE(""),               //No Intialization file for ram.
       .COMPATIBILITY("E"),              //
       .OUTPUT_REG("FALSE"),             //No output register. 
       .CHECK_FULL("TRUE"),              //Skip the write if fifo full.             
       .CHECK_EMPTY("TRUE"),             //Skip the read if fifo empty. 
       .AFULL_THRESHOLD(WFIFO_DEPTH),
       .AEMPTY_THRESHOLD(1)
       )
   u_wfifo
     (
      .i_arst    (rst_in),
      .i_wclk    (clk_in),
      .i_we      (fifo_we),
      .i_wdata   (fifo_datain),
      .i_rclk    (clk_in),          
      .i_re      (wfifo_rd),           //Connect to SPI Shifter. 
      .o_full    (),              
      .o_empty   (),                   //Indicate that the FIFO is empty, ready for software to do burst write. 
      .o_rdata   (wfifo_data),
      .o_afull   (),
      .o_wcnt    (),
      .o_aempty  (),
      .o_rcnt    ()
      );

 

   assign fast_read_final = fast_read & rden;
   assign fast_read_dual_final = fast_read_dual & rden;
   assign quad_fast_read_final = quad_fast_read & rden;
   assign quad_io_fast_read_final = quad_io_fast_read & rden;
   
//Command Controller 
   `IP_MODULE_NAME(efx_command_ctl) u_efx_command_ctl
     (
      // Outputs
      .byte_cnt_out                     (byte_cnt[8:0]),          //User Byte Counter
      .spi_cmd_en			(spi_cmd_en),             //Command enable 
      .spi_cmd				(spi_cmd[4:0]),           //Command Instruction
      .spi_wr_data			(spi_wr_data[7:0]),       //
      .spi_cmd_instr			(spi_cmd_instr[7:0]),     //Special Command Instruction 
      .busy_out				(busy),                   //This flag indicates :
                                                                  //busy status while executing
                                                                  //multiple instruction command
      // Inputs
      .rst_in				(rst_in),
      .clk_in				(clk_in),
      .wren                             (wren),
      .shift_bytes                      (shift_bytes),      
      .fast_read			(fast_read_final),      //from top - User control
      .fast_read_dual                   (fast_read_dual_final), //from top - User Control
      .quad_fast_read                   (quad_fast_read_final), //from top - User Control
      .quad_io_fast_read                (quad_io_fast_read_final), //from top - User Control
      .sector_erase			(sector_erase),         //from top - User control
      .page_write			(page_write),           //from top - User control
      .quad_page_write			(quad_page_write),
      .quad_enable			(quad_enable),
      .flash_rd_status_reg0             (flash_rd_status_reg0), //from `IP_MODULE_NAME(efx_spi_shifter) block.
      .flash_rd_status_reg1             (flash_rd_status_reg1), //from `IP_MODULE_NAME(efx_spi_shifter) block.
      .data_valid             		(data_valid_w), //from `IP_MODULE_NAME(efx_spi_shifter) block.
      .busy				(busy_int));            //from `IP_MODULE_NAME(efx_spi_shifter) block to
                                                                //indicate the status of FSM. 
   
   
endmodule // efx_flash_controller_top

//////////////////////////////////////////////////////////////////////////////
// Copyright (C) 2013-2019 Efinix Inc. All rights reserved.
//
// This   document  contains  proprietary information  which   is
// protected by  copyright. All rights  are reserved.  This notice
// refers to original work by Efinix, Inc. which may be derivitive
// of other work distributed under license of the authors.  In the
// case of derivative work, nothing in this notice overrides the
// original author's license agreement.  Where applicable, the 
// original license agreement is included in it's original 
// unmodified form immediately below this header.
//
// WARRANTY DISCLAIMER.  
//     THE  DESIGN, CODE, OR INFORMATION ARE PROVIDED “AS IS” AND 
//     EFINIX MAKES NO WARRANTIES, EXPRESS OR IMPLIED WITH 
//     RESPECT THERETO, AND EXPRESSLY DISCLAIMS ANY IMPLIED WARRANTIES, 
//     INCLUDING, WITHOUT LIMITATION, THE IMPLIED WARRANTIES OF 
//     MERCHANTABILITY, NON-INFRINGEMENT AND FITNESS FOR A PARTICULAR 
//     PURPOSE.  SOME STATES DO NOT ALLOW EXCLUSIONS OF AN IMPLIED 
//     WARRANTY, SO THIS DISCLAIMER MAY NOT APPLY TO LICENSEE.
//
// LIMITATION OF LIABILITY.  
//     NOTWITHSTANDING ANYTHING TO THE CONTRARY, EXCEPT FOR BODILY 
//     INJURY, EFINIX SHALL NOT BE LIABLE WITH RESPECT TO ANY SUBJECT 
//     MATTER OF THIS AGREEMENT UNDER TORT, CONTRACT, STRICT LIABILITY 
//     OR ANY OTHER LEGAL OR EQUITABLE THEORY (I) FOR ANY INDIRECT, 
//     SPECIAL, INCIDENTAL, EXEMPLARY OR CONSEQUENTIAL DAMAGES OF ANY 
//     CHARACTER INCLUDING, WITHOUT LIMITATION, DAMAGES FOR LOSS OF 
//     GOODWILL, DATA OR PROFIT, WORK STOPPAGE, OR COMPUTER FAILURE OR 
//     MALFUNCTION, OR IN ANY EVENT (II) FOR ANY AMOUNT IN EXCESS, IN 
//     THE AGGREGATE, OF THE FEE PAID BY LICENSEE TO EFINIX HEREUNDER 
//     (OR, IF THE FEE HAS BEEN WAIVED, $100), EVEN IF EFINIX SHALL HAVE 
//     BEEN INFORMED OF THE POSSIBILITY OF SUCH DAMAGES.  SOME STATES DO 
//     NOT ALLOW THE EXCLUSION OR LIMITATION OF INCIDENTAL OR 
//     CONSEQUENTIAL DAMAGES, SO THIS LIMITATION AND EXCLUSION MAY NOT 
//     APPLY TO LICENSEE.
//
/////////////////////////////////////////////////////////////////////////////



/////////////////////////////////////////////////////////////////////////////
//           _____       
//          / _______    Copyright (C) 2013-2020 Efinix Inc. All rights reserved.
//         / /       \   
//        / /  ..    /   `IP_MODULE_NAME(efx_spi_shifter).v
//       / / .'     /    
//    __/ /.'      /     Description:
//   __   \       /      flash controller FSM to shift the serial data in and out to SPI interface
//  /_/ /\ \_____/ /     
// ____/  \_______/      
//
// *******************************
// Revisions:
// 1.0 Initial rev
//
// *******************************
`resetall
`timescale 1 ps/1 ps

  module `IP_MODULE_NAME(efx_spi_shifter)
    #(
      parameter WFIFO_DEPTH_256 = 8'd1,
      parameter RFIFO_DEPTH_256 = 8'd1,
      parameter SCLK_FREQ = 1,
      parameter ADDR_WIDTH = 24
      )
   (
    input 		   nrst,
    input 		   clkin,
    
    // to PLL
    input 		   locked,
    output 		   pll_rst,
    
    // command interface - spi_cmd
    //1 soft_reset,         // soft reset. 
    //2 read,               // read 
    //3 read_device_id,     // read device id
    //4 read_unique_id,     // read unique id
    //5 read_reg,	    // read status register 1/2/3; data_in as command
    //6 read_jedec_id,      // read jedec id.
    //8 write_enable,	    // write enable (0x06)
    //9 write_reg1,	    // write status register 1
    //10 write_reg2,	    // write status register 2
    //11 write_reg3,	    // write status register 3 
    //12 write,             // Page Program 
    //13 erase,             // Ease
    //14 read_reg1          // read status register 1
    //15 read_reg2          // read status register 2
    //16 read_reg3          // read status register 3
    //17 read_manufacturing_id // read manufacturing id.
    //18 write_enable_for_volatile,	    // write volatile status (0x50)
    //19 write_disable                      // write disable (0x04)
    //20 fast_read           //Fast Read 
    //21 fast_read_dual
 
    // New commands for Quad 1/11/2021 - Must Status_register2 S9 (bit 1) = 1
    //22 quad_write,	// Quad page program
    //23 quad_fast_read,	// Quad fast read
    //24 quad_fast_io_read,	// Quad fast IO read
    input 		   spi_cmd_en, //To enable the spi_cmd opcode command. 
    input [4:0] 	   spi_cmd,
    input [7:0] 	   spi_cmd_instr, 
    input [ADDR_WIDTH-1:0] address,
    input [7:0] 	   data_in, // command or data to input
    input [7:0] 	   burst_data_wr,
    input [8:0] 	   byte_cnt,
    input [7:0] 	   w_burst_size, //SPI Burst Write Size. 1 - 256, 2 - 512
    input [7:0] 	   r_burst_size, //SPI Burst Read Size.  1 - 256, 2 - 512
    input 		   rden,
    output [7:0] 	   data_out,
    output 		   busy,
    output 		   data_valid,

    //Output
    output reg [23:0] 	   jedec_id_reg,
    output reg [7:0] 	   manufacturing_id_reg,
    output reg [63:0] 	   unique_id_reg,
    output reg [7:0] 	   device_id_reg,
    output reg [7:0] 	   spi_flash_rd_status_reg0 ,
    output reg [7:0] 	   spi_flash_rd_status_reg1 ,
    output reg [7:0] 	   spi_flash_rd_status_reg2 ,

    output reg 		   erase_en, //This bit indicate erase command is enabled. When user issue write enable command, this bit set to high.
                              //When user isse write disable command, this bit set to low.
    output [4:0] 	   fsm_status,
    output wire 	   wfifo_rd,
    output reg 		   page_program_done,
    // SPI interface
    input 		   miso, // SPI MISO
    input 		   miso_1, //SPI MISO
    input 		   miso_2, //SPI MISO
    input 		   miso_3, //SPI MISO
    output 		   sclk, // SPI SCLK
    output 		   nss, // SPI SS
    output 		   mosi,    // SPI MOSI
    output 		   mosi_1,    // SPI MOSI
    output 		   mosi_2,    // SPI MOSI
    output 		   mosi_3,    // SPI MOSI
    output                 mosi_oe  //active high output enable
    );
   

///////////////////////////////////////
//FSM Definition
///////////////////////////////////////
reg [4:0] state;

//State Machine  
localparam IDLE             = 5'd0, 
  READ_CMD                  = 5'd1, 
  READ_DEVICE_ID_CMD        = 5'd2, 
  READ_JEDEC_ID_CMD         = 5'd4, 
  READ_UNIQUE_ID_CMD        = 5'd5, 
  RESET_CMD                 = 5'd6, 
  WRITE_CMD                 = 5'd7, 
  ERASE_CMD                 = 5'd8, 
  WRITE_DATA                = 5'd9, 
  READ_DATA                 = 5'd10, 
  WRITE_ENABLE_CMD          = 5'd11, 
  WRITE_REG_CMD             = 5'd12, 
  READ_REG_CMD              = 5'd13,
  READ_MANUFACTURING_ID_CMD = 5'd14,
  WRITE_ENABLE_VOL_CMD      = 5'd15,
  WRITE_DISABLE_CMD         = 5'd16,
  WBURST_CHK_STATUS         = 5'd17,
  WBURST_WEL_CLR            = 5'd18,
  WBURST_WE_INSTR           = 5'd19,
  WBURST_PAGE               = 5'd20,
  FAST_READ_CMD             = 5'd21,
  READ_DUMMY_DATA           = 5'd22;
 
   
   
   

//Command Setting    
localparam RESETDATA1 = 8'h66, //Enable Reset
  RESETDATA2          = 8'h99, //Reset Device 
  UNIQUEID_DATA       = 8'h4B, //Read Unique ID
  DEVICEID_DATA       = 8'hAB, //Release Power Down / Device ID. 
  WRITEDATA           = 8'h02, //Page Program 
  WRREG1_DATA         = 8'h01, //Write Status Register-1
  WRREG2_DATA         = 8'h31, //Write Status Register-2
  WRREG3_DATA         = 8'h11, //Write Status Register-3
  RDREG1_DATA         = 8'h05, //Read Status Register-1
  RDREG2_DATA         = 8'h35, //Read Status Register-2
  RDREG3_DATA         = 8'h15, //Read Status Register-3
  JEDECID_DATA        = 8'h9F, //Read JEDEC ID
  MANUFACTURING_ID_DATA = 8'h90, // Read manufacturing id. 
  WRITE_ENABLE_DATA     = 8'h06,              //Write Enable Instruction 
  WRITE_ENABLE_VOLATILE_STAT_DATA = 8'h50,    //Write Enable for Volatile Status Register 
  WRITE_DISABLE_DATA = 8'h04,                 //Write Disable.  
  BREAD_DATA = 8'h03,
  FAST_BREAD_DATA = 8'h0B,
  FAST_BREAD_DATA_DUAL = 8'h3B,
  CHIP_ERASE_0 = 8'hc7, //CHIP ERASE Command type 0
  CHIP_ERASE_1 = 8'h60, //Chip Erase Command type 1
  SECTOR_ERASE = 8'h20,       //
  BLOCK_32KB_ERASE = 8'h52,   //
  BLOCK_64KB_ERASE = 8'hD8,   //

// new commands for Quad rd/wr
  QUAD_WRITEDATA = 8'h32,
  FAST_BREAD_DATA_QUAD = 8'h6B,
  FAST_IO_BREAD_DATA_QUAD = 8'hEB;
   
   function integer depth2width;
      input [31:0] 	  depth;
      begin
	 if (depth > 1) begin
	    depth = depth - 1;
	    for (depth2width=0; depth>0; depth2width = depth2width + 1)
	      depth = depth>>1;
	 end
	 else
	   depth2width = 0;
      end
   endfunction

   localparam RBIT_CNT_SIZE = 12;//depth2width(RFIFO_DEPTH_256*256*8);
   localparam WBIT_CNT_SIZE = 12;//depth2width(WFIFO_DEPTH_256*256*8);
   
//Internal Signals    
   reg [7:0] cmd_in;
   reg [5:0] cnt,cnt_0;
   reg [5:0] sclkcnt;
   reg [RBIT_CNT_SIZE-1:0] readcnt;
   reg [WBIT_CNT_SIZE-1:0] writecnt;
   wire [RBIT_CNT_SIZE-1:0] r_burst_cnt_max;
   wire [WBIT_CNT_SIZE-1:0] w_burst_cnt_max;
   reg 	      sclk_reg, sclk_reg_d;
   //reg 	      read_done;
   reg 	      mosi_reg, nss_reg, busy_reg, data_valid_reg;
   reg [2:0]  mosi_breg;
   reg [7:0]  data_in_reg, data_out_reg, data_out_reg_d;
   reg [ADDR_WIDTH-1:0] address_reg;
   reg [ADDR_WIDTH-1:0] flash_address_reg;
   
   reg 	      spi_cmd_en0,spi_cmd_en1;
   wire       spi_cmd_en_pos;
   reg 	      burst_wr_flag;
   reg 	      burst_rd_flag;
   
   reg 	      wfifo_rd0,wfifo_rd1;
   reg 	      data_valid_reg0;
   reg 	      data_valid_reg1;
   reg [5:0]  cnt_max;
   reg [7:0]  spi_cmd_instr_reg;
   wire       sclk_reg_neg;
   wire       sclk_reg_pos;
   wire       sclk_trigger;
   wire       read_done;
   wire       c_read_done;
   reg        r_read_done;
   
   assign fsm_status =  state;

   //19 Feb 2020
   //CL
   assign mosi = mosi_reg;
   assign mosi_1 = mosi_breg[0];
   assign mosi_2 = mosi_breg[1];
   assign mosi_3 = mosi_breg[2];
   assign mosi_oe = (state!=READ_DATA && state!=IDLE);
   //assign mosi = (state==READ_DATA) ? 1'bz : mosi_reg;
   assign nss = nss_reg;
   assign busy = busy_reg;
   assign data_valid = (burst_rd_flag) ? data_valid_reg0 & ~data_valid_reg1 : 1'b0;
   assign data_out = data_out_reg_d;
   assign pll_rst = nrst;

//////////////////////////////
// SCLK Clock Generation
//////////////////////////////
   always @(posedge clkin)
     begin
	if (!nrst) begin
	   sclkcnt <= 6'd0;
	   sclk_reg <= 1'b0;
	   sclk_reg_d <= 1'b0;
	end
	else begin
	   if (sclkcnt == SCLK_FREQ) begin
	      sclk_reg <= ~sclk_reg;
	      sclkcnt <= 6'd0;
	   end
	   else begin
	      sclkcnt <= sclkcnt + 1'b1;
	   end
	   sclk_reg_d <= sclk_reg;
	end
     end // always @ (posedge clkin)

   assign sclk = sclk_reg;   
   assign sclk_reg_neg = (sclk_reg == 1'b0 && sclk_reg_d == 1'b1);
   assign sclk_reg_pos = (sclk_reg == 1'b1 && sclk_reg_d == 1'b0);
   
   assign sclk_trigger = (SCLK_FREQ == 0) ? sclk_reg_pos : sclk_reg_neg;

     
   //To decode the command instruction counter.
   always @(*)
     begin
	case (spi_cmd_instr[7:0])
	  CHIP_ERASE_0 : cnt_max[5:0] = 6'd8;
	  CHIP_ERASE_1 : cnt_max[5:0] = 6'd8;
	  default      : cnt_max[5:0] = (6'd8 + ADDR_WIDTH); //Sector/Block Erase.
	endcase // case (spi_cmd_instr[7:0])
     end
   
   
   always @(posedge clkin)
     if (~nrst)
       begin
	  spi_cmd_en0 <= 1'b0;
	  spi_cmd_en1 <= 1'b0;
       end
   
     else 
       begin
	  spi_cmd_en0 <= spi_cmd_en;
	  spi_cmd_en1 <= spi_cmd_en0;
       end // else: !if(~nrst)

   assign spi_cmd_en_pos = spi_cmd_en0 & ~spi_cmd_en1;
   
  
   
   ////////////////////////////
   //Burst Data Size
   ////////////////////////////

   //For write burst, it's always multiple of 256 bytes. 
   //assign w_burst_cnt_max = 'd256;
   assign w_burst_cnt_max = byte_cnt;
   
   //r_burst_size is no. of words multiple of 256
   //Translate to bits r_burst_size*256*8
 // always @(*) begin 
 //    case (r_burst_size)
 //	8'h01  : r_burst_cnt_max = 'd2048 - 1;
 //	8'h02  : r_burst_cnt_max = 'd4096 - 1;
 //	8'h0A  : r_burst_cnt_max = 'd20480 - 1;
 //	8'd20  : r_burst_cnt_max = 'd40960 - 1;
 //	8'd60 : r_burst_cnt_max = 'd122880 - 1;
 //	8'd100 : r_burst_cnt_max = 'd204800 - 1;
 //	default : r_burst_cnt_max = 'd2048 - 1;
 //    endcase // case (r_burst_size)   
 //  end // always @ (*)
   
   //assign r_burst_cnt_max = {r_burst_size,11'b0} -1;
   
   assign r_burst_cnt_max = (spi_cmd == 5'd23) ? ({3'b001, {{RBIT_CNT_SIZE-3}{1'b0}}} -1) :  //fast_read_quad
                            (spi_cmd == 5'd21) ? ({2'b01, {{RBIT_CNT_SIZE-2}{1'b0}}} -1) :  //fast_read_dual
                            ({1'b1, {{RBIT_CNT_SIZE-1}{1'b0}}} -1); //fast_read
   
  //w_burst_size
  //>1 - the state machine will change the burst loop state.
   reg state_loop_flag;
   reg [7:0] spi_wr_burst_size_cnt;
   reg [3:0] instr_wait_cnt;
   
   // SPI state machine
   always @(posedge clkin)
     begin
	if (!nrst) begin
	   nss_reg <= 1'b1;
	   mosi_reg <= 1'b1;
	   mosi_breg <= 3'b111;
	   busy_reg <= 1'b1;
	   data_valid_reg <= 1'b0;
	   data_out_reg <= 8'd0;
	   data_out_reg_d <= 8'd0;
	   address_reg <= 'h0;
	   flash_address_reg <= 'h0;
	   
	   data_in_reg <= 8'd0;
	   state <= IDLE;
	   erase_en <= 1'b0;
	   wfifo_rd0 <= 1'b0;
	   burst_wr_flag <= 1'b0;
	   burst_rd_flag <= 1'b0;
	   page_program_done <= 1'b0;
	   spi_cmd_instr_reg <= 8'h0;
	   writecnt <= {{WBIT_CNT_SIZE}*{1'b0}};
	   readcnt <= {{RBIT_CNT_SIZE}*{1'b0}};
	   cnt <= 6'd0;
	   //read_done <= 1'b0;
	   state_loop_flag <= 1'b0;
	   spi_wr_burst_size_cnt <= 8'h1;
	   instr_wait_cnt <= 4'h0;
	   
	end
	else begin
	   case (state)
	     IDLE: begin
		// SPI signals
		nss_reg <= 1'b1;
		mosi_reg <= 1'b1;
		mosi_breg <= 3'b111;
		instr_wait_cnt <= 4'h0;
		busy_reg <= 1'b0;
		readcnt <= 'b0;
		//read_done <= 1'b0;
		cnt <= 6'd0;
		
		data_in_reg <= data_in;
		address_reg <= address;
		flash_address_reg <= address;
		data_valid_reg <= 1'b0;
		
		// state change
		if (spi_cmd_en_pos)
		  begin 
		     case (spi_cmd)
		       5'd1: begin	// soft reset 0x1
			  busy_reg <= 1'b1;
			  cmd_in <= RESETDATA1;
			  state <= RESET_CMD;
		       end
		       5'd2: begin	// read data 0x2
			  data_out_reg_d <= 8'd0;
			  busy_reg <= 1'b1;
			  state <= READ_CMD;
			  cmd_in <= BREAD_DATA; //Burst Read Data
			  burst_rd_flag <= 1'b1;
		       end
		       5'd3: begin	// read device id 0x3
			  data_out_reg_d <= 8'd0;
			  busy_reg <= 1'b1;
			  cmd_in <= DEVICEID_DATA;
			  state <= READ_DEVICE_ID_CMD;
		       end
		       5'd4: begin	// read unique id 0x4
			  data_out_reg_d <= 8'd0;
			  busy_reg <= 1'b1;
			  cmd_in <= UNIQUEID_DATA;
			  state <= READ_UNIQUE_ID_CMD;
		       end
		       5'd5: begin	// read status register 0x5 - data_in as command
			  data_out_reg_d <= 8'd0;
			  busy_reg <= 1'b1;
			  cmd_in <= data_in[7:0];
			  state <= READ_REG_CMD;
		       end
		       5'd6: begin	// read JEDEC id 0x6
			  busy_reg <= 1'b1;
			  cmd_in <= JEDECID_DATA;
			  state <= READ_JEDEC_ID_CMD;
		       end
		       5'd8: begin	// write enable 0x8
			  busy_reg <= 1'b1;
			  cmd_in <= WRITE_ENABLE_DATA;
			  state <= WRITE_ENABLE_CMD;
			  erase_en <= 1'b1;
		       end
		       5'd9: begin	// write status reg 1
			  busy_reg <= 1'b1;
			  cmd_in <= WRREG1_DATA;
			  state <= WRITE_REG_CMD;
		       end
		       5'd10: begin	// write status reg 2
			  busy_reg <= 1'b1;
			  cmd_in <= WRREG2_DATA;
			  state <= WRITE_REG_CMD;
		       end
		       5'd11: begin	// write status reg 3
			  busy_reg <= 1'b1;
			  cmd_in <= WRREG3_DATA;
			  state <= WRITE_REG_CMD;
		       end
		       5'd12: begin	// page program 0xC
			  busy_reg <= 1'b1;
			  cmd_in <= WRITEDATA;
			  state <= WRITE_CMD;
			  wfifo_rd0 <= 1'b1;
			  burst_wr_flag <= 1'b1;
			  spi_wr_burst_size_cnt <= w_burst_size;
		       end
		       5'd13: begin	// erase page 0xD
			  busy_reg <= 1'b1;
			  state <= ERASE_CMD;
			  spi_cmd_instr_reg <= spi_cmd_instr;
			  
		       end
		       5'd14: begin	// read status register 0x05 - data_in as command
			  data_out_reg_d <= 8'd0;
			  busy_reg <= 1'b1;
			  cmd_in <= RDREG1_DATA;
			  state <= READ_REG_CMD;
		       end
		       5'd15: begin	// read status register 0x35 - data_in as command
			  data_out_reg_d <= 8'd0;
			  busy_reg <= 1'b1;
			  cmd_in <= RDREG2_DATA;
			  state <= READ_REG_CMD;
		       end
		       5'd16: begin	// read status register 0x15 - data_in as command
			  data_out_reg_d <= 8'd0;
			  busy_reg <= 1'b1;
			  cmd_in <= RDREG3_DATA;
			  state <= READ_REG_CMD;
		       end

		       5'd17: begin	// read manufacturing id
			  data_out_reg_d <= 8'd0;
			  busy_reg <= 1'b1;
			  cmd_in <= MANUFACTURING_ID_DATA;
			  state <= READ_MANUFACTURING_ID_CMD;
		       end

		       5'd18: begin	// write volatile status enable 0x18
			  busy_reg <= 1'b1;
			  cmd_in <= WRITE_ENABLE_VOLATILE_STAT_DATA;
			  state <= WRITE_ENABLE_VOL_CMD;
		       end
		       
		       5'd19: begin	// write disable 0x19
			  busy_reg <= 1'b1;
			  cmd_in <= WRITE_DISABLE_DATA;
			  state <= WRITE_DISABLE_CMD;
			  erase_en <= 1'b0;
		       end

		       5'd20: begin // fast read
			  data_out_reg_d <= 8'd0;
			  busy_reg <= 1'b1;
			  state <= FAST_READ_CMD;
			  cmd_in <= FAST_BREAD_DATA; //Burst Read Data
			  burst_rd_flag <= 1'b0;
		       end

		       5'd21: begin // fast read dual
			  data_out_reg_d <= 8'd0;
			  busy_reg <= 1'b1;
			  state <= FAST_READ_CMD;
			  cmd_in <= FAST_BREAD_DATA_DUAL; //Burst Read Data
			  burst_rd_flag <= 1'b0;
		       end
		       
		       5'd22: begin // quad page write
			  busy_reg <= 1'b1;
			  cmd_in <= QUAD_WRITEDATA;
			  state <= WRITE_CMD;
			  wfifo_rd0 <= 1'b1;
			  burst_wr_flag <= 1'b1;
			  spi_wr_burst_size_cnt <= w_burst_size;	
   		       end

		       5'd23: begin // quad fast read
			  data_out_reg_d <= 8'd0;
			  busy_reg <= 1'b1;
			  state <= FAST_READ_CMD;
			  cmd_in <= FAST_BREAD_DATA_QUAD; //Burst Read Data
			  burst_rd_flag <= 1'b0;
		       end

		       5'd24: begin // quad io fast read
			  data_out_reg_d <= 8'd0;
			  busy_reg <= 1'b1;
			  state <= FAST_READ_CMD;
			  cmd_in <= FAST_IO_BREAD_DATA_QUAD; //Burst Read Data
			  burst_rd_flag <= 1'b0;
		       end

		     endcase // case (spi_cmd)

		     page_program_done <= 1'b0;
		  end // if (spi_cmd_en)
		
		else begin
		   busy_reg <= 1'b0;
		   cmd_in <= 8'h00;
		   wfifo_rd0 <= 1'b0;
		   state <= IDLE;		   
		end // else: !if(spi_cmd_en)
	       
	     end // case: IDLE

	     

	     //Burst Read Data with 1 page (256 bytes). 
	     READ_CMD: begin			// data_in with read buffer command 0x03
		if (sclk_trigger) begin  // negedge of sclkreg
		   if (cnt < 6'd8) begin
		      nss_reg <= 1'b0;
		      mosi_reg <= cmd_in[7];	
		      cmd_in <= {cmd_in[6:0], 1'b0};
		      busy_reg <= 1'b1;
		      cnt <= cnt + 1'b1;
		   end
		   else if (cnt < (6'd8 + ADDR_WIDTH) ) begin
		      nss_reg <= 1'b0;
		      mosi_reg <= address_reg[ADDR_WIDTH-1];
		      address_reg <= {address_reg[ADDR_WIDTH-2:0], 1'b0};
		      cnt <= cnt + 1'b1;
		   end
		   else if (cnt == (6'd8 + ADDR_WIDTH)) begin
		      readcnt <= r_burst_cnt_max;	// read 256 bytes (2048 bits) data
		      cnt <= 6'd0;
		      state <= READ_DATA;
		   end
		end
	     end // case: READ_CMD


	     //Burst Read Data with 1 page (256 bytes). 
	     FAST_READ_CMD: begin			// data_in with read buffer command 0x03
		if (sclk_trigger) begin  // negedge of sclkreg
		    if (spi_cmd == 5'd24) begin
		  	if (cnt < 6'd2) begin
			   nss_reg <= 1'b0;
		   	   mosi_reg <= cmd_in[7];
		   	   mosi_breg <= cmd_in[6:4];	   
		   	   cmd_in <= {cmd_in[3:0], 4'h0};
		   	   busy_reg <= 1'b1;
		   	   cnt <= cnt + 1'b1;
		   	end
		   	else if (cnt < (6'd2 + ADDR_WIDTH/4)) begin
		   	   nss_reg <= 1'b0;
		   	   mosi_reg <= address_reg[ADDR_WIDTH-1:ADDR_WIDTH-4];
		   	   address_reg <= {address_reg[ADDR_WIDTH-5:0], 4'h0};
		   	   cnt <= cnt + 1'b1;
		   	end
		   	else if (cnt == (6'd2 + ADDR_WIDTH/4)) begin
		   	   readcnt <= 'd7;	// read 256 bytes (2048 bits) data
		   	   cnt <= 6'd0;
		   	   state <= READ_DUMMY_DATA;
		   	end
		    end
		    else begin
		   	if (cnt < 6'd8) begin
		   	   nss_reg <= 1'b0;
		   	   mosi_reg <= cmd_in[7];	
		   	   cmd_in <= {cmd_in[6:0], 1'b0};
		   	   busy_reg <= 1'b1;
		   	   cnt <= cnt + 1'b1;
		   	end
		   	else if (cnt < (6'd8 + ADDR_WIDTH)) begin
		   	   nss_reg <= 1'b0;
		   	   mosi_reg <= address_reg[ADDR_WIDTH-1];
		   	   address_reg <= {address_reg[ADDR_WIDTH-2:0], 1'b0};
		   	   cnt <= cnt + 1'b1;
		   	end
		   	else if (cnt == (6'd8 + ADDR_WIDTH)) begin
		   	   readcnt <= 'd7;	// read 256 bytes (2048 bits) data
		   	   cnt <= 6'd0;
		   	   state <= READ_DUMMY_DATA;
		   	end
		    end
		end
	     end
	     
	     READ_DEVICE_ID_CMD: begin	// send command 0xAB
		if (sclk_trigger) begin  // negedge of sclkreg
		   nss_reg <= 1'b0;
		   if (cnt < 6'd8) begin
		      mosi_reg <= cmd_in[7];
		      cmd_in <= {cmd_in[6:0], 1'b0};
		      cnt <= cnt + 1'b1;
		   end
		   else if (cnt < 6'd32) begin
		      mosi_reg <= 1'b0;
		      cnt <= cnt + 1'b1;
		   end
		   else if (cnt == 6'd32) begin
		      cnt <= 6'd0;
		      readcnt <= 'd7;	// read 8 bits
		      state <= READ_DATA;
		   end
		end
	     end // case: READ_DEVICE_ID_CMD


	     READ_MANUFACTURING_ID_CMD: begin	// send command 0x90
		if (sclk_trigger) begin  // negedge of sclkreg
		   nss_reg <= 1'b0;
		   if (cnt < 6'd8) begin
		      mosi_reg <= cmd_in[7];
		      cmd_in <= {cmd_in[6:0], 1'b0};
		      cnt <= cnt + 1'b1;
		   end
		   else if (cnt < 6'd32) begin
		      mosi_reg <= 1'b0;
		      cnt <= cnt + 1'b1;
		   end
		   else if (cnt == 6'd32) begin
		      cnt <= 6'd0;
		      readcnt <= 'd7;	// read 8 bits
		      state <= READ_DATA;
		   end
		end
	     end
	     
	     READ_UNIQUE_ID_CMD: begin	// send command 0x4B
		if (sclk_trigger) begin  // negedge of sclkreg
		   nss_reg <= 1'b0;
		   if (cnt < 6'd8) begin
		      mosi_reg <= cmd_in[7];
		      cmd_in <= {cmd_in[6:0], 1'b0};
		      cnt <= cnt + 1'b1;
		   end
		   else if (cnt < 6'd40) begin
		      mosi_reg <= 1'b0;
		      cnt <= cnt + 1'b1;
		   end
		   else if (cnt == 6'd40) begin
		      cnt <= 6'd0;
		      readcnt <= 'd63;	// read 64 bits
		      state <= READ_DATA;
		   end
		end
	     end
	     
	     READ_JEDEC_ID_CMD: begin	// send command 0x9F
		if (sclk_trigger) begin  // negedge of sclkreg
		   nss_reg <= 1'b0;
		   if (cnt < 6'd8) begin
		      mosi_reg <= cmd_in[7];
		      cmd_in <= {cmd_in[6:0], 1'b0};
		      cnt <= cnt + 1'b1;
		   end
		   else if (cnt == 6'd8) begin
		      cnt <= 6'd0;
		      readcnt <= 'd23;	// read 24 bits (3 bytes)
		      state <= READ_DATA;
		   end
		end
	     end
	     
	     READ_REG_CMD: begin	// send read status register command 0x05, 0x35, 0x15 (data_in)
		if (sclk_trigger) begin  // negedge of sclkreg
		   nss_reg <= 1'b0;
		   if (cnt < 6'd8) begin
		      mosi_reg <= cmd_in[7];
		      cmd_in <= {cmd_in[6:0], 1'b0};
		      cnt <= cnt + 1'b1;
		   end
		   else if (cnt == 6'd8) begin
		      cnt <= 6'd0;
		      readcnt <= 'd7;	// read 8 bits
		      state <= READ_DATA;
		   end
		end
	     end
	     
	     RESET_CMD: begin
		if (sclk_trigger) begin  // negedge of sclkreg
		   if (cnt < 6'd8) begin
		      nss_reg <= 1'b0;
		      mosi_reg <= cmd_in[7];	
		      cmd_in <= {cmd_in[6:0], 1'b0};
		      busy_reg <= 1'b1;
		      cnt <= cnt + 1'b1;
		   end
		   else if (cnt < 6'd11) begin
		      nss_reg <= 1'b1;
		      mosi_reg <= 1'b0;
		      cmd_in <= RESETDATA2;
		      cnt <= cnt + 1'b1;
		   end
		   else if (cnt < 6'd19) begin
		      nss_reg <= 1'b0;
		      mosi_reg <= cmd_in[7];
		      cmd_in <= {cmd_in[6:0], 1'b0};
		      cnt <= cnt + 1'b1;
		   end
		   else if (cnt == 6'd19) begin
		      nss_reg <= 1'b1;
		      mosi_reg <= 1'b1;
		      cnt <= 6'd0;
		      busy_reg <= 1'b0;
		      data_valid_reg <= 1'd1;
		      state <= IDLE;
		   end
		end
	     end
	     
	     WRITE_ENABLE_CMD: begin	                           // enable page program, erase command
		if (sclk_trigger) begin  // negedge of sclkreg
		   if (cnt < 6'd8) begin
		      nss_reg <= 1'b0;
		      mosi_reg <= cmd_in[7];
		      cmd_in <= {cmd_in[6:0], 1'b0};
		      busy_reg <= 1'b1;
		      cnt <= cnt + 1'b1;
		   end
		   else if (cnt == 6'd8) begin
		      data_valid_reg <= 1'd1;
		      cnt <= 6'd0;
		     
		      if (state_loop_flag)
			state <= WBURST_PAGE;
		      else 
			state <= IDLE;
		      
		   end
		   
		end
	     end // case: WRITE_ENABLE_CMD

	     WRITE_ENABLE_VOL_CMD: begin	// enable page program, erase command
		if (sclk_trigger) begin  // negedge of sclkreg
		   if (cnt < 6'd8) begin
		      nss_reg <= 1'b0;
		      mosi_reg <= cmd_in[7];
		      cmd_in <= {cmd_in[6:0], 1'b0};
		      busy_reg <= 1'b1;
		      cnt <= cnt + 1'b1;
		   end
		   else if (cnt == 6'd8) begin
		      data_valid_reg <= 1'd1;
		      cnt <= 6'd0;
		      state <= IDLE;
		   end
		   
		end
	     end // case: WRITE_ENABLE_CMD


	     WRITE_DISABLE_CMD: begin	// enable page program, erase command
		if (sclk_trigger) begin  // negedge of sclkreg
		   if (cnt < 6'd8) begin
		      nss_reg <= 1'b0;
		      mosi_reg <= cmd_in[7];
		      cmd_in <= {cmd_in[6:0], 1'b0};
		      busy_reg <= 1'b1;
		      cnt <= cnt + 1'b1;
		   end
		   else if (cnt == 6'd8) begin
		      data_valid_reg <= 1'd1;
		      cnt <= 6'd0;
		      state <= IDLE;
		   end
		   
		end
	     end // case: WRITE_ENABLE_CMD
	     
	     
	     
	     WRITE_REG_CMD: begin	// write status register command
		if (sclk_trigger) begin  // negedge of sclkreg	
		   nss_reg <= 1'b0;
		   busy_reg <= 1'b1;
		   if (cnt < 6'd8) begin
		      cnt <= cnt + 1'b1;
		      mosi_reg <= cmd_in[7];
		      cmd_in <= {cmd_in[6:0], 1'b0};
		   end
		   else if (cnt == 6'd8) begin
		      writecnt <= 'd1;	// write 1 byte
		      cnt <= 6'd0;
		      mosi_reg <= data_in_reg[7];
		      data_in_reg <= {data_in_reg[6:0], 1'b0};
		      state <= WRITE_DATA;
		   end
		end
	     end
	     
	     WRITE_CMD: begin	// page program
		wfifo_rd0 <= 1'b0;

		
		if (sclk_trigger) begin  // negedge of sclkreg
		   //cmd phase
		   if (cnt < 6'd8) begin
		      nss_reg <= 1'b0;
		      mosi_reg <= cmd_in[7];
		      cmd_in <= {cmd_in[6:0], 1'b0};
		      busy_reg <= 1'b1;
		      cnt <= cnt + 1'b1;
		   end
		   
		   //address phase
		   else if (cnt < (6'd8 + ADDR_WIDTH)) begin
		      nss_reg <= 1'b0;
		      cnt <= cnt + 1'b1;
		      mosi_reg <= address_reg[ADDR_WIDTH-1];
		      address_reg <= {address_reg[ADDR_WIDTH-2:0], 1'b0};
		      if (cnt == (6'd7 + ADDR_WIDTH)) begin
			      if (spi_cmd == 5'd22) begin
				      wfifo_rd0 <= 1'd1;
				      data_in_reg <= burst_data_wr;
			      end
		      end
		   end
		   
		   //data phase. 
		   else if (cnt == (6'd8 + ADDR_WIDTH)) begin
		      //if (cmd_in == QUAD_WRITEDATA) begin
		      if (spi_cmd == 5'd22) begin
			      mosi_reg <= data_in_reg[4];
			      mosi_breg[2:0] <= data_in_reg[7:5];
			      data_in_reg <= {data_in_reg[3:0], 4'h0};
			      cnt <= 6'd5;
		      end
		      else begin
			      mosi_reg <= burst_data_wr[7];
			      data_in_reg <= {burst_data_wr[6:0], 1'b0};
			      cnt <= 6'd0;
		      end
		      writecnt <= w_burst_cnt_max;	// write 256 bytes //write 3 bytes
		      state <= WRITE_DATA;
		   end
		end
	     end
	     
	     ERASE_CMD: begin	// data_in with instruction for sector erase 0x20 or block erase 0x52/0xD8
		if (sclk_trigger) begin  // negedge of sclkreg
		   if (cnt < 6'd8) begin
		      nss_reg <= 1'b0;
		      mosi_reg <= spi_cmd_instr_reg[7];
		      spi_cmd_instr_reg <= {spi_cmd_instr_reg[6:0], 1'b0};
		      busy_reg <= 1'b1;
		      cnt <= cnt + 1'b1;
		   end
		   else if (cnt < cnt_max) begin
		      nss_reg <= 1'b0;
		      mosi_reg <= address_reg[ADDR_WIDTH-1];
		      address_reg <= {address_reg[ADDR_WIDTH-2:0], 1'b0};
		      cnt <= cnt + 1'b1;
		   end
		   else if (cnt == cnt_max) begin
		      nss_reg <= 1'b1;
		      mosi_reg <= 1'b1;
		      cnt <= 6'd0;
		      busy_reg <= 1'b0;
		      data_valid_reg <= 1'd1;
		      state <= IDLE;
		   end
		end
	     end
	     
	     WRITE_DATA: begin	// data valid goes 1 when 1 byte has been written on SPI data bus
		if (sclk_trigger) begin  // negedge of sclkreg
		   // quad mosi_breg -- 1/11/2021
		   if (spi_cmd == 5'd22) begin
		   	mosi_reg <= data_in_reg[4];
			mosi_breg <= data_in_reg[7:5];
			if (cnt == 6'd5) begin		// not actual count, align with wfifo_rd0 only
			   nss_reg <= 1'b0;
			   data_valid_reg <= 1'b0;
			   //data_in_reg <= {data_in_reg[3:0], 4'h0};
			   data_in_reg <= burst_data_wr;
			   cnt <= 6'd8;
			end
			else if (cnt == 6'd8) begin
		   	   writecnt <= writecnt - 1'b1;
		   	   //data_in_reg <= burst_data_wr;
		   	   data_in_reg <= {data_in_reg[3:0], 4'h0};
		   	   data_valid_reg <= 1'b1;
		   	   cnt <= 6'd5;
			end
		   end
		   else begin
		   	mosi_reg <= data_in_reg[7];
		   	if (cnt < 6'd6) begin
		   	   nss_reg <= 1'b0;
		   	   data_valid_reg <= 1'b0;
		   	   data_in_reg <= {data_in_reg[6:0], 1'b0};
		   	   cnt <= cnt + 1'b1;
		   	end
		   	else if (cnt == 6'd6) begin
		   	   data_in_reg <= (burst_wr_flag)? burst_data_wr : data_in;
		   	   cnt <= cnt + 1'b1;
		   	end
		   	else if (cnt == 6'd7) begin
		   	   writecnt <= writecnt - 1'b1;
		   	   data_in_reg <= {data_in_reg[6:0], 1'b0};
		   	   data_valid_reg <= 1'b1;
		   	   cnt <= 6'd0;
		   	end

		   end		   
		   
		   if (burst_wr_flag & cnt == 6'd5 & writecnt != 'd1)
		      wfifo_rd0 <= 1'b1;
		   else
		      wfifo_rd0 <= 1'b0;
		   	
		   if ((writecnt == 'd1) && (cnt >= 6'd7)) begin
		   //if ((writecnt == 'd1) && (cnt == 6'd7)) begin
		      nss_reg <= 1'b1;
		      busy_reg <= 1'b0;
		      //state <= IDLE;
		      burst_wr_flag <= 1'b0; //clear the burst write flag.
		      if (spi_wr_burst_size_cnt == 8'h1)
			begin 
			   page_program_done <= (burst_wr_flag) ? 1'b1 : 1'b0;
			   state <= IDLE;
			   state_loop_flag <= 1'b0;
			end
		      else
			begin
			   page_program_done <= 1'b0;
			   state <= WBURST_CHK_STATUS;
			end
		         
		   end // if ((writecnt == 'd1) && (cnt == 6'd7))
		   
		end
	     end

	     WBURST_CHK_STATUS : begin
		nss_reg <= 1'b1;
		mosi_reg <= 1'b1;
		readcnt <= 'b0;
		//read_done <= 1'b0;
		cnt <= 6'd0;

		
		data_out_reg_d <= 8'd0;
		busy_reg <= 1'b1;
		cmd_in <= RDREG1_DATA;
		state_loop_flag <= 1'b1;
		instr_wait_cnt <= instr_wait_cnt + 1;
		if (instr_wait_cnt == 4'hf)
		  begin
		     state <= READ_REG_CMD;
		     instr_wait_cnt <= 4'h0;
		  end
		
	     end // case: WBURST_CHK_STATUS

	     WBURST_WEL_CLR : begin
		if (data_out_reg_d[1] == 1'b0) //WEL flag is clear.*TO FIX - 
		  state <= WBURST_WE_INSTR;
		else //Repeat again if not clear.
		  state <= WBURST_CHK_STATUS;
	     end

	     WBURST_WE_INSTR : begin
		nss_reg <= 1'b1;
		mosi_reg <= 1'b1;
		readcnt <= 'b0;
		//read_done <= 1'b0;
		cnt <= 6'd0;
		
		busy_reg <= 1'b1;
		cmd_in <= WRITE_ENABLE_DATA;
		erase_en <= 1'b1;
		instr_wait_cnt <= instr_wait_cnt + 1;

		if (instr_wait_cnt == 4'hf)
		  begin
		     state <= WRITE_ENABLE_CMD;
		     instr_wait_cnt <= 4'h0;
		  end
	     end // case: WBURST_WE_INSTR

	     WBURST_PAGE : begin
		nss_reg <= 1'b1;
		mosi_reg <= 1'b1;
		readcnt <= 'b0;
		//read_done <= 1'b0;
		cnt <= 6'd0;
		
		
		busy_reg <= 1'b1;
		cmd_in <= WRITEDATA;
		wfifo_rd0 <= 1'b1;
		burst_wr_flag <= 1'b1;
	
	
		instr_wait_cnt <= instr_wait_cnt + 1;

		if (instr_wait_cnt == 4'hf)
		  begin
		     flash_address_reg <= flash_address_reg + 256;
		     spi_wr_burst_size_cnt <= spi_wr_burst_size_cnt-1; 
		     state <= WRITE_CMD;
		     address_reg <= flash_address_reg + 256;
		     instr_wait_cnt <= 4'h0;
		  end
	     end
	     
	     READ_DUMMY_DATA: begin
	      //if (spi_cmd == 5'd23 || spi_cmd == 5'd24) begin // Fast Read Quad, Fast IO Read Quad
	      	/*if (sclk_reg_pos) begin  // posedge of sclkreg
	      	   data_out_reg <= {data_out_reg[3:0], miso_3, miso_2, miso, miso_1};
	      	   readcnt <= readcnt - 1'b1;
	      	   if ( (cnt < 6'd7 && spi_cmd == 5'd23) || (cnt < 6'd3 && spi_cmd == 5'd24) ) begin
	      	      data_valid_reg <= 1'b0;
	      	      cnt <= cnt + 1'b1;
	      	   end
	      	   else begin
	      	      data_out_reg_d <= {data_out_reg[3:0], miso_3, miso_2, miso, miso_1};
	      	      data_valid_reg <= 1'b1;
	      	      cnt <= 6'd0;
	      	     // if (readcnt == 'd0) begin
	      		 //read_done <= 1'b1;
	      	     // end
	      	   end
	      	end
	      	if (sclk_trigger) begin  // negedge of sclkreg
	      	   if (read_done == 1'b1) begin
	      	      //burst_rd_flag <= 1'b1;            // set the burst read flag.
	      	      state <= READ_DATA;
	      	      //read_done <= 1'b0;
	      	      readcnt <= r_burst_cnt_max;	// read 256 bytes (2048 bits) data
	      	   end
	      	end*/
         //end
	     /*else if (spi_cmd == 5'd21) begin // Fast Read Dual
	    	if (sclk_reg_pos) begin  // posedge of sclkreg
	    	   data_out_reg <= {data_out_reg[5:0], miso, miso_1};
	    	   readcnt <= readcnt - 1'b1;
	    	   if (cnt < 6'd7) begin
	    	      data_valid_reg <= 1'b0;
	    	      cnt <= cnt + 1'b1;
	    	   end
	    	   else begin
	    	      data_out_reg_d <= {data_out_reg[5:0], miso, miso_1};
	    	      data_valid_reg <= 1'b1;
	    	      cnt <= 6'd0;
	    	     // if (readcnt == 'd0) begin
	    		 //read_done <= 1'b1;
	    	     // end
	    	   end
	    	end
	    	if (sclk_trigger) begin  // negedge of sclkreg
	    	   if (read_done == 1'b1) begin
	    	      burst_rd_flag <= 1'b1;            // set the burst read flag.
	    	      state <= READ_DATA;
	    	      //read_done <= 1'b0;
	    	      readcnt <= r_burst_cnt_max;	// read 256 bytes (2048 bits) data
	    	   end
	    	end
          end
          else begin*/
              if (sclk_reg_pos) begin  // posedge of sclkreg
                 //data_out_reg <= {data_out_reg[6:0], miso};
                 readcnt <= readcnt - 1'b1;
                 if (cnt < 6'd7) begin
                    //data_valid_reg <= 1'b0;
                    cnt <= cnt + 1'b1;
                 end
                 else begin
                    //data_out_reg_d <= {data_out_reg[6:0], miso};
                    //data_valid_reg <= 1'b1;
                    cnt <= 6'd0;
                 //   if (readcnt == 'd0) begin
              	 //read_done <= 1'b1;
                 //   end
                 end
              end
              if (sclk_trigger) begin  // negedge of sclkreg
                 if (read_done == 1'b1) begin
                    burst_rd_flag <= 1'b1;            // set the burst read flag.
                    state <= READ_DATA;
                    //read_done <= 1'b0;
                    readcnt <= r_burst_cnt_max;	// read 256 bytes (2048 bits) data
                 end
              end
          //end
	     end // case: READ_DUMMY_DATA
	     
	     READ_DATA: begin
		if (sclk_reg_pos) begin  // posedge of sclkreg

		   if (spi_cmd == 5'd23) //Quad Fast Read
		     begin
			data_out_reg <= {data_out_reg[3:0], miso_3, miso_2, miso, miso_1};
			readcnt <= readcnt - 1'b1;
		     end   
		   else if (spi_cmd == 5'd21) //Fast Read Dual
		     begin
			data_out_reg <= {data_out_reg[5:0], miso, miso_1};
			readcnt <= readcnt - 1'b1;
		     end   
		   else
		     begin 
			data_out_reg <= {data_out_reg[6:0], miso};
			readcnt <= readcnt - 1'b1;
		     end
		   
		   if ( (spi_cmd == 5'd21 && cnt < 6'd3) || (spi_cmd != 5'd21 && cnt < 6'd7) ) begin
		      data_valid_reg <= 1'b0;
		      if (spi_cmd == 5'd23)
                cnt <= cnt + 3'd7; // 4 bits read at 1 time
		      else
		      	cnt <= cnt + 1'b1;
		   end
		   else begin
		      if (spi_cmd == 5'd23) 
			data_out_reg_d <= {data_out_reg[5:0], miso_3, miso_2, miso, miso_1};
		      else if (spi_cmd == 5'd21) 
			data_out_reg_d <= {data_out_reg[5:0], miso, miso_1};
		      else
			data_out_reg_d <= {data_out_reg[6:0], miso};
		      
		      data_valid_reg <= 1'b1;
		      cnt <= 6'd0;
		     // if ((readcnt == 'd0 && (spi_cmd !=5'd20 | spi_cmd !=5'd21 | spi_cmd !=5'd23) ) | ( (spi_cmd == 5'd20 | spi_cmd == 5'd21 | spi_cmd == 5'd23) & ~rden)) begin
			 //read_done <= 1'b1;
		     // end
		   end
		end
		if (sclk_trigger) begin  // negedge of sclkreg
		   if (read_done == 1'b1) begin
		    
		      burst_rd_flag <= 1'b0; //clear the burst read flag.
		      
		      if (state_loop_flag)
			state <= WBURST_WEL_CLR;
		      else 
			state <= IDLE;
		      
		   end
		end
	     end
	     
	     default: begin
		state <= IDLE;
	     end
	   endcase
	end
     end // always @ (posedge clkin)
   
    assign c_read_done = (state == READ_DUMMY_DATA && readcnt == 'd0) || (state == READ_DATA && (readcnt == 'd0) && (spi_cmd !=5'd20 & spi_cmd !=5'd21 & spi_cmd !=5'd23))
                          || (state == READ_DATA && (spi_cmd == 5'd20 | spi_cmd == 5'd21 | spi_cmd == 5'd23) & ~rden);
                         
    always @(posedge clkin) begin
      if (~nrst) begin
        r_read_done <= 1'b0;
      end
      else if (sclk_reg_pos) begin
        r_read_done <= c_read_done;
      end
    end
    
    assign read_done = (SCLK_FREQ == 0) ? c_read_done : r_read_done;

   //To update those read register from SPI Flash.
   always @(posedge clkin)
     if (~nrst)
       begin
	  data_valid_reg0 <= 1'b0;
	  data_valid_reg1 <= 1'b0;
	  wfifo_rd1 <= 1'b0;
       end
     else
       begin
	  data_valid_reg0 <= data_valid_reg;
	  data_valid_reg1 <= data_valid_reg0;
	  wfifo_rd1 <= wfifo_rd0;
	  
       end
   assign wfifo_rd = wfifo_rd0 && ~wfifo_rd1;
   
   
   always @(posedge clkin)
     if (!nrst) begin 
	manufacturing_id_reg <= 8'h0;
	jedec_id_reg <= 24'h0;
	unique_id_reg <= 64'h0;
	device_id_reg <= 8'h0;
	spi_flash_rd_status_reg0 <= 8'h0;
	spi_flash_rd_status_reg1 <= 8'h0;
	spi_flash_rd_status_reg2 <= 8'h0;

	
     end
   
     else if (data_valid_reg0 & ~data_valid_reg1) begin 
       case (spi_cmd)
	 5'd6  : jedec_id_reg[23:0]        <= {data_out_reg_d,jedec_id_reg[23:8]};
	 5'd17 : manufacturing_id_reg[7:0] <= data_out_reg_d;
	 5'd4  : unique_id_reg[63:0]       <= {unique_id_reg[55:0],data_out_reg_d};
	 5'd3  : device_id_reg             <= data_out_reg_d;
	 5'd14 : spi_flash_rd_status_reg0  <= data_out_reg_d;
	 5'd15 : spi_flash_rd_status_reg1  <= data_out_reg_d;
	 5'd16 : spi_flash_rd_status_reg2  <= data_out_reg_d;
	 default : ;
       endcase // case (spi_cmd)
     end
   
   
	 
	  
endmodule // efx_spi_shifter


//////////////////////////////////////////////////////////////////////////////
// Copyright (C) 2013-2019 Efinix Inc. All rights reserved.
//
// This   document  contains  proprietary information  which   is
// protected by  copyright. All rights  are reserved.  This notice
// refers to original work by Efinix, Inc. which may be derivitive
// of other work distributed under license of the authors.  In the
// case of derivative work, nothing in this notice overrides the
// original author's license agreement.  Where applicable, the 
// original license agreement is included in it's original 
// unmodified form immediately below this header.
//
// WARRANTY DISCLAIMER.  
//     THE  DESIGN, CODE, OR INFORMATION ARE PROVIDED “AS IS” AND 
//     EFINIX MAKES NO WARRANTIES, EXPRESS OR IMPLIED WITH 
//     RESPECT THERETO, AND EXPRESSLY DISCLAIMS ANY IMPLIED WARRANTIES, 
//     INCLUDING, WITHOUT LIMITATION, THE IMPLIED WARRANTIES OF 
//     MERCHANTABILITY, NON-INFRINGEMENT AND FITNESS FOR A PARTICULAR 
//     PURPOSE.  SOME STATES DO NOT ALLOW EXCLUSIONS OF AN IMPLIED 
//     WARRANTY, SO THIS DISCLAIMER MAY NOT APPLY TO LICENSEE.
//
// LIMITATION OF LIABILITY.  
//     NOTWITHSTANDING ANYTHING TO THE CONTRARY, EXCEPT FOR BODILY 
//     INJURY, EFINIX SHALL NOT BE LIABLE WITH RESPECT TO ANY SUBJECT 
//     MATTER OF THIS AGREEMENT UNDER TORT, CONTRACT, STRICT LIABILITY 
//     OR ANY OTHER LEGAL OR EQUITABLE THEORY (I) FOR ANY INDIRECT, 
//     SPECIAL, INCIDENTAL, EXEMPLARY OR CONSEQUENTIAL DAMAGES OF ANY 
//     CHARACTER INCLUDING, WITHOUT LIMITATION, DAMAGES FOR LOSS OF 
//     GOODWILL, DATA OR PROFIT, WORK STOPPAGE, OR COMPUTER FAILURE OR 
//     MALFUNCTION, OR IN ANY EVENT (II) FOR ANY AMOUNT IN EXCESS, IN 
//     THE AGGREGATE, OF THE FEE PAID BY LICENSEE TO EFINIX HEREUNDER 
//     (OR, IF THE FEE HAS BEEN WAIVED, $100), EVEN IF EFINIX SHALL HAVE 
//     BEEN INFORMED OF THE POSSIBILITY OF SUCH DAMAGES.  SOME STATES DO 
//     NOT ALLOW THE EXCLUSION OR LIMITATION OF INCIDENTAL OR 
//     CONSEQUENTIAL DAMAGES, SO THIS LIMITATION AND EXCLUSION MAY NOT 
//     APPLY TO LICENSEE.
//
/////////////////////////////////////////////////////////////////////////////



/////////////////////////////////////////////////////////////////////////////
//           _____       
//          / _______    Copyright (C) 2013-2020 Efinix Inc. All rights reserved.
//         / /       \   
//        / /  ..    /   `IP_MODULE_NAME(simple_dual_port_ram).v
//       / / .'     /    
//    __/ /.'      /     Description:
//   __   \       /      Single RAM block
//  /_/ /\ \_____/ /     
// ____/  \_______/      
//
// *******************************
// Revisions:
// 0.0 Initial rev
// 0.1 Added output register
// 1.0 Finalized RTL macro
// *******************************

module `IP_MODULE_NAME(simple_dual_port_ram)
#(
	parameter DATA_WIDTH	= 8,
	parameter ADDR_WIDTH	= 9,
	parameter OUTPUT_REG	= "TRUE",
	parameter RAM_INIT_FILE	= ""
)
(
	input [(DATA_WIDTH-1):0] wdata,
	input [(ADDR_WIDTH-1):0] waddr, raddr,
	input we, wclk, re, rclk,
	output [(DATA_WIDTH-1):0] rdata
);

	localparam MEMORY_DEPTH = 2**ADDR_WIDTH;
	localparam MAX_DATA = (1<<ADDR_WIDTH)-1;
	
	reg [DATA_WIDTH-1:0] ram[MEMORY_DEPTH-1:0];
	reg [DATA_WIDTH-1:0] r_rdata_1P;
	reg [DATA_WIDTH-1:0] r_rdata_2P;
	
	integer i;
	initial
	begin
	// By default the Efinix memory will initialize to 0
		if (RAM_INIT_FILE != "")
		begin
			$readmemh(RAM_INIT_FILE, ram);
		end
	end
	
	always @ (posedge wclk)
		if (we)
		ram[waddr] <= wdata;
	
	always @ (posedge rclk)
	begin
		if (re)
			r_rdata_1P <= ram[raddr];
		r_rdata_2P <= r_rdata_1P;
	end
	
	generate
		if (OUTPUT_REG == "TRUE")
			assign	rdata = r_rdata_2P;
		else
			assign	rdata = r_rdata_1P;
	endgenerate

endmodule


//////////////////////////////////////////////////////////////////////////////
// Copyright (C) 2013-2019 Efinix Inc. All rights reserved.
//
// This   document  contains  proprietary information  which   is
// protected by  copyright. All rights  are reserved.  This notice
// refers to original work by Efinix, Inc. which may be derivitive
// of other work distributed under license of the authors.  In the
// case of derivative work, nothing in this notice overrides the
// original author's license agreement.  Where applicable, the 
// original license agreement is included in it's original 
// unmodified form immediately below this header.
//
// WARRANTY DISCLAIMER.  
//     THE  DESIGN, CODE, OR INFORMATION ARE PROVIDED “AS IS” AND 
//     EFINIX MAKES NO WARRANTIES, EXPRESS OR IMPLIED WITH 
//     RESPECT THERETO, AND EXPRESSLY DISCLAIMS ANY IMPLIED WARRANTIES, 
//     INCLUDING, WITHOUT LIMITATION, THE IMPLIED WARRANTIES OF 
//     MERCHANTABILITY, NON-INFRINGEMENT AND FITNESS FOR A PARTICULAR 
//     PURPOSE.  SOME STATES DO NOT ALLOW EXCLUSIONS OF AN IMPLIED 
//     WARRANTY, SO THIS DISCLAIMER MAY NOT APPLY TO LICENSEE.
//
// LIMITATION OF LIABILITY.  
//     NOTWITHSTANDING ANYTHING TO THE CONTRARY, EXCEPT FOR BODILY 
//     INJURY, EFINIX SHALL NOT BE LIABLE WITH RESPECT TO ANY SUBJECT 
//     MATTER OF THIS AGREEMENT UNDER TORT, CONTRACT, STRICT LIABILITY 
//     OR ANY OTHER LEGAL OR EQUITABLE THEORY (I) FOR ANY INDIRECT, 
//     SPECIAL, INCIDENTAL, EXEMPLARY OR CONSEQUENTIAL DAMAGES OF ANY 
//     CHARACTER INCLUDING, WITHOUT LIMITATION, DAMAGES FOR LOSS OF 
//     GOODWILL, DATA OR PROFIT, WORK STOPPAGE, OR COMPUTER FAILURE OR 
//     MALFUNCTION, OR IN ANY EVENT (II) FOR ANY AMOUNT IN EXCESS, IN 
//     THE AGGREGATE, OF THE FEE PAID BY LICENSEE TO EFINIX HEREUNDER 
//     (OR, IF THE FEE HAS BEEN WAIVED, $100), EVEN IF EFINIX SHALL HAVE 
//     BEEN INFORMED OF THE POSSIBILITY OF SUCH DAMAGES.  SOME STATES DO 
//     NOT ALLOW THE EXCLUSION OR LIMITATION OF INCIDENTAL OR 
//     CONSEQUENTIAL DAMAGES, SO THIS LIMITATION AND EXCLUSION MAY NOT 
//     APPLY TO LICENSEE.
//
/////////////////////////////////////////////////////////////////////////////


`undef IP_UUID
`undef IP_NAME_CONCAT
`undef IP_MODULE_NAME
